## drivers/media/platform/rockchip/coprocessor/Kconfig
```kconfig
# SPDX-License-Identifier: GPL-2.0
config VIDEO_ROCKCHIP_USBACM_CONTROL
	tristate "Rockchip Usbacm video control driver"
	depends on VIDEO_V4L2 && VIDEO_V4L2_SUBDEV_API && NPU_USB_ACM
	depends on ARCH_ROCKCHIP || COMPILE_TEST
	depends on MEDIA_CAMERA_SUPPORT
	select VIDEOBUF2_DMA_CONTIG
	select V4L2_FWNODE
	default n
	help
	  Support for usbacm video control on the rockchip SoCs like rk1808.
```

## drivers/media/spi/Kconfig
```kconfig
if VIDEO_V4L2

menu "SPI helper chips"
	visible if !MEDIA_SUBDRV_AUTOSELECT || COMPILE_TEST

config VIDEO_GS1662
	tristate "Gennum Serializers video"
	depends on SPI && VIDEO_V4L2 && VIDEO_V4L2_SUBDEV_API
	---help---
	  Enable the GS1662 driver which serializes video streams.

config VIDEO_IMX327_SPI
	tristate "Sony imx327 sensor support"
	depends on SPI && VIDEO_V4L2 && VIDEO_V4L2_SUBDEV_API
	depends on MEDIA_CAMERA_SUPPORT
	select V4L2_FWNODE
	help
	  This driver supports IMX327 cameras from Sony

config VIDEO_ROCKCHIP_PREISP
	tristate "Rockchip Image Signal Pre-processing driver"
	depends on VIDEO_V4L2 && VIDEO_V4L2_SUBDEV_API && SPI_MASTER
	depends on ARCH_ROCKCHIP || COMPILE_TEST
	select V4L2_FWNODE
	default n
	help
	  Support for Pre-isp on the rockchip SoC.

endmenu

endif
```

## drivers/media/usb/rockchip/Kconfig
```kconfig
config NPU_USB_ACM
	tristate "Rockchip NPU ACM device driver support"
	depends on USB
	help
	  This is a ACM driver for Rockchip NPU USB device.

	  Say Y here if you want to connect this type of
	  device to your HOST USB port.
```

## drivers/media/video/rk_preisp/Kconfig
```kconfig
# SPDX-License-Identifier: GPL-2.0

menu "RockChip preisp driver"

config RKPREISP_DRV
	tristate "preisp driver "
	default n
	---help---

endmenu
```

## drivers/memory/tegra/Kconfig
```kconfig
config TEGRA124_EMC
	bool "Tegra124 External Memory Controller(EMC) driver"
	default y
	depends on MFD_SYSCON && (ARCH_TEGRA_124_SOC || ARCH_TEGRA_132_SOC)
	help
	  This driver is for the External Memory Controller(EMC) module
	  available in Tegra124 SoCs.
```

## drivers/miniarm/dsi/Kconfig
```kconfig
config DRM_PANEL_TOSHIBA_TC358762
	tristate "support for toshiba tc358762"
	depends on OF && I2C
	depends on BACKLIGHT_CLASS_DEVICE
	select VIDEOMODE_HELPERS
	help
	  Say Y here if you want to enable support for toshiba tc358762 bridge.
	  To compile this driver as a module, choose M here.

config ASUS_RPI_MCU
	tristate "RPI MCU for ASUS"
	depends on DRM_ROCKCHIP && DRM_PANEL_TOSHIBA_TC358762
	depends on I2C
	select RPI_MCU
	help
	 This selects support for TOSHIBA TC358762 bridge specific
	 extensions for ASUS rpi. If you want to enable MIPI DSI
	 on RK3288 based SoC, you should selet this option.

config ROCKCHIP_DW_MIPI_DSI2
	tristate "Rockchip specific extensions for Synopsys DW MIPI DSI"
	depends on DRM_ROCKCHIP
	depends on !ROCKCHIP_DW_MIPI_DSI
	select DRM_MIPI_DSI
	help
	 This selects support for Rockchip SoC specific extensions
	 for the Synopsys DesignWare HDMI driver. If you want to
	 enable MIPI DSI on RK3288 based SoC, you should selet this
	 option.
```

## drivers/misc/axd/Kconfig
```kconfig
config AXD
	tristate "AXD Audio Processing IP"
	depends on MIPS && COMMON_CLK && CMA
	---help---
	  Say Y here if you want to use AXD Audio Processing IP.

config AXD_DEBUG_DIAG
	bool "AXD diagnostics"
	depends on AXD
	---help---
	  Say Y if you want AXD driver to print some diagnostics after playing
	  a stream.
```

## drivers/mtd/spi-nand/Kconfig
```kconfig
menuconfig MTD_SPI_NAND
	tristate "SPI NAND device support"
	depends on MTD
	select MTD_NAND
	help
	  This is the framework for the SPI NAND.

if MTD_SPI_NAND

config MTD_SPI_NAND_DEVICES
	tristate "Support for SPI NAND devices (MT29F, GD5F)"
	default y
	depends on MTD_SPI_NAND
	help
	  Select this option if you require support for the most common SPI NAND
	  devices such as mt29f and gd5f.

endif # MTD_SPI_NAND
```

## drivers/mtd/spi-nor/Kconfig
```kconfig
menuconfig MTD_SPI_NOR
	tristate "SPI-NOR device support"
	depends on MTD
	help
	  This is the framework for the SPI NOR which can be used by the SPI
	  device drivers and the SPI-NOR device driver.

if MTD_SPI_NOR

config SPI_FSL_QUADSPI
	tristate "Freescale Quad SPI controller"
	depends on ARCH_MXC
	help
	  This enables support for the Quad SPI controller in master mode.
	  We only connect the NOR to this controller now.

config SPI_HISI_SFC
	tristate "Hisilicon SPI-NOR Flash Controller(SFC)"
	depends on ARCH_HISI || COMPILE_TEST
	depends on HAS_IOMEM && HAS_DMA
	help
	  This enables support for hisilicon SPI-NOR flash controller.

endif # MTD_SPI_NOR
```

## drivers/net/ethernet/atheros/Kconfig
```kconfig
#
# Atheros device configuration
#

config NET_VENDOR_ATHEROS
	bool "Atheros devices"
	default y
	depends on PCI
	---help---
	  If you have a network (Ethernet) card belonging to this class, say Y
	  and read the Ethernet-HOWTO, available from
	  <http://www.tldp.org/docs.html#howto>.

	  Note that the answer to this question doesn't directly affect the
	  kernel: saying N will just cause the configurator to skip all
	  the questions about Atheros devices. If you say Y, you will be asked
	  for your specific card in the following questions.

if NET_VENDOR_ATHEROS

config ATL2
	tristate "Atheros L2 Fast Ethernet support"
	depends on PCI
	select CRC32
	select MII
	---help---
	  This driver supports the Atheros L2 fast ethernet adapter.

	  To compile this driver as a module, choose M here.  The module
	  will be called atl2.

config ATL1
	tristate "Atheros/Attansic L1 Gigabit Ethernet support"
	depends on PCI
	select CRC32
	select MII
	---help---
	  This driver supports the Atheros/Attansic L1 gigabit ethernet
	  adapter.

	  To compile this driver as a module, choose M here.  The module
	  will be called atl1.

config ATL1E
	tristate "Atheros L1E Gigabit Ethernet support"
	depends on PCI
	select CRC32
	select MII
	---help---
	  This driver supports the Atheros L1E gigabit ethernet adapter.

	  To compile this driver as a module, choose M here.  The module
	  will be called atl1e.

config ATL1C
	tristate "Atheros L1C Gigabit Ethernet support"
	depends on PCI
	select CRC32
	select MII
	---help---
	  This driver supports the Atheros L1C gigabit ethernet adapter.

	  To compile this driver as a module, choose M here.  The module
	  will be called atl1c.

config ALX
	tristate "Qualcomm Atheros AR816x/AR817x support"
	depends on PCI
	select CRC32
	select MDIO
	help
	  This driver supports the Qualcomm Atheros L1F ethernet adapter,
	  i.e. the following chipsets:

	  1969:1091 - AR8161 Gigabit Ethernet
	  1969:1090 - AR8162 Fast Ethernet
	  1969:10A1 - AR8171 Gigabit Ethernet
	  1969:10A0 - AR8172 Fast Ethernet

	  To compile this driver as a module, choose M here.  The module
	  will be called alx.

config QCA8337_LITE
	tristate "Qualcomm/Atheros QCA8337 driver for minimal initialization (EXPERIMENTAL)"
	depends on EXPERIMENTAL
	select NET_CORE
	select MII
	---help---
	  This driver performs a minimal initialization of the Qualcom/Atheros QCA8337

	  Normally, U-boot (BIOS) performs this initialization. Systems using CoreBoot
	  (instead of U-Boot) need this driver to use Wired Ethernet.
	  If in doubt, select M.

	  The module will be called qca3887-lite.

config QCA_NSS_DRV
	tristate "Qualcomm/Atheros IPQ806x NSS driver support (EXPERIMENTAL)"
	depends on EXPERIMENTAL && ARCH_QCOM
	select NET_CORE
	select MII
	---help---
	  This driver supports the Qualcomm/Atheros IPQ806x internal NSS core.
	  It contains routines to load firmware and basic methods to communicate
	  with it. The NSS based GMAC relies on this driver to communicate with
	  the NSS firmware.

	  The module will be called qca-nss-drv.

config QCA_NSS_GMAC
	tristate "Qualcomm/Atheros IPQ806x GMAC Ethernet support (EXPERIMENTAL)"
	depends on EXPERIMENTAL && ARCH_QCOM
	select QCA_NSS_DRV
	select NET_CORE
	select MII
	---help---
	  This driver supports the Qualcomm/Atheros GMAC ports in IPQ806x
	  chipset. Presents an ethernet interface to user space.

	  The module will be called qca-nss-gmac.

endif # NET_VENDOR_ATHEROS
```

## drivers/net/wireless-3.8/ti/Kconfig
```kconfig
menuconfig WL_TI
	bool "TI Wireless LAN support"
	---help---
	  This section contains support for all the wireless drivers
	  for Texas Instruments WLAN chips, such as wl1251 and the wl12xx
	  family.

if WL_TI
source "drivers/net/wireless-3.8/ti/wl1251/Kconfig"
source "drivers/net/wireless-3.8/ti/wl12xx/Kconfig"
source "drivers/net/wireless-3.8/ti/wl18xx/Kconfig"

# keep last for automatic dependencies
source "drivers/net/wireless-3.8/ti/wlcore/Kconfig"
endif # WL_TI
```

## drivers/net/wireless/iwl7000/Kconfig
```kconfig
config IWL7000
	tristate "Intel Wireless WiFi 7000 series driver (new version)"

	# normal iwlwifi dependencies
	depends on PCI && HAS_IOMEM
	select FW_LOADER
	select NEW_LEDS
	select LEDS_CLASS
	select LEDS_TRIGGERS

	# this is because we don't depend on mac80211
	depends on CFG80211

	# things mac80211 selects
	select CRYPTO
	select CRYPTO_ARC4
	select CRYPTO_AES
	select CRC32
	select AVERAGE

	# we can't really be modular ... at least I was too lazy for it
	depends on m

config IWL7000_DEBUGFS
	def_bool y
	depends on IWL7000
	depends on CFG80211_DEBUGFS

config IWL7000_TRACING
	def_bool y
	depends on IWL7000
	depends on EVENT_TRACING

config IWL7000_TESTMODE
	def_bool y
	depends on IWL7000
	depends on NL80211_TESTMODE

config IWL7000_XVT
	tristate "Enable IWL7000 XVT (production test) code"
	default m
	depends on IWL7000
	depends on IWL7000_TESTMODE
```

## drivers/net/wireless/rockchip_wlan/rtl8723bs-vq0/Kconfig
```kconfig
config RTL8723BS_VQ0
	tristate "Realtek 8723BS_VQ0 WiFi"
	---help---
	  Help message of RTL8723BS-VQ0
```

## drivers/net/wireless/rockchip_wlan/rtl8723du/Kconfig
```kconfig
config RTL8723DU
	tristate "Realtek 8723D USB WiFi"
	---help---
	  Help message of RTL8723DU
```

## drivers/net/wireless/rockchip_wlan/rtl8822bs/Kconfig
```kconfig
config RTL8822BS
	tristate "Realtek 8822BS SDIO WiFi"
	---help---
	  Help message of RTL8822BS
```

## drivers/net/wireless/rockchip_wlan/ssv6xxx/Kconfig
```kconfig
menu "iComm WLAN support"
config SSV6051
        tristate "ssv6051 Wireless driver"
	depends on MMC
	select CFG80211
	select MAC80211
	select NL80211_TESTMODE
	---help---
	  Enable iComm ssv6051 WLAN kernel driver.

config SSV6051_P2P
	default y
	bool "SSV6051_P2P"
	---help---
	  Enable iComm ssv6051 P2P interface.

config SSV6051_SDIO
	default y
	bool "SSV6051_SDIO"
	---help---
	  iComm ssv6051 sdio setting.

endmenu
```

## drivers/pinctrl/bcm/Kconfig
```kconfig
#
# Broadcom pinctrl drivers
#

config PINCTRL_BCM2835
	bool
	select PINMUX
	select PINCONF

config PINCTRL_CYGNUS_MUX
	bool "Broadcom Cygnus IOMUX driver"
	depends on (ARCH_BCM_CYGNUS || COMPILE_TEST)
	select PINMUX
	select GENERIC_PINCONF
	default ARCH_BCM_CYGNUS
	help
	  Say yes here to enable the Broadcom Cygnus IOMUX driver.

	  The Broadcom Cygnus IOMUX driver supports group based IOMUX
	  configuration, with the exception that certain individual pins
	  can be overrided to GPIO function
```

## drivers/platform/Kconfig
```kconfig
# drivers/platform/Kconfig

if X86
source "drivers/platform/x86/Kconfig"
endif
if GOLDFISH
source "drivers/platform/goldfish/Kconfig"
endif

if ARM
source "drivers/platform/arm/Kconfig"
endif

source "drivers/platform/chrome/Kconfig"

config CHROMEOS
	bool
	depends on ARM_CHROMEOS_FIRMWARE || (NVRAM && ACPI_CHROMEOS)

	---help---
	  Provides abstracted interfaces to the firmware features provided on
	  ChromeOS devices. It depends on a lowlevel driver to implement the
	  firmware interface on the platform.

config CHROMEOS_VBC_BLK
	bool
	depends on CHROMEOS

	---help---
	  Provides access to vboot context stored on block device.  Select this
	  if you have a ChromeOS firmware that does not support storing vboot
	  context in EC's nvram.

config CHROMEOS_VBC_EC
	bool
	depends on CHROMEOS && MFD_CROS_EC

	---help---
	  Provides access to vboot context stored on EC's nvram.  Select this
	  if you have a ChromeOS firmware that supports storing vboot context
	  in EC's nvram.
```

## drivers/platform/arm/Kconfig
```kconfig
#
# ARM Platform Specific Drivers
#

menuconfig ARM_PLATFORM_DEVICES
	bool "ARM Specific Device Drivers"
	default n
	---help---
	  Say Y here to get to see options for device drivers for various
	  ARM platforms. This option alone does not add any kernel code.

	  If you say N, all options in this submenu will be skipped and disabled.

if ARM_PLATFORM_DEVICES

config ARM_CHROMEOS_FIRMWARE
	bool "ChromeOS firmware interface driver"
	select CHROMEOS
	select CHROMEOS_VBC_BLK
	select CHROMEOS_VBC_EC if !ARCH_QCOM
	---help---
	  This driver provides an interface to ChromeOS firmware.

	  Say Y here if you are building for a ChromeOS device.

endif # CROS_PLATFORM_DEVICES
```

## drivers/reset/Kconfig
```kconfig
config ARCH_HAS_RESET_CONTROLLER
	bool

menuconfig RESET_CONTROLLER
	bool "Reset Controller Support"
	default y if ARCH_HAS_RESET_CONTROLLER
	help
	  Generic Reset Controller support.

	  This framework is designed to abstract reset handling of devices
	  via GPIOs or SoC-internal reset controller modules.

	  If unsure, say no.

config RESET_SCMI
	tristate "Reset driver controlled via ARM SCMI interface"
	depends on ARM_SCMI_PROTOCOL || COMPILE_TEST
	default ARM_SCMI_PROTOCOL
	help
	  This driver provides support for reset signal/domains that are
	  controlled by firmware that implements the SCMI interface.

	  This driver uses SCMI Message Protocol to interact with the
	  firmware controlling all the reset signals.

source "drivers/reset/sti/Kconfig"
```

## drivers/rksfc/Kconfig
```kconfig
if ARCH_ROCKCHIP
config RK_SFC
	tristate "RK SFC Device Support"
	default n
	help
	  RK NAND Device Support.

endif
```

## drivers/soc/Kconfig
```kconfig
menu "SOC (System On Chip) specific Drivers"

source "drivers/soc/rockchip/Kconfig"

endmenu
```

## drivers/soc/friendlyelec/Kconfig
```kconfig
#
# Machine drivers
#

if ARCH_ROCKCHIP

config VENDOR_FRIENDLYELEC
	bool "FriendlyElec board based on Rockchip SoCs"
	default n

endif
```

## drivers/soc/img/Kconfig
```kconfig
menuconfig SOC_IMG
        bool "IMG SOC drivers support"

if SOC_IMG

config IMG_EFUSE
	tristate "Imagination Technologies Generic eFuse driver"
	depends on HAS_IOMEM
	help
	  Imagination Technologies Generic eFuse driver which exposes the status
	  of 128 EFUSE bits.

	  To compile this driver as a module, choose M here: the module will
	  be called img-efuse.

endif # SOC_IMG
```
