## drivers/soc/qcom/Kconfig
```kconfig
#
# QCOM Soc drivers
#
config QCOM_GSBI
        tristate "QCOM General Serial Bus Interface"
        depends on ARCH_QCOM
        help
          Say y here to enable GSBI support.  The GSBI provides control
          functions for connecting the underlying serial UART, SPI, and I2C
          devices to the output pins.

config QCOM_TCSR
        tristate "QCOM Top Control and Status Registers"
        depends on ARCH_QCOM
        help
          Say y here to enable TCSR support.  The TCSR provides control
          functions for various peripherals.
```

## drivers/soc/rockchip/Kconfig
```kconfig
if ARCH_ROCKCHIP || COMPILE_TEST

#
# Rockchip Soc drivers
#
config ROCKCHIP_VENDOR_STORAGE
	bool "Rockchip vendor storage support"
	default y
	help
	  Say y here to enable vendor storage support.
	  Vendor storage is used for stored SN, MAC, BT ADDR etc.

endif
```

## drivers/soc/tegra/Kconfig
```kconfig
config TEGRA_DVFS
	bool "Tegra DVFS support"
	depends on ARCH_TEGRA
	help
	  This adds Tegra DVFS support. There could be several power
	  rails involved and there might be rails dependency based
	  on different SoCs, this config enable the generic DVFS
	  library needed by each SoCs DVFS files.

	  If in doubt, say N.

config TEGRA_124_DVFS
	bool "Tegra124 DVFS support"
	select TEGRA_DVFS
	help
	  This enable Tegra124 DVFS functionality, it implements SoC
	  specific initialization code to be invoked by probe function
	  defined in generic Tegra DVFS driver, so while enabled it
	  needs the config TEGRA_DVFS to be enabled as well.

config EDP_MANAGEMENT
	bool "EDP management"
	help
	  Power "sources" like batteries and regulators have limits
	  on how much current they can supply, the maximum current
	  the power source can supply is its "EDP limit".
	  This is the NVIDIA technique for managing the peak current
	  consumption of the power rail.
	  EDP management manages the components to avoid exceeding
	  the design limits, it limits peak current consumption
	  while maximizing performance.

config TEGRA_CPU_EDP_LIMITS
	bool "Enforce electrical design limits on CPU rail (CPU EDP)"
	depends on ARCH_TEGRA
	depends on CPU_FREQ && THERMAL && EDP_MANAGEMENT
	help
	  Enforce electrical design limits on CPU rail.
	  VDD_CPU EDP prevents the CPU from drawing more current than
	  its voltage regulator can supply.
	  Limit maximum CPU frequency based on temperature and number
	  of on-line CPUs to keep CPU rail current within power supply
	  capabilities.
	  If in doubt, say "Y".
```

## drivers/tty/wk2xxx/Kconfig
```kconfig
menu "wk2xxx"

config WK2XXX_I2C
	tristate "WK2XXX_I2C I2C Convert To UART"
	depends on I2C
	help
	  Select this option to enable I2C convert to 2 UARTS.

endmenu
```

## drivers/usb/dwc3/Kconfig
```kconfig
config USB_DWC3
	tristate "DesignWare USB3 DRD Core Support"
	depends on (USB || USB_GADGET) && GENERIC_HARDIRQS
	select USB_XHCI_PLATFORM if USB_SUPPORT && USB_XHCI_HCD
	help
	  Say Y or M here if your system has a Dual Role SuperSpeed
	  USB controller based on the DesignWare USB3 IP Core.

	  If you choose to build this driver is a dynamically linked
	  module, the module will be called dwc3.ko.

if USB_DWC3

choice
	bool "DWC3 Mode Selection"
	default USB_DWC3_DUAL_ROLE if (USB && USB_GADGET)
	default USB_DWC3_HOST if (USB && !USB_GADGET)
	default USB_DWC3_GADGET if (!USB && USB_GADGET)

config USB_DWC3_HOST
	bool "Host only mode"
	depends on USB=y || USB=USB_DWC3
	help
	  Select this when you want to use DWC3 in host mode only,
	  thereby the gadget feature will be regressed.

config USB_DWC3_GADGET
	bool "Gadget only mode"
	depends on USB_GADGET=y || USB_GADGET=USB_DWC3
	help
	  Select this when you want to use DWC3 in gadget mode only,
	  thereby the host feature will be regressed.

config USB_DWC3_DUAL_ROLE
	bool "Dual Role mode"
	depends on ((USB=y || USB=USB_DWC3) && (USB_GADGET=y || USB_GADGET=USB_DWC3))
	help
	  This is the default mode of working of DWC3 controller where
	  both host and gadget features are enabled.

endchoice

comment "Platform Glue Driver Support"

config USB_DWC3_OMAP
	tristate "Texas Instruments OMAP5 and similar Platforms"
	depends on EXTCON
	default USB_DWC3
	help
	  Some platforms from Texas Instruments like OMAP5, DRA7xxx and
	  AM437x use this IP for USB2/3 functionality.

	  Say 'Y' or 'M' here if you have one such device

config USB_DWC3_EXYNOS
	tristate "Samsung Exynos Platform"
	default USB_DWC3
	help
	  Recent Exynos5 SoCs ship with one DesignWare Core USB3 IP inside,
	  say 'Y' or 'M' if you have one such device.

config USB_DWC3_PCI
	tristate "PCIe-based Platforms"
	depends on PCI
	default USB_DWC3
	help
	  If you're using the DesignWare Core IP with a PCIe, please say
	  'Y' or 'M' here.

	  One such PCIe-based platform is Synopsys' PCIe HAPS model of
	  this IP.

config USB_DWC3_OF_SIMPLE
       tristate "Generic OF Simple Glue Layer"
       depends on OF && COMMON_CLK
       default USB_DWC3
       help
         Support USB2/3 functionality in simple SoC integrations.
	 Currently supports Xilinx and Qualcomm DWC USB3 IP.
	 Say 'Y' or 'M' if you have one such device.

config USB_DWC3_RK322XH
	tristate "Rockchip rk322xh Platform"
	depends on OF && COMMON_CLK && ARCH_ROCKCHIP
	default USB_DWC3
	help
	  Support of USB2/3 functionality in Rockchip rk322xh platform.
	  say 'Y' or 'M' if you have one such device.

comment "Debugging features"

config USB_DWC3_DEBUG
	bool "Enable Debugging Messages"
	help
	  Say Y here to enable debugging messages on DWC3 Driver.

config USB_DWC3_VERBOSE
	bool "Enable Verbose Debugging Messages"
	depends on USB_DWC3_DEBUG
	help
	  Say Y here to enable verbose debugging messages on DWC3 Driver.

endif
```

## kernel.its
```
/dts-v1/;

/ {
    description = "Chrome OS kernel image with one or more FDT blobs";
    #address-cells = <1>;
    images {
        kernel@1{
            description = "kernel";
            data = /incbin/("arch/arm/boot/zImage");
            type = "kernel_noload";
            arch = "arm";
            os = "linux";
            compression = "none";
            load = <0>;
            entry = <0>;
        };
        fdt@1{
            description = "rk3288-veyron-speedy.dtb";
            data = /incbin/("arch/arm/boot/dts/rk3288-veyron-speedy.dtb");
            type = "flat_dt";
            arch = "arm";
            compression = "none";
            hash@1{
                algo = "sha1";
            };
        };
    };
    configurations {
        default = "conf@1";
        conf@1{
            kernel = "kernel@1";
            fdt = "fdt@1";
        };
    };
};
```

## security/chromiumos/Kconfig
```kconfig
config SECURITY_CHROMIUMOS
	tristate "Chromium OS Security Module"
	depends on SECURITY
	help
	  The purpose of the Chromium OS security module is to reduce attacking
	  surface by preventing access to general purpose access modes not
	  required by Chromium OS. Currently: the mount operation is
	  restricted by requiring a mount point path without symbolic links,
	  and loading modules is limited to only the root filesystem.
```

## sound/soc/qcom/Kconfig
```kconfig
config SND_SOC_QCOM
	tristate "SoC Audio support for QCOM platforms"
	help
          Support for audio in Qualcomm Technologies SOC-based systems.
          Say Y if you want to use audio devices such as I2S, PCM,
          S/PDIF, etc.

config SND_SOC_LPASS_CPU
	tristate
	depends on SND_SOC_QCOM

config SND_SOC_IPQ806X
	tristate "SoC Audio support for IPQ806x based platforms"
	depends on SND_SOC_QCOM || ARCH_QCOM || COMPILE_TEST
        select SND_SIMPLE_CARD
	select SND_SOC_LPASS_CPU
	select SND_SOC_LPASS_PLATFORM
        select SND_SOC_MAX98357A
	help
          Support for Qualcomm Technologies LPASS audio block in
          IPQ806X SOC-based systems.
          Say Y if you want to use audio devices such as I2S, PCM,
          S/PDIF, etc.

config SND_SOC_LPASS_PLATFORM
	tristate
	depends on SND_SOC_QCOM
```

## sound/soc/rockchip/Kconfig
```kconfig
config SND_SOC_ROCKCHIP
	tristate "ASoC support for Rockchip"
	depends on COMPILE_TEST || ARCH_ROCKCHIP
	select SND_SOC_GENERIC_DMAENGINE_PCM
	help
	  Say Y or M if you want to add support for codecs attached to
	  the Rockchip SoCs' Audio interfaces. You will also need to
	  select the audio interfaces to support below.

config SND_SOC_ROCKCHIP_I2S
	tristate

config SND_SOC_ROCKCHIP_MAX98090
	tristate "ASoC support for Rockchip boards using a MAX98090 codec"
	depends on SND_SOC_ROCKCHIP && I2C && GPIOLIB
	select SND_SOC_ROCKCHIP_I2S
	select SND_SOC_MAX98090
	select SND_SOC_TS3A227E
	help
	  Say Y or M here if you want to add support for SoC audio on Rockchip
	  boards using the MAX98090 codec, such as Veyron.

config SND_SOC_ROCKCHIP_HDMI_AUDIO
	tristate "ASoC support for Rockchip HDMI audio"
	depends on SND_SOC_ROCKCHIP
	select SND_SOC_ROCKCHIP_I2S
	select SND_SOC_DW_HDMI_AUDIO
	help
	  Say Y or M here if you want to add support for SoC audio on Rockchip
	  HDMI, such as rk3288 hdmi.
```
