## drivers/rkflash/Kconfig
```kconfig
# SPDX-License-Identifier: GPL-2.0

if ARCH_ROCKCHIP

menuconfig RK_FLASH
	bool "Rockchip Flash Devices Support"
	select ROCKCHIP_VENDOR_STORAGE
	select ROCKCHIP_FLASH_VENDOR_STORAGE
	default n
	help
	  This enables support for Rockchip Flash Devices including Nandc Slc
	  Nand, SFC Spi Nand and SFC Spi Nor.

	  They're block interface.

	  Say Y when you have a board with one of them.

if RK_FLASH

comment "Rockchip Flash Devices"

config RK_SFTL
	bool "Rockchip Slc Nand FTL support"
	default y
	depends on (RK_NANDC_NAND || (RK_SFC_NAND && !RK_SFC_NAND_MTD))
	help
	  This enables support for Slc Nand FTL.

	  Say Y when you have a board with Slc Nand Flash register as block device.

config RK_NANDC_NAND
	bool "Rockchip NANDC Slc Nand Devices support"
	default n
	depends on RK_NAND != y
	help
	  This enables support for NANDC Slc Nand Devices.

	  It's block interface, 512Kb/sector.

	  Say Y when you have a board with Slc Nand Flash supported by Rockchip
	  Nandc controller.

config RK_SFC_NAND
	bool "Rockchip SFC Spi Nand Devices support"
	default n
	depends on RK_NAND != y
	help
	  This enables support for Rockchip SFC Spi Nand Devices.

	  It's block interface, 512Kb/sector.

	  Say Y when you have a board with Spi Nand Flash supported by Rockchip
	  Serial Flash Controller(SFC).

config RK_SFC_NAND_MTD
	bool "RK SFC NAND mtd Interface Support"
	select ROCKCHIP_MTD_VENDOR_STORAGE
	default n
	depends on RK_SFC_NAND && MTD
	help
	  Enable mtd interface for SFC_NAND device.

	  Say Y when you wanna use mtd interface for SFC_NAND flash.

config RK_SFC_NOR
	bool "Rockchip SFC Spi Nor Devices Support"
	select CRYPTO
	select CRYPTO_LIB_ARC4
	default n
	help
	  This enables support for Rockchip SFC Spi Nor Devices.

	  It's block interface,512Kb/sector.

	  Say Y when you have a board with Spi Nor Flash supported by Rockchip
	  Serial Flash Controller(SFC).

config RK_SFC_NOR_MTD
	bool "RK SFC NOR mtd Interface Support"
	default n
	depends on RK_SFC_NOR && MTD
	help
	  Enable mtd interface for SFC_NOR device.

	  Say Y when you wanna use mtd interface for SFC_NOR flash.

config RK_SFC_NOR_MTD_PANIC_WRITE
	bool "Panic writes for RK SFC NOR MTD"
	depends on RK_SFC_NOR_MTD && ARM_ARCH_TIMER
	help
	  Add an atomic-context PIO write path for users such as mtdoops.
	  It requires an active, exclusively owned SFC v3/v4/v5 controller,
	  SPI-mode NOR and a pre-erased destination. Busy hardware is rejected;
	  in-flight transfers and erase operations are not reset or suspended.
	  QPI and the 0xeb read address mode are not supported.

	  Say N if unsure.

config RK_SFC_NOR_MTD_PANIC_TIMEOUT_MS
	int "Total NOR panic write timeout in milliseconds"
	depends on RK_SFC_NOR_MTD_PANIC_WRITE
	range 1 10000
	default 1000
	help
	  Limit the entire panic write, including status polling and readback,
	  to this budget. Check the NOR program time, record size and watchdog
	  timeout on the target board before choosing a value.

endif # RK_FLASH

endif # ARCH_ROCKCHIP
```
