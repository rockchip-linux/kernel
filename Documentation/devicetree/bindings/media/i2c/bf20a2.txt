## Documentation/devicetree/bindings/media/i2c/imx327.txt
```
* Sony IMX327 MIPI sensor

Required Properties:
- compatible: should be "sony,imx327"
- clocks: reference to the 37.125M xvclk input clock.
- clock-names: should be "xvclk".
- dovdd-supply: Digital I/O voltage supply, 1.8 volts
- avdd-supply: Analog voltage supply, 2.8 volts
- dvdd-supply: Digital core voltage supply, 1.2 volts
- reset-gpios: Low active reset gpio

The device node must contain one 'port' child node for its digital output
video port, in accordance with the video interface bindings defined in
Documentation/devicetree/bindings/media/video-interfaces.txt.

Example:
&i2c3: imx327@1a {
	compatible = "sony,imx327";
	reg = <0x1a>;
	clocks = <&cru SCLK_CIF_OUT>;
	clock-names = "xvclk";
	avdd-supply = <&vcc2v8_dvp>;
	dovdd-supply = <&vcc1v8_dvp>;
	dvdd-supply = <&vdd1v5_dvp>;
	pwdn-gpios = <&gpio0 23 GPIO_ACTIVE_HIGH>;
	pinctrl-names = "default";
	pinctrl-0 = <&cif_clkout_m0>;
	port {
		ucam_out: endpoint {
			remote-endpoint = <&mipi_in_ucam>;
			data-lanes = <1 2>;
		};
	};
};
```

## Documentation/devicetree/bindings/media/i2c/nvp6158.txt
```
* Nextchip NVP6158 AHD to BT656/BT1120 decoder

Required Properties:
- compatible: should be "nvp6158-v4l2"
- clocks: reference to the Single 27M Oscillator.
- clock-names: should be "xvclk".
- pwr-gpios: High active nvp6158 power gpio
- pwr2-gpios: High active ahd camera power gpio
- pwdn-gpios: High active nvp6158 pwdn gpio
- pwdn2-gpios: High active ahd camera pwdn gpio
- rst-gpios: High active nvp6158 reset gpio
- rst2-gpios: High active ahd camera reset gpio
Optional Properties:
- rockchip,dvp_mode: BT656 or BT1120 or BT656_TEST
- rockchip,channel_nums: channel nums, 1/2/4
- rockchip,dual_edge: dual edge, 0/1

NVP6158 device address 0x30(7bit);
The device node must contain one 'port' child node for its digital output
video port, in accordance with the video interface bindings defined in
Documentation/devicetree/bindings/media/video-interfaces.txt.

Example:

&i2c1 {
	status = "okay";

	nvp6158: nvp6158@30 {
		compatible = "nvp6158-v4l2";
		status = "okay";
		reg = <0x30>;
		clocks = <&cru CLK_CIF_OUT>;
		clock-names = "xvclk";
		power-domains = <&power RK3568_PD_VI>;
		pinctrl-names = "default";
		pinctrl-0 = <&cif_clk &cif_dvp_clk &cif_dvp_bus8 &cif_dvp_bus16>;
		pwr-gpios = <&gpio4 RK_PB2 GPIO_ACTIVE_HIGH>;
		pwr2-gpios = <&gpio4 RK_PB1 GPIO_ACTIVE_HIGH>;
		rst-gpios = <&gpio4 RK_PB5 GPIO_ACTIVE_HIGH>;
		/*rst2-gpios = <&gpio2 RK_PC5 GPIO_ACTIVE_HIGH>;*/
		/*pwdn-gpios = <&gpio4 RK_PA6 GPIO_ACTIVE_HIGH>;*/
		/*pwdn2-gpios = <&gpio4 RK_PA6 GPIO_ACTIVE_HIGH>;*/
		rockchip,camera-module-index = <0>;
		rockchip,camera-module-facing = "back";
		rockchip,camera-module-name = "default";
		rockchip,camera-module-lens-name = "default";
		rockchip,dvp_mode = "BT1120"; //BT656 or BT1120 or BT656_TEST
		rockchip,channel_nums = <4>; //channel nums, 1/2/4
		rockchip,dual_edge = <1>; // pclk dual edge, 0/1
		rockchip,default_rect= <1920 1080>; // default resolution
		port {
			nvp6158_out: endpoint {
				remote-endpoint = <&dvp_in_bcam1>;
			};
		};
	};
};
```

## Documentation/devicetree/bindings/media/i2c/nvp6324.txt
```
* Nextchip NVP6324 AHD to MIPI CSI2 decoder

Required Properties:
- compatible: should be "jaguar1-v4l2"
- clocks: reference to the Single 27M Oscillator.
- clock-names: should be "xvclk".
- pd-gpios: High active nvp6324 powerdown gpio
- pd2-gpios: High active ahd camera  powerdown gpio
- rst-gpios: High active nvp6324 reset gpio
- rst2-gpios: High active ahd camera reset gpio

Optional Properties:
- rockchip,default_rect= <1920 1080>; // default resolution

NVP6324 device address 0x30(7bit);
The device node must contain one 'port' child node for its digital output
video port, in accordance with the video interface bindings defined in
Documentation/devicetree/bindings/media/video-interfaces.txt.

Example:

&i2c4 {
	status = "okay";

	jaguar1: jaguar1@30 {
		compatible = "jaguar1-v4l2";
		status = "okay";
		reg = <0x30>;
		clocks = <&cru CLK_CAM0_OUT>;
		clock-names = "xvclk";
		power-domains = <&power RK3568_PD_VI>;
		pd-gpios = <&gpio4 RK_PB4 GPIO_ACTIVE_HIGH>;
		/*pd2-gpios = <&gpio4 RK_PB5 GPIO_ACTIVE_HIGH>;*/
		rst-gpios = <&gpio3 RK_PB6 GPIO_ACTIVE_HIGH>;
		/*rst2-gpios = <&gpio2 RK_PC5 GPIO_ACTIVE_HIGH>;*/
		rockchip,camera-module-index = <0>;
		rockchip,camera-module-facing = "back";
		rockchip,camera-module-name = "jaguar1";
		rockchip,camera-module-lens-name = "jaguar1";
		rockchip,default_rect= <1920 1080>; // default resolution
		port {
			n4_out: endpoint {
				remote-endpoint = <&mipi_in_ucam3>;
				data-lanes = <1 2 3 4>;
			};
		};
	};
};
```

## Documentation/devicetree/bindings/media/i2c/os08a10.txt
```
* Omnivision os08a10 MIPI CSI-2 sensor

Required Properties:
- compatible: should be "ovti,os08a10"
- clocks: reference to the 24M xvclk input clock.
- clock-names: should be "xvclk".
- dovdd-supply: Digital I/O voltage supply, 1.8 volts
- avdd-supply: Analog voltage supply, 2.8 volts
- dvdd-supply: Digital core voltage supply, 1.2 volts
- power-gpios : High active reset gpio
- reset-gpios: High active reset gpio
- pwdn-gpios: High active reset gpio

Attention:
os08a10 device address 0x36(7bit) or 0x10(7bit) is decided by SID pin;

The device node must contain one 'port' child node for its digital output
video port, in accordance with the video interface bindings defined in
Documentation/devicetree/bindings/media/video-interfaces.txt.

Example:
//RK356x Board
&i2c4 {
	status = "okay";

	os08a10: os08a10@36 {
		status = "okay";
		compatible = "ovti,os08a10";
		reg = <0x36>;
		clocks = <&cru CLK_CIF_OUT>;
		clock-names = "xvclk";
		power-domains = <&power RK3568_PD_VI>;
		avdd-supply = <&vcc_avdd>;
		dovdd-supply = <&vcc_dovdd>;
		dvdd-supply = <&vcc_dvdd>;
		//pinctrl-names = "rockchip,camera_default", "rockchip,camera_sleep";
		//pinctrl-0 = <&cam_clkout0>;
		//pinctrl-1 = <&cam_sleep>;
		power-gpios = <&gpio0 RK_PB6 GPIO_ACTIVE_HIGH>;
		reset-gpios = <&gpio4 RK_PB1 GPIO_ACTIVE_HIGH>;
		pwdn-gpios = <&gpio4 RK_PB7 GPIO_ACTIVE_HIGH>;
		rockchip,camera-module-index = <0>;
		rockchip,camera-module-facing = "back";
		rockchip,camera-module-name = "RS-8MTP659";
		rockchip,camera-module-lens-name = "default";
		port {
			os08a10_out: endpoint {
				remote-endpoint = <&mipi_in_ucam2>;
				data-lanes = <1 2 3 4>;
			};
		};
	};
};
```

## Documentation/devicetree/bindings/media/i2c/ov2680.txt
```
* Omnivision OV2680 MIPI CSI-2 sensor

Required Properties:
- compatible: should be "ovti,ov2680"
- clocks: reference to the 24M xvclk input clock.
- clock-names: should be "xvclk".
- dovdd-supply: Digital I/O voltage supply, 1.8 volts
- avdd-supply: Analog voltage supply, 2.8 volts
- dvdd-supply: Digital core voltage supply, 1.5 volts
- powerdown-gpios: Low active powerdown gpio

Attention:
OV2680 device address 0x6c(8bit) or 0x20(8bit) is decided by SID pin;

The device node must contain one 'port' child node for its digital output
video port, in accordance with the video interface bindings defined in
Documentation/devicetree/bindings/media/video-interfaces.txt.

Example:
	ov2680: ov2680@36 {  // or ov2680: ov2680@10
		status = "okay";
		compatible = "ovti,ov2680";
		reg = <0x36>; //or reg = <0x10>;
		clocks = <&cru SCLK_CIF_OUT>;
		clock-names = "xvclk";

		avdd-supply = <&vcc2v8_dvp>;
		dovdd-supply = <&vcc1v8_dvp>;
		dvdd-supply = <&vdd1v5_dvp>;
		pinctrl-names = "rockchip,camera_default";
		pinctrl-0 = <&cif_clkout_m0>;
		pwdn-gpios = <&gpio2 13 GPIO_ACTIVE_LOW>;
		rockchip,camera-module-index = <1>;
		rockchip,camera-module-facing = "back";
		rockchip,camera-module-name = "default";
		rockchip,camera-module-lens-name = "default";
		port {
			ucam_out: endpoint {
				remote-endpoint = <&mipi_in_ucam>;
				data-lanes = <1>;
			};
		};
	};
```

## Documentation/devicetree/bindings/media/i2c/ov5640.txt
```
* Omnivision OV5640 1/4-Inch 5Mp SOC Camera sensor

The Omnivision OV5640 is a 1/4-Inch 5Mp SOC Camera sensor,
with an active array size of 2592 x 1944.
It is programmable through a SCCB.
The OV5640 sensor supports multiple output formats,
such as RAW RGB, CCIR656, YUV422/420 and YCbCr422.
It also Support DVP/MIPI CSI-2 output interfaces.

Required Properties:
- compatible: should be "ovti,ov5640"
- clocks: reference to the 24M xvclk input clock.
- clock-names: should be "xvclk".
- dovdd-supply: Digital I/O voltage supply, 1.8/2.8 volts
- avdd-supply: Analog voltage supply, 2.8 volts
- dvdd-supply: Digital core voltage supply, 1.5 volts(embedded 1.5V regulator)
- reset-gpios: Low active reset gpio
- powerdown-gpios: Low active powerdown gpio

The device node must contain one 'port' child node for its digital output
video port, in accordance with the video interface bindings defined in
Documentation/devicetree/bindings/media/video-interfaces.txt.

Example:
&i2c2 {
	status = "okay";

	/* MIPI Interface */
	ov5640: ov5640@3c {
		status = "okay";
		compatible = "ovti,ov5640";
		reg = <0x3c>;
		clocks = <&cru SCLK_CIF_OUT>;
		clock-names = "xvclk";

		avdd-supply = <&vcc2v8_dvp>;
		dovdd-supply = <&vcc1v8_dvp>;
		//dvdd-supply = <&vdd1v5_dvp>;
		pinctrl-names = "rockchip,camera_default";
		pinctrl-0 = <&cif_clkout>;
		//reset-gpios = <&gpio2 5 GPIO_ACTIVE_HIGH>;
		pwdn-gpios = <&gpio2 13 GPIO_ACTIVE_HIGH>;
		power-gpios = <&gpio0 8 GPIO_ACTIVE_HIGH>;
		rockchip,camera-module-index = <0>;
		rockchip,camera-module-facing = "back";
		rockchip,camera-module-name = "CameraKing";
		rockchip,camera-module-lens-name = "CHT-842B-MD";
		port {
			ucam_out: endpoint {
				remote-endpoint = <&mipi_in_ucam>;
				data-lanes = <1 2>;
			};
		};
	};

	/* DVP Interface 10-bit parallel */
	ov5640: ov5640@3c {
		status = "okay";
		compatible = "ovti,ov5640";
		reg = <0x3c>;
		clocks = <&cru SCLK_VIP_OUT>;
		clock-names = "xvclk";

		avdd-supply = <&vcc2v8_dvp>;
		dovdd-supply = <&vcc1v8_dvp>;
		//dvdd-supply = <&vdd1v5_dvp>;
		pinctrl-names = "default";
		pinctrl-0 = <&isp_dvp_d2d9 &isp_dvp_d10d11 &cif_clkout>;
		pwdn-gpios = <&gpio1 RK_PB5 GPIO_ACTIVE_HIGH>;
		power-gpio = <&gpio3 RK_PB2 GPIO_ACTIVE_HIGH>;
		rockchip,camera-module-index = <0>;
		rockchip,camera-module-facing = "back";
		rockchip,camera-module-name = "CameraKing";
		rockchip,camera-module-lens-name = "Largan";
		port {
			ov5640_out: endpoint {
				remote-endpoint = <&dvp_in_bcam>;
			};
		};
	};
};
```

## Documentation/devicetree/bindings/media/i2c/ov5648.txt
```
* Omnivision ov5648 MIPI CSI-2 sensor

Required Properties:
- compatible: should be "ovti,ov5648"
- clocks: reference to the 24M xvclk input clock.
- clock-names: should be "xvclk".
- dovdd-supply: Digital I/O voltage supply, 1.8 volts
- avdd-supply: Analog voltage supply, 2.8 volts
- dvdd-supply: Digital core voltage supply, 1.5 volts
- reset-gpios: Low active reset gpio
- powerdown-gpios: Low active powerdown gpio

The device node must contain one 'port' child node for its digital output
video port, in accordance with the video interface bindings defined in
Documentation/devicetree/bindings/media/video-interfaces.txt.

Example:
&i2c2 {
	status = "okay";

	ov5648: ov5648@36 {
		status = "okay";
		compatible = "ovti,ov5648";
		reg = <0x36>;
		clocks = <&cru SCLK_CIF_OUT>;
		clock-names = "xvclk";

		avdd-supply = <&vcc2v8_dvp>;
		dovdd-supply = <&vcc1v8_dvp>;
		dvdd-supply = <&vdd1v5_dvp>;
		pinctrl-names = "rockchip,camera_default";
		pinctrl-0 = <&cif_clkout_m0>;
		reset-gpios = <&gpio2 5 GPIO_ACTIVE_LOW>;
		pwdn-gpios = <&gpio2 13 GPIO_ACTIVE_LOW>;
		rockchip,camera-module-index = <0>;
		rockchip,camera-module-facing = "back";
		rockchip,camera-module-name = "CameraKing";
		rockchip,camera-module-lens-name = "CHT-842B-MD";
		port {
			ucam_out: endpoint {
				remote-endpoint = <&mipi_in_ucam>;
				data-lanes = <1 2>;
			};
		};
	};
};
```

## Documentation/devicetree/bindings/media/i2c/ov5670.txt
```
* Omnivision ov5670 MIPI CSI-2 sensor

Required Properties:
- compatible: should be "ovti,ov5670"
- clocks: reference to the 24M xvclk input clock.
- clock-names: should be "xvclk".
- dovdd-supply: Digital I/O voltage supply, 1.8 volts
- avdd-supply: Analog voltage supply, 2.8 volts
- dvdd-supply: Digital core voltage supply, 1.2 volts
- reset-gpios: Low active reset gpio
- powerdown-gpios: Low active powerdown gpio

Attention:
OV5670 device address 0x6c(8bit) or 0x20(8bit) is decided by SID pin;

The device node must contain one 'port' child node for its digital output
video port, in accordance with the video interface bindings defined in
Documentation/devicetree/bindings/media/video-interfaces.txt.

Example:
&i2c2 {
	status = "okay";

	ov5670: ov5670@36 { // or ov5670: ov5670@10
		status = "okay";
		compatible = "ovti,ov5670";
		reg = <0x36>; //or reg = <0x10>;
		clocks = <&cru SCLK_CIF_OUT>;
		clock-names = "xvclk";

		avdd-supply = <&vcc2v8_dvp>;
		dovdd-supply = <&vcc1v8_dvp>;
		dvdd-supply = <&vdd1v2_dvp>;
		pinctrl-names = "default";
		pinctrl-0 = <&cif_clkout>;
		reset-gpios = <&gpio2 5 GPIO_ACTIVE_HIGH>;
		pwdn-gpios = <&gpio2 13 GPIO_ACTIVE_HIGH>;
		rockchip,camera-module-index = <0>;
		rockchip,camera-module-facing = "back";
		rockchip,camera-module-name = "CameraKing";
		rockchip,camera-module-lens-name = "CHT-842B-MD";
		port {
			ucam_out: endpoint {
				remote-endpoint = <&mipi_in_ucam>;
				data-lanes = <1 2>;
			};
		};
	};
};
```

## Documentation/devicetree/bindings/media/i2c/sp250a.txt
```
* Superpix SP250A MIPI CSI-2 sensor

Required Properties:
- compatible: should be "superpix,sp250a".
- clocks: reference to the 24M xvclk input clock.
- clock-names: should be "xvclk".
- power-domains: should be "power RK3568_PD_VI" for RK356x.
- dovdd-supply: Digital I/O voltage supply, 1.8/2.8 volts
- avdd-supply: Analog voltage supply, 2.8 volts
- reset-gpios: High active reset gpio
- pwdn-gpios: High active power-down gpio

The device node must contain one 'port' child node for its digital output
video port, and this port must have a single endpoint in accordance with
 the video interface bindings defined in
Documentation/devicetree/bindings/media/video-interfaces.txt.

Endpoint node required properties for CSI-2 connection are:
- remote-endpoint: a phandle to the bus receiver's endpoint node.
- data-lanes: should be set to <1> (one CSI-2 lane supported).

Example:

&i2c2 {
	status = "okay";

	sp250a: sp250a@3c {
		compatible = "superpix,sp250a";
		status = "okay";
		reg = <0x3c>;
		clocks = <&cru CLK_CIF_OUT>;
		clock-names = "xvclk";
		power-domains = <&power RK3568_PD_VI>;
		avdd-supply = <&vcc2v8_dvp>;
		dovdd-supply = <&vcc1v8_dvp>;
		reset-gpios = <&gpio4 RK_PB0 GPIO_ACTIVE_HIGH>;
		pwdn-gpios = <&gpio4 RK_PB3 GPIO_ACTIVE_HIGH>;
		rockchip,camera-module-index = <1>;
		rockchip,camera-module-facing = "front";
		rockchip,camera-module-name = "LM50A60-S107-YK-XJL-V2";
		rockchip,camera-module-lens-name = "default";
		port {
			sp250a_out: endpoint {
				remote-endpoint = <&mipi_in_ucam2>;
				data-lanes = <1>;
			};
		};
	};
};
```
