## Documentation/devicetree/bindings/media/i2c/bf20a2.txt
```
* BF20A2 1/10-Inch 0.3Mp SOC Camera

The BYD BF20A2 is a 1/10-inch SOC camera, with an active array size of
640H x 480V. It is programmable through a SCCB. The BF20A2 sensor supports
SVGA. It also can support YUV422 or raw RGB output formats.

Required Properties:
- compatible: Must be "byd,bf20a2"
- reg: I2C slave address
- clocks: reference to the xvclk input clock.
- clock-names: should be "xvclk".
- dovdd-supply: Digital I/O voltage supply, 1.7~3.1 volts
- avdd-supply: Analog voltage supply, 2.8 volts
- powerdown-gpios: High active powerdown gpio

The device node must contain one 'port' child node for its digital output
video port, in accordance with the video interface bindings defined in
Documentation/devicetree/bindings/media/video-interfaces.txt.

Example:
&i2c2 {
	status = "okay";

	bf20a2: bf20a2@6e {
		status = "okay";
		compatible = "byd,bf20a2";
		reg = <0x6e>;
		clocks = <&cru SCLK_CIF_OUT>;
		clock-names = "xvclk";

		avdd-supply = <&vcc2v8_dvp>;
		dovdd-supply = <&vcc2v8_dvp>;
		pinctrl-names = "default";
		pinctrl-0 = <&cif_clkout_m0>;
		pwdn-gpios = <&gpio2 13 GPIO_ACTIVE_HIGH>;
		rockchip,camera-module-index = <0>;
		rockchip,camera-module-facing = "back";
		rockchip,camera-module-name = "default";
		rockchip,camera-module-lens-name = "default";

		port {
			bf20a2_out: endpoint {
				remote-endpoint = <&dvp_in_bcam>;
			};
		};
	};
};
```

## Documentation/devicetree/bindings/media/i2c/bf3925.txt
```
* BF3925 1/5-Inch 2Mp SOC Camera

The BYD BF3925 is a 1/5-inch SOC camera, with an active array size of
1616H x 1216V. It is programmable through a SCCB. The BF3925 sensor supports
multiple resolutions output, such as UXGA, SVGA. It also can support
YUV422 or raw RGB output formats.

Required Properties:
- compatible: Must be "byd,bf3925"
- reg: I2C slave address
- clocks: reference to the xvclk input clock.
- clock-names: should be "xvclk".
- dovdd-supply: Digital I/O voltage supply, 1.7~3.1 volts
- avdd-supply: Analog voltage supply, 2.8 volts
- dvdd-supply: Digital core voltage supply, 1.8 volts
- reset-gpios: Low active reset gpio
- powerdown-gpios: HIGH active powerdown gpio

The device node must contain one 'port' child node for its digital output
video port, in accordance with the video interface bindings defined in
Documentation/devicetree/bindings/media/video-interfaces.txt.

Example:
&i2c2 {
	status = "okay";

	bf3925: bf3925@6e {
		status = "okay";
		compatible = "byd,bf3925";
		reg = <0x6e>;
		clocks = <&cru SCLK_CIF_OUT>;
		clock-names = "xvclk";

		avdd-supply = <&vcc2v8_dvp>;
		dovdd-supply = <&vcc1v8_dvp>;
		dvdd-supply = <&vdd1v8_dvp>;
		pinctrl-names = "default";
		pinctrl-0 = <&cif_clkout_m0>;
		reset-gpios = <&gpio2 5 GPIO_ACTIVE_LOW>;
		pwdn-gpios = <&gpio2 13 GPIO_ACTIVE_HIGH>;
		rockchip,camera-module-index = <0>;
		rockchip,camera-module-facing = "back";
		rockchip,camera-module-name = "default";
		rockchip,camera-module-lens-name = "default";

		port {
			bf3925_out: endpoint {
				remote-endpoint = <&dvp_in_bcam>;
			};
		};
	};
};
```

## Documentation/devicetree/bindings/media/i2c/gc2053.txt
```
* GalaxyCore GC2053 MIPI sensor

Required Properties:
- compatible: should be "galaxycore,gc2053"
- clocks: reference to the 24M xvclk input clock.
- clock-names: should be "xvclk".
- dovdd-supply: Digital I/O voltage supply, 1.8 volts
- avdd-supply: Analog voltage supply, 2.8 volts
- dvdd-supply: Digital core voltage supply, 1.2 volts
- reset-gpios: Low active reset gpio
- pwdn-gpios: Low active power down gpio

The device node must contain one 'port' child node for its digital output
video port, in accordance with the video interface bindings defined in
Documentation/devicetree/bindings/media/video-interfaces.txt.

Example:
//rk3399pro evb board
&i2c1 {
	status = "okay";
	gc2053: gc2053@37 {
		compatible = "galaxycore,gc2053";
		status = "okay";
		reg = <0x37>;
		clocks = <&cru SCLK_CIF_OUT>;
		clock-names = "xvclk";

		//conflict with csi-ctl-gpios
		reset-gpios = <&gpio4 26 GPIO_ACTIVE_HIGH>;
		pwdn-gpios = <&gpio4 25 GPIO_ACTIVE_HIGH>;
		pinctrl-names = "rockchip,camera_default";
		pinctrl-0 = <&cif_clkout>;
		rockchip,camera-module-index = <0>;
		rockchip,camera-module-facing = "back";
		rockchip,camera-module-name = "default";
		rockchip,camera-module-lens-name = "default";
		port {
			ucam_out0: endpoint {
				remote-endpoint = <&mipi_in_ucam0>;
				data-lanes = <1>;
			};
		};
	};
};
```

## Documentation/devicetree/bindings/media/i2c/gc2385.txt
```
* GalaxyCore GC2385 MIPI sensor

Required Properties:
- compatible: should be "galaxycore,gc2385"
- clocks: reference to the 24M xvclk input clock.
- clock-names: should be "xvclk".
- dovdd-supply: Digital I/O voltage supply, 1.8 volts
- avdd-supply: Analog voltage supply, 2.8 volts
- dvdd-supply: Digital core voltage supply, 1.2 volts
- reset-gpios: Low active reset gpio

The device node must contain one 'port' child node for its digital output
video port, in accordance with the video interface bindings defined in
Documentation/devicetree/bindings/media/video-interfaces.txt.

Example:
//rk3399 evb board
&i2c1 {
	status = "okay";
	gc2385: gc2385@37 {
		compatible = "galaxycore,gc2385";
		status = "okay";
		reg = <0x37>;
		clocks = <&cru SCLK_CIF_OUT>;
		clock-names = "xvclk";

		//reset pin control by hardware,used this pin switch to mipi input
		//1->mipi input, 0->hdmi in
		reset-gpios = <&gpio2 10 GPIO_ACTIVE_LOW>;
		pwdn-gpios = <&gpio1 4 GPIO_ACTIVE_LOW>;
		pinctrl-names = "rockchip,camera_default";
		pinctrl-0 = <&cif_clkout>;
		rockchip,camera-module-index = <0>;
		rockchip,camera-module-facing = "back";
		rockchip,camera-module-name = "RK-CMK-2M-2-v1";
		rockchip,camera-module-lens-name = "TL0534-2";
		port {
			ucam_out0: endpoint {
				remote-endpoint = <&mipi_in_ucam0>;
				data-lanes = <1>;
			};
		};
	};
};
```

## Documentation/devicetree/bindings/media/i2c/gc5035.txt
```
* GalaxyCore GC5035 MIPI sensor

Required Properties:
- compatible: should be "galaxycore,gc5035"
- clocks: reference to the 24M xvclk input clock.
- clock-names: should be "xvclk".
- dovdd-supply: Digital I/O voltage supply, 1.7~3.0 volts
- avdd-supply: Analog voltage supply, 2.8 volts
- dvdd-supply: Digital core voltage supply, 1.2 volts
- reset-gpios: Low active reset gpio
- powerdown-gpios: Low active powerdown gpio

Attention:
GC5035 device address 0x6e(8bit) or 0x7e(8bit) is decided by IDSEL pin;

The device node must contain one 'port' child node for its digital output
video port, in accordance with the video interface bindings defined in
Documentation/devicetree/bindings/media/video-interfaces.txt.

Example:

&i2c1 {
	status = "okay";
	gc5035: gc5035@37 { // or gc5035: gc5035@3f
		status = "okay";
		compatible = "galaxycore,gc5035";
		reg = <0x37>; //or reg = <0x3f>;
		clocks = <&cru SCLK_CIF_OUT>;
		clock-names = "xvclk";

		avdd-supply = <&vcc2v8_dvp>;
		dovdd-supply = <&vcc1v8_dvp>;
		dvdd-supply = <&vdd1v2_dvp>;
		pwdn-gpios = <&gpio2 RK_PD4 GPIO_ACTIVE_HIGH>;
		pinctrl-names = "rockchip,camera_default";
		pinctrl-0 = <&cif_clkout>;

		rockchip,camera-module-index = <1>;
		rockchip,camera-module-facing = "front";
		rockchip,camera-module-name = "CQ95-HL106F-5035_V1";
		rockchip,camera-module-lens-name = "HTT-M503B-70";
		lens-focus = <&dw9714f>;
		port {
			ucam_out1: endpoint {
				//remote-endpoint = <&mipi_in_ucam0>;
				remote-endpoint = <&mipi_in_ucam1>;
				data-lanes = <1 2>;
			};
		};
	};
};
```

## Documentation/devicetree/bindings/media/i2c/hi556.txt
```
* Hynix hi556 MIPI CSI-2 sensor

Required Properties:
- compatible: should be "hynix,hi556"
- clocks: reference to the 24M xvclk input clock.
- clock-names: should be "xvclk".
- dovdd-supply: Digital I/O voltage supply, 1.8 or 2.8 volts
- avdd-supply: Analog voltage supply, 2.8 volts
- dvdd-supply: Digital core voltage supply, 1.2 volts
- power-gpios : High active reset gpio
- reset-gpios: High active reset gpio
- pwdn-gpios: High active reset gpio
Optional Properties:
- flash-leds : attached led node
- lens-focus : attached vcm for focus

Attention:
hi556 device address 0x20(7bit) or 0x28(7bit) is decided by I2C_ID_SEL pin;

The device node must contain one 'port' child node for its digital output
video port, in accordance with the video interface bindings defined in
Documentation/devicetree/bindings/media/video-interfaces.txt.

Example:
//RK356x Board
&i2c4 {
	status = "okay";

	hi556: hi556@20 {
		status = "okay";
		compatible = "hynix,hi556";
		reg = <0x20>;
		clocks = <&cru CLK_CIF_OUT>;
		clock-names = "xvclk";
		power-domains = <&power RK3568_PD_VI>;
		pinctrl-names = "default";
		pinctrl-0 = <&cam_clkout0>;
		power-gpios = <&gpio0 RK_PC1 GPIO_ACTIVE_HIGH>;
		reset-gpios = <&gpio4 RK_PA7 GPIO_ACTIVE_HIGH>;
		pwdn-gpios = <&gpio4 RK_PB2 GPIO_ACTIVE_HIGH>;
		rockchip,camera-module-index = <0>;
		rockchip,camera-module-facing = "back";
		rockchip,camera-module-name = "KYT-8607-V1.0";
		rockchip,camera-module-lens-name = "default";
		flash-leds = <&flash_rgb13h>;
		lens-focus = <&dw9714>;
		port {
			hi556_out: endpoint {
				remote-endpoint = <&mipi_in_hi556>;
				data-lanes = <1 2>;
			};
		};
	};
};
```

## Documentation/devicetree/bindings/media/i2c/hi846.txt
```
* Hynix hi846 MIPI CSI-2 sensor

Required Properties:
- compatible: should be "hynix,hi846"
- clocks: reference to the 24M xvclk input clock.
- clock-names: should be "xvclk".
- dovdd-supply: Digital I/O voltage supply, 1.8 or 2.8 volts
- avdd-supply: Analog voltage supply, 2.8 volts
- dvdd-supply: Digital core voltage supply, 1.2 volts
- power-gpios : High active reset gpio
- reset-gpios: High active reset gpio
- pwdn-gpios: High active reset gpio
Optional Properties:
- flash-leds : attached led node
- lens-focus : attached vcm for focus

Attention:
hi846 device address is decided by I2C_ID_SEL0 & I2C_ID_SEL1 pins;

Slave address(@ 8bit) I2C_ID_SEL0 I2C_ID_SEL1
W : 0x40 / R : 0x41 Low(default) Low(default)
W : 0x44 / R : 0x45 Low High
W : 0x42 / R : 0x43 High Low
W : 0x46 / R : 0x47 High High

The device node must contain one 'port' child node for its digital output
video port, in accordance with the video interface bindings defined in
Documentation/devicetree/bindings/media/video-interfaces.txt.

Example:
//RK356x Board
&i2c2 {
	status = "okay";

	hi846: hi846@20 {
		status = "okay";
		compatible = "hynix,hi846";
		reg = <0x20>;
		clocks = <&cru CLK_CIF_OUT>;
		clock-names = "xvclk";
		power-domains = <&power RK3568_PD_VI>;
		pinctrl-names = "default";
		pinctrl-0 = <&cam_clkout0>;
		power-gpios = <&gpio0 RK_PC1 GPIO_ACTIVE_HIGH>;
		reset-gpios = <&gpio4 RK_PA7 GPIO_ACTIVE_HIGH>;
		pwdn-gpios = <&gpio4 RK_PB2 GPIO_ACTIVE_HIGH>;
		rockchip,camera-module-index = <0>;
		rockchip,camera-module-facing = "back";
		rockchip,camera-module-name = "KYT-8648-V1.0";
		rockchip,camera-module-lens-name = "default";
		flash-leds = <&flash_rgb13h>;
		lens-focus = <&dw9714>;
		port {
			hi846_out: endpoint {
				remote-endpoint = <&mipi_in_hi846>;
				data-lanes = <1 2>;
				//or data-lanes = <1 2 3 4>;
			};
		};
	};
};
```

## Documentation/devicetree/bindings/media/i2c/imx214.txt
```
* Sony IMX214 MIPI sensor

Required Properties:
- compatible: should be "sony,imx214"
- clocks: reference to the 24M xvclk input clock.
- clock-names: should be "xvclk".
- dovdd-supply: Digital I/O voltage supply, 1.8 volts
- avdd-supply: Analog voltage supply, 2.8 volts
- dvdd-supply: Digital core voltage supply, 1.0 volts
- reset-gpios: Low active reset gpio

The device node must contain one 'port' child node for its digital output
video port, in accordance with the video interface bindings defined in
Documentation/devicetree/bindings/media/video-interfaces.txt.

Example:
//rk3399 evb board
&i2c1 {
	status = "okay";
	imx214_eeprom: imx214_eeprom@0x50 {
		compatible = "sony,imx214_eeprom";
		status = "okay";
		reg = <0x50>;
	};
	imx214: imx214@10 {
		eeprom-ctrl = <&imx214_eeprom>;
		compatible = "sony,imx214";
		status = "okay";
		reg = <0x10>;
		clocks = <&cru SCLK_CIF_OUT>;
		clock-names = "xvclk";
		/* avdd-supply = <>; */
		/* dvdd-supply = <>; */
		/* dovdd-supply = <>; */
		/* pwdn-gpios = <>; */
		reset-gpios = <&gpio2 13 GPIO_ACTIVE_LOW>;
		pinctrl-names = "rockchip,camera_default";
		pinctrl-0 = <&cif_clkout>;
		rockchip,camera-module-index = <0>;
		rockchip,camera-module-facing = "back";
		rockchip,camera-module-name = "YG9626-S600Y7-C";
		rockchip,camera-module-lens-name = "LG-50013A7";
		port {
			ucam_out1: endpoint {
				remote-endpoint = <&mipi_in_ucam0>;
				data-lanes = <1 2>;
			};
		};
	};
};
```

## Documentation/devicetree/bindings/media/i2c/imx258.txt
```
* Sony IMX258 MIPI sensor

Required Properties:
- compatible: should be "sony,imx258"
- clocks: reference to the 24M xvclk input clock.
- clock-names: should be "xvclk".
- dovdd-supply: Digital I/O voltage supply, 1.8 volts
- avdd-supply: Analog voltage supply, 2.8 volts
- dvdd-supply: Digital core voltage supply, 1.2 volts
- reset-gpios: Low active reset gpio

The device node must contain one 'port' child node for its digital output
video port, in accordance with the video interface bindings defined in
Documentation/devicetree/bindings/media/video-interfaces.txt.

Example:
//rk3399 evb board
&i2c1 {
	status = "okay";
	imx258_eeprom: imx258_eeprom@0x50 {
		compatible = "sony,imx258_eeprom";
		status = "okay";
		reg = <0x50>;
	};
	imx258: imx258@10 {
		eeprom-ctrl = <&imx258_eeprom>;
		compatible = "sony,imx258";
		status = "okay";
		reg = <0x10>;
		clocks = <&cru SCLK_CIF_OUT>;
		clock-names = "xvclk";
		//reset pin control by hardware,used this pin switch to mipi input
		//1->mipi input, 0->hdmi in
		reset-gpios = <&gpio2 10 GPIO_ACTIVE_LOW>;
		pinctrl-names = "rockchip,camera_default";
		pinctrl-0 = <&cif_clkout>;
		rockchip,camera-module-index = <0>;
		rockchip,camera-module-facing = "back";
        	rockchip,camera-module-name = "RK-GZ-13M-1-v1";
		rockchip,camera-module-lens-name = "LG500627G";
		port {
			ucam_out0: endpoint {
				remote-endpoint = <&mipi_in_ucam0>;
				data-lanes = <1 2 3 4>;
			};
		};
	};
};
```

## Documentation/devicetree/bindings/media/i2c/imx307.txt
```
* Sony IMX307 MIPI sensor

Required Properties:
- compatible: should be "sony,imx307"
- clocks: reference to the 37.125M xvclk input clock.
- clock-names: should be "xvclk".
- dovdd-supply: Digital I/O voltage supply, 1.8 volts
- avdd-supply: Analog voltage supply, 2.8 volts
- dvdd-supply: Digital core voltage supply, 1.2 volts
- reset-gpios: Low active reset gpio

The device node must contain one 'port' child node for its digital output
video port, in accordance with the video interface bindings defined in
Documentation/devicetree/bindings/media/video-interfaces.txt.

Example:
imx307: imx307@1a {
	compatible = "sony,imx307";
	status = "okay";
	reg = <0x1a>;
	clocks = <&cru SCLK_CIF_OUT>;
	clock-names = "xvclk";

	//conflict with csi-ctl-gpios
	reset-gpios = <&gpio4 26 GPIO_ACTIVE_LOW>;
	pinctrl-names = "rockchip,camera_default";
	pinctrl-0 = <&cif_clkout>;
	rockchip,camera-module-index = <0>;
	rockchip,camera-module-facing = "back";
	rockchip,camera-module-name = "CMK-OT0837-PT2";
	rockchip,camera-module-lens-name = "YT-2929";
	port {
		ucam_out0: endpoint {
			remote-endpoint = <&mipi_in_ucam0>;
			data-lanes = <1 2>;
		};
	};
};
```
