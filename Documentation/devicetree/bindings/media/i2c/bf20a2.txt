## Documentation/devicetree/bindings/media/i2c/techpoint.txt
```
* techpoint,tpxxxx Decoder

Required Properties:
- compatible: should be "techpoint,tpxxxx"
- clocks: reference to the 27M xvclk input clock.
- clock-names: should be "xvclk".
- dovdd-supply: Digital I/O voltage supply, 1.8 volts
- avdd-supply: Analog voltage supply, 3.3 volts
- dvdd-supply: Digital core voltage supply, 1.2 volts
- reset-gpios: Low active reset gpio
- pwdn-gpios: High active power-down gpio

Attention:
techpoint device address (7bit)
techpoint + evb reuse the power bus

Example:
&i2c1 {
	status = "okay";

	// BT1120
	tp9930: tp9930@45 {
		compatible = "techpoint,tp9930";
		reg = <0x45>;
		clocks = <&cru CLK_MIPICSI_OUT>;
		clock-names = "xvclk";
		avdd-supply = <&vcc_avdd>;
		dovdd-supply = <&vcc_dovdd>;
		dvdd-supply = <&vcc_dvdd>;
		power-domains = <&power RV1126_PD_VI>;
		pinctrl-names = "rockchip,camera_default";
		pinctrl-0 = <&mipicsi_clk0 &cifm0_bt1120_ctl>;
		rockchip,grf = <&grf>;
		reset-gpios = <&gpio3 RK_PC4 GPIO_ACTIVE_LOW>;
		power-gpios = <&gpio2 RK_PA2 GPIO_ACTIVE_HIGH>;
		rockchip,camera-module-index = <0>;
		rockchip,camera-module-facing = "back";
		rockchip,camera-module-name = "default";
		rockchip,camera-module-lens-name = "default";
		port {
			cam_para_out1: endpoint {
				remote-endpoint = <&cif_para_in>;
				bus-width = <16>;
				pclk-sample = <1>;
			};
		};
	};

	// MIPI
	tp2855: tp2855@44 {
		compatible = "techpoint,tp2855";
		reg = <0x44>;
		clocks = <&cru CLK_MIPICSI_OUT>;
		clock-names = "xvclk";
		avdd-supply = <&vcc_avdd>;
		dovdd-supply = <&vcc_dovdd>;
		dvdd-supply = <&vcc_dvdd>;
		power-domains = <&power RV1126_PD_VI>;
		pinctrl-names = "rockchip,camera_default";
		pinctrl-0 = <&mipicsi_clk0>;
		reset-gpios = <&gpio3 RK_PC4 GPIO_ACTIVE_LOW>;
		power-gpios = <&gpio2 RK_PA2 GPIO_ACTIVE_HIGH>;
		rockchip,camera-module-index = <1>;
		rockchip,camera-module-facing = "front";
		rockchip,camera-module-name = "tp2855";
		rockchip,camera-module-lens-name = "tp2855";

		port {
			ucam_out0: endpoint {
				remote-endpoint = <&mipi_in_ucam0>;
				data-lanes = <1 2 3 4>;
			};
		};
	};
};
```

## Documentation/devicetree/bindings/media/i2c/xc7080-xc530.txt
```
* Xchip external isp xc7080 connect xc530 MIPI CSI-2 sensor

Required Properties:
- compatible: xc7080 should be "xchip,xc7080", xc530 should be "xchip,xc7080-xc530"
- clocks: reference to the 24M xvclk input clock.
- clock-names: should be "xvclk".
- dovdd-supply: Digital I/O voltage supply, 1.8 volts
- avdd-supply: Analog voltage supply, 2.8 volts
- dvdd-supply: Digital core voltage supply, 1.2 volts

Attention:
XC7080 device i2c address 0x1b(7bit);
XC530 device i2c address 0x48(7bit);

The device node must contain one 'port' child node for its digital output
video port, in accordance with the video interface bindings defined in
Documentation/devicetree/bindings/media/video-interfaces.txt.

Example:

&i2c1 {
	status = "okay";

	clock-frequency = <100000>;

	xc7080: xc7080@1b {
		compatible = "xchip,xc7080";
		status = "okay";
		reg = <0x1b>;
		clocks = <&cru SCLK_CIF_OUT>;
		clock-names = "xvclk";

		rst-gpios = <&gpio2 23 GPIO_ACTIVE_HIGH>;
		pwd-gpios = <&gpio0 23 GPIO_ACTIVE_HIGH>;
		pinctrl-names = "default";
		pinctrl-0 = <&cif_clkout_m0>;
		rockchip,camera-module-index = <0>;
		rockchip,camera-module-facing = "back";
		rockchip,camera-module-name = "default";
		rockchip,camera-module-lens-name = "default";
		port {
			ucam_out: endpoint {
				remote-endpoint = <&mipi_in_ucam>;
				data-lanes = <1 2>;
			};
		};

	};
	xc7080_xc530: xc7080_xc530@48 {
		compatible = "xchip,xc7080-xc530";
		reg = <0x48>;
		status = "okay";
	};
};
```

## Documentation/devicetree/bindings/media/rockchip-mpp-service.txt
```
* Rockchip MPP (Media Process Platform) service

Rockchip mpp service is a common task handling service module in kernel.
mpp service proivdes two main functions:
1. serializing userspace task handling by different task handling status list.
2. providing standard task based hardware transaction flow by work queue for
   each hardware.

Because some multimedia devices in Rockchip SoCs share the resources, such
as RK312x, vpu and rkvdec share the registers and inner ram, and these devices
cannot running at the same time, therefor, a service maintain unit queue is
required.

Required properties:
  - compatible : value should be either one among the following
	(a) "rockchip,mpp_service" for a common version present in Rockchip SoCs

Optional properties:

  - reg : Physical base address of the combo IP registers and length of memory
	  mapped region.

Example:
SoC specific DT entry:

rkvenc_srv: rkvenc_srv {
	compatible = "rockchip,mpp_service";
};
```

## Documentation/devicetree/bindings/media/rockchip-rkvdec.txt
```
* Rockchip Video Decoder (RKVDEC)

Rockchip Video Decoder (RKVDEC) is the IP present in Rockchip SoCs which
supports high resolution decoding functionalities.
The RKVDEC device driver which can decode video h.264, h.265 elementary streams,
vp9 ivf to nv12 yuv data.

Required properties:
  - compatible : value should be either one among the following
	(a) "rockchip,rkvdec" for a common version present in Rockchip SoCs
	(b) "rockchip,rk322xh-rkvdec" for the rkvdec present in rk322xh SoC

  - reg : Physical base address of the IP registers and length of memory
	  mapped region.

  - interrupts : RKVENC interrupt number to the CPU.

  - clocks : RKVENC clock source.

Optional properties:

  - resets : The reset controller to reset the ip.

  - rockchip,grf : general register set, used to configure the general feature
		   in the Rockchip SoCs.

Example:
SoC specific DT entry:

rkvdec: rkvdec@ff360000 {
	compatible = "rockchip,rk322xh-rkvdec", "rockchip,rkvdec";
	rockchip,grf = <&grf>;
	iommu_enabled = <1>;
	reg = <0x0 0x36000000 0x0 0x400>;
	interrupts = <GIC_SPI 7 IRQ_TYPE_LEVEL_HIGH>;
	clocks = <&aclk_rkvdec>, <&clk_gates11 0>, <&clk_vdec_cabac>,
		<&clk_vdec_core>;
	clock-names = "aclk_vcodec", "hclk_vcodec", "clk_cabac",
		"clk_core";
	resets = <&reset RK322XH_SRST_VDEC_H>,
		<&reset RK322XH_SRST_VDEC_A>;
	reset-names = "video_h", "video_a";
	name = "rkvdec";
	status = "disabled";
};

Board specific DT entry:

rkvdec {
	status = "okay";
};
```

## Documentation/devicetree/bindings/media/rockchip-rkvenc.txt
```
* Rockchip Video Encoder (RKVENC)

Rockchip Video Encoder (RKVENC) is the IP present in Rockchip SoCs which
supports high resolution encoding functionalities.
The RKVENC device driver base on Media Process Platform (MPP) which can
encode video raw sequences to h.264 elementary streams.

Required properties:
  - compatible : value should be either one among the following
	(a) "rockchip,rkvenc" for a common version present in Rockchip SoCs
	(b) "rockchip,rv1108-rkvenc" for the rkvenc present in rv1108 SoC

  - reg : Physical base address of the IP registers and length of memory
	  mapped region.

  - interrupts : RKVENC interrupt number to the CPU.

  - clocks : RKVENC clock source.

Optional properties:

  - resets : The reset controller to reset the ip.

  - rockchip,grf : general register set, used to configure the general feature
		   in the Rockchip SoCs.

Example:
SoC specific DT entry:

rkvenc: rkvenc@28000000 {
	compatible = "rockchip,rv1108-rkvenc", "rockchip,rkvenc";
	rockchip,grf = <&grf>;
	iommu_enabled = <0>;
	reg = <0x28000000 0x400>;
	interrupts = <GIC_SPI 8 IRQ_TYPE_LEVEL_HIGH>;
	clocks = <&aclk_rkvenc_pre>, <&clk_gates19 9>,
		<&clk_venc_core>;
	clock-names = "aclk_vcodec", "hclk_vcodec", "clk_core";
	resets = <&reset RV1108_RST_RKVENC_H>,
		<&reset RV1108_RST_RKVENC_A>,
		<&reset RV1108_RST_RKVENC_CORE>;
	reset-names = "video_h", "video_a", "video_c";
	name = "rkvenc";
	status = "disabled";
};

Board specific DT entry:

rkvenc {
	status = "okay";
};
```

## Documentation/devicetree/bindings/media/rockchip-vepu.txt
```
* Rockchip Video Encode Process Unit (VEPU)

Rockchip Video Encode Process Unit (VEPU) is the IP present in Rockchip SoCs
which supports encoding functionalities.
The VEPU device driver base on Media Process Platform (MPP) which can encode
video raw sequences to h.264 elementary streams, vp8 ivf, and jpeg.

Required properties:
  - compatible : value should be either one among the following
	(a) "rockchip,vepu" for a common version present in Rockchip SoCs
	(b) "rockchip,rk322xh-vepu" for the vepu present in rk322xh SoC

  - reg : Physical base address of the IP registers and length of memory
	  mapped region.

  - interrupts : RKVENC interrupt number to the CPU.

  - clocks : RKVENC clock source.

Optional properties:

  - resets : The reset controller to reset the ip.

  - rockchip,grf : general register set, used to configure the general feature
		   in the Rockchip SoCs.

  - mode_bit : control bit in grf control register

  - mode_ctrl : control register in grf, which used to switch working ip using
		the same service.

Example:
SoC specific DT entry:

venc_srv: venc_srv {
	compatible = "rockchip,mpp_service";
};

rkvenc: rkvenc@ff34000000 {
	compatible = "rockchip,rk322xh-vepu", "rockchip,vepu";
	rockchip,grf = <&grf>;
	iommu_enabled = <1>;
	reg = <0x0 0xff340000 0x0 0x400>;
	interrupts = <GIC_SPI 97 IRQ_TYPE_LEVEL_HIGH>;
	clocks = <&aclk_rkvenc>, <&hclk_rkvenc>;
	clock-names = "aclk_vcodec", "hclk_vcodec";
	resets = <&reset RK322XH_SRST_H264_H>,
		<&reset RK322XH_SRST_H264_A>;
	reset-names = "video_h", "video_a";
	rockchip,srv = <&venc_srv>;
	mode_bit = <11>;
	mode_ctrl = <0x40c>;
	name = "vepu";
	status = "disabled";
};

Board specific DT entry:

vepu {
	status = "okay";
};
```
