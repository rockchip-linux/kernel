## Documentation/devicetree/bindings/pinctrl/nvidia,tegra124-xusb-padctl.txt
```
Device tree binding for NVIDIA Tegra XUSB pad controller
========================================================

The Tegra XUSB pad controller manages a set of lanes, each of which can be
assigned to one out of a set of different pads. Some of these pads have an
associated PHY that must be powered up before the pad can be used.

This document defines the device-specific binding for the XUSB pad controller.

Refer to pinctrl-bindings.txt in this directory for generic information about
pin controller device tree bindings and ../phy/phy-bindings.txt for details on
how to describe and reference PHYs in device trees.

Required properties:
--------------------
- compatible: should be "nvidia,tegra124-xusb-padctl"
- reg: Physical base address and length of the controller's registers.
- resets: Must contain an entry for each entry in reset-names.
  See ../reset/reset.txt for details.
- reset-names: Must include the following entries:
  - padctl
- #phy-cells: Should be 1. The specifier is the index of the PHY to reference.
  See <dt-bindings/pinctrl/pinctrl-tegra-xusb.h> for the list of valid values.
- mboxes: Must contain an entry for the XUSB mailbox channel.
  See ../mailbox/mailbox.txt for details.
- mbox-names: Must include the following entries:
  - xusb

Optional properties:
-------------------
- vbus-{0,1,2}-supply: VBUS regulator for the corresponding UTMI pad.
- vddio-hsic-supply: VDDIO regulator for the HSIC pads.
- nvidia,usb3-port-{0,1}-lane: PCIe/SATA lane to which the corresponding USB3
  port is mapped.  See <dt-bindings/pinctrl/pinctrl-tegra-xusb.h> for the list
  of valid values.

Lane muxing:
------------

Child nodes contain the pinmux configurations following the conventions from
the pinctrl-bindings.txt document. Typically a single, static configuration is
given and applied at boot time.

Each subnode describes groups of lanes along with parameters and pads that
they should be assigned to. The name of these subnodes is not important. All
subnodes should be parsed solely based on their content.

Each subnode only applies the parameters that are explicitly listed. In other
words, if a subnode that lists a function but no pin configuration parameters
implies no information about any pin configuration parameters. Similarly, a
subnode that describes only an IDDQ parameter implies no information about
what function the pins are assigned to. For this reason even seemingly boolean
values are actually tristates in this binding: unspecified, off or on.
Unspecified is represented as an absent property, and off/on are represented
as integer values 0 and 1.

Required properties:
- nvidia,lanes: An array of strings. Each string is the name of a lane.

Optional properties:
- nvidia,function: A string that is the name of the function (pad) that the
  pin or group should be assigned to. Valid values for function names are
  listed below.
- nvidia,iddq: Enables IDDQ mode of the lane. (0: no, 1: yes)
- nvidia,usb2-port-num: USB2 port (0, 1, or 2) to which the lane is mapped.
- nvidia,hsic-strobe-trim: HSIC strobe trimmer value.
- nvidia,hsic-rx-strobe-trim: HSIC RX strobe trimmer value.
- nvidia,hsic-rx-data-trim: HSIC RX data trimmer value.
- nvidia,hsic-tx-rtune-n: HSIC TX RTUNEN value.
- nvidia,hsic-tx-rtune-p: HSIC TX RTUNEP value.
- nvidia,hsic-tx-slew-n: HSIC TX SLEWN value.
- nvidia,hsic-tx-slew-p: HSIC TX SLEWP value.
- nvidia,hsic-auto-term: Enables HSIC AUTO_TERM. (0: no, 1: yes)
- nvidia,otg-hs-curr-level-offset: Offset to be applied to the pad's fused
  HS_CURR_LEVEL value.

Note that not all of these properties are valid for all lanes. Lanes can be
divided into three groups:

  - otg-0, otg-1, otg-2:

    Valid functions for this group are: "snps", "xusb", "uart", "rsvd".

    The nvidia,otg-hs-curr-level-offset property only applies.

  - ulpi-0, hsic-0, hsic-1:

    Valid functions for this group are: "snps", "xusb".

    The nvidia,hsic-* properties apply only to the pins hsic-{0,1} when
    the function is xusb.

  - pcie-0, pcie-1, pcie-2, pcie-3, pcie-4, sata-0:

    Valid functions for this group are: "pcie", "usb3", "sata", "rsvd".

    The nvidia,usb2-port-num property only applies and is required when
    the function is usb3.

Example:
========

SoC file extract:
-----------------

	padctl@0,7009f000 {
		compatible = "nvidia,tegra124-xusb-padctl";
		reg = <0x0 0x7009f000 0x0 0x1000>;
		resets = <&tegra_car 142>;
		reset-names = "padctl";
		mboxes = <&xusb_mbox>;
		mbox-names = "xusb";

		#phy-cells = <1>;
	};

Board file extract:
-------------------

	pcie-controller@0,01003000 {
		...

		phys = <&padctl 0>;
		phy-names = "pcie";

		...
	};

	...

	usb@0,70090000 {
		...

		phys = <&padctl 5>, <&padctl 6>, <&padctl 7>;
		phy-names = "utmi-1", "utmi-2", "usb3-0";

		...
	}

	...

	padctl: padctl@0,7009f000 {
		pinctrl-0 = <&padctl_default>;
		pinctrl-names = "default";

		nvidia,usb3-port-0-lane = <TEGRA_XUSB_PADCTL_PIN_PCIE_0>;
		vbus-2-supply = <&vdd_usb3_vbus>;

		padctl_default: pinmux {
			otg {
				nvidia,lanes = "otg-1", "otg-2";
				nvidia,function = "xusb";
			};

			usb3p0 {
				nvidia,lanes = "pcie-0";
				nvidia,function = "usb3";
				nvidia,iddq = <0>;
				nvidia,usb2-port-num = <2>;
			};

			pcie {
				nvidia,lanes = "pcie-2", "pcie-3",
					       "pcie-4";
				nvidia,function = "pcie";
				nvidia,iddq = <0>;
			};

			sata {
				nvidia,lanes = "sata-0";
				nvidia,function = "sata";
				nvidia,iddq = <0>;
			};
		};
	};
```

## Documentation/devicetree/bindings/pinctrl/pinctrl-rk628.txt
```
Pincontrol driver for RK628.

Please refer file <devicetree/bindings/pinctrl/pinctrl-bindings.txt>
for details of the common pinctrl bindings used by client devices,
including the meaning of the phrase "pin configuration node".

Optional Pinmux properties:
--------------------------
Following properties are required if default setting of pins are required
at boot.
- pinctrl-names: A pinctrl state named per <pinctrl-binding.txt>.
- pinctrl[0...n]: Properties to contain the phandle for pinctrl states per
		<pinctrl-binding.txt>.

The pin configurations are defined as child of the pinctrl states node. Each
sub-node have following properties:

Optional properties:
-------------------
Following are optional properties defined as pinmux DT binding document
<pinctrl-bindings.txt>. Absence of properties will leave the configuration
on default.

pins			- the list of pins that properties in the node
			  apply to (either this or "group" has to be
			  specified)
group			- the group to apply the properties to, if the driver
			  supports configuration of whole groups rather than
			  individual pins (either this or "pins" has to be
			  specified)
bias-high-impedance	- high impedance mode ("third-state", "floating")
bias-pull-up		- pull up the pin
bias-pull-down		- pull down the pin
drive-strength		- sink or source at most X mA
input-schmitt-enable	- enable schmitt-trigger mode
input-schmitt-disable	- disable schmitt-trigger mode
low-power-enable	- enable low power mode
low-power-disable	- disable low power mode
output-low		- set the pin to output mode with low level
output-high		- set the pin to output mode with high level

Example:
--------
&rk628_pinctrl: pinctrl {
	compatible = "rockchip,rk628-pinctrl";
	status = "okay";

	//for function mode
	hpd_in_pins: hpd-in {
		pins = "gpio0b0";
		function = "hpd_in";
	}

	//for gpio mode
	gvi_hpd_gpio: gvi-hpd-gpio {
		pins = "gpio3b1";
		function = "gpio";
		drive-strength = <1>;
		bias-pull-up;
		slew-rate = <1>;
		low-power-enable;
		input-schmitt-enable;
		output-high;
	};
}

backlight: backlight {
	...
	interrupt-parent = <&rk628_gpio0>;
	interrupts = <RK_PA0 IRQ_TYPE_LEVEL_LOW>;

	pinctrl-names = "default";
	pinctrl-0 = <&hpd_in_pins>,<&gvi_hpd_gpio>;

	vbus-5v-gpios = <&rk628_gpio0 RK_PA1 GPIO_ACTIVE_LOW>;
}
```

## Documentation/devicetree/bindings/power/bq2477x-charger.txt
```
bq2477x charger
~~~~~~~~~~~~~~~

Required properties :
 - compatible : should contain "ti,bq2477x".
 - monitor-mode: If exist, the driver will be in read-only mode.
 - ti,dac-ichg : Charge current that must be programmed
 - ti,dac-v : The maximum charge voltage that must be programmed
 - ti,dac-minsv : The minimum System voltage that must be programmed
 - ti,dac-iin : The input current that must be programmed
 - ti,wdt-refresh-timeout : watch dog timer that must be programmed
 - ti,charger-detect-gpio : a GPIO spec for AC adapter detection. The flag
	that determines if AC adapter presence is indicated by active low.
	Set this to GPIO_ACTIVE_LOW if active low indicates adapter is present,
	else GPIO_ACTIVE_HIGH.

Example:

	bq2477x@6a {
		compatible = "ti,bq2477x";
		reg = <0x6a>;
		ti,dac-ichg = <2240>;
		ti,dac-v = <9008>;
		ti,dac-minsv = <4608>;
		ti,dac-iin = <4992>;
		ti,wdt-refresh-timeout = <40>;
		ti,charger-detect-gpio = <&gpio TEGRA_GPIO(J, 0) GPIO_ACTIVE_LOW>;
	 };

	bq2477x@6a {
		compatible = "ti,bq2477x";
		reg = <0x6a>;
		monitor-mode;
		ti,charger-detect-gpio = <&gpio TEGRA_GPIO(J, 0) GPIO_ACTIVE_LOW>;
	 };
```

## Documentation/devicetree/bindings/serio/rockchip_ps2.txt
```
ROCKCHIP PS/2 controller

Required properties:
- compatible : should be "rockchip,ps2c".
```

## Documentation/devicetree/bindings/soc/img/img-efuse.txt
```
* Imagination Technologies Generic eFuse controller

Required properties:
- compatible: Must be "img,pistachio-efuse".
- reg: Must contain the base address and length of the eFuse registers.

Optional properties:
- clocks: Must contain an entry for each entry in clock-names.
  See ../clock/clock-bindings.txt for details.
- clock-names: Must include the following entries:
  - osc: External oscillator clock
  - sys: eFuse register interface clock

Example:
efuse: efuse@18149200 {
	compatible = "img,pistachio-efuse";
	reg = <0x18149200 0x200>;
};

Example with optional clock properties:
efuse: efuse@18149200 {
	compatible = "img,pistachio-efuse";
	reg = <0x18149200 0x200>;
	clocks = <&osc>, <&system_clk>;
	clock-names = "osc", "sys";
};
```

## Documentation/devicetree/bindings/soc/qcom/qcom,tcsr.txt
```
QCOM TCSR (Top Control and Status Register) Driver

The TCSR provides miscellaneous control functions and status registers for
Qualcomm processors.

Required properties:
- compatible: must contain "qcom,tcsr" for IPQ806x
- reg: Address range for TCSR registers

Optional properties:
- qcom,usb-ctrl-select : indicates USB port type selection.  Please reference
  dt-bindings/soc/qcom,tcsr.h for valid USB port selection values.

Example for IPQ8064:

#include <dt-bindings/soc/qcom,tcsr.h>

		tcsr: tcsr@1a400000 {
			compatible = "qcom,tcsr";
			reg = <0x1a400000 0x100>;

			qcom,usb-ctrl-select = <TCSR_USB_SELECT_USB3_DUAL>;
		};
```

## Documentation/devicetree/bindings/soc/qcom/qfprom.txt
```
QCOM QFPROM

QFPROM is basically some efuses where things like calibration data, speed bins,
etc are stored. This data is accessed by various drivers like the cpufreq,
thermal, etc.

Required properties:
- compatible: must contain "qcom,qfprom" followed by "syscon"
- reg: Address range for QFPROM
- stride : register address stride.
	1 for byte.
	2 for 2 bytes
	3 for 3 bytes
	4 for a word.

Example:
	qfprom: qfprom@00700000 {
		compatible 	= "qcom,qfprom", "syscon";
		reg		= <0x00700000 0x1000>;
		stride		= <1>;
	};

	tsens@34000 {
		compatible = "qcom,tsens-apq8064";
		reg = <0x34000 0x1000>;
		qcom,qfprom = <&qfprom 0x18 0x10>, <&qfprom 0x28 0x10>;
		qcom,qfprom-names = "calib", "backup_calib";
	};
```

## Documentation/devicetree/bindings/sound/concerto-audio.txt
```
Google Concerto audio card
==========================

This document describes device-tree bindings for audio on boards based on
the Concerto module.

Required properties:
--------------------
 - compatible: Must include "google,concerto-audio".
 - model: Must be the board model name, e.g. "Google Kennet".
 - clocks: Must contain an entry for each entry in clock-names.
   See ../clock/clock-bindings.txt for details.
 - clock-names: Must include "audio_pll" and "mclk".
 - img,cr-periph: Must contain a phandle to the Pistachio peripheral control
   syscon node.
 - img,cr-top: Must contain a phandle to the Pistachio top control syscon node.

Optional properties:
--------------------
 - routing: A list of the connections between audio components.  Each entry
   is a pair of strings, the first being the connection's sink, the second
   being the connection's source.
 - widgets: A list of off-codec widgets.  Each entry is a pair of strings,
   the first being the template name, the second being the card's widget
   name.  Recognized template names are "Microphone", "Line", "Headphone",
   and "Speaker".

Each interface (I2S in/out, S/PDIF in/out, parallel out) has it's own sub-node.
Any combination of these sub-nodes may be specified.

I2S out:
--------
The I2S out sub-node must be named "i2s-out".  A single "cpu" sub-node
is required, and a variable number of codec sub-nodes, which must be named
"codec-{0,1,2,...}", may be specified.

I2S in:
-------
The I2S in sub-node must be named "i2s-in".  A single "cpu" sub-node
is required, and a variable number of codec sub-nodes, which must be named
"codec-{0,1,2,...}", may be specified.

I2S CPU/codec sub-node required properties:
-------------------------------------------
- sound-dai: Must contain a phandle to the CPU DAI or a codec DAI.
- format: Must be set to the DAI's format.

I2S CPU/codec sub-node optional properties:
-------------------------------------------
- name: Optional name for the codec.  This will be used as the name prefix
  for the codec.
- continuous-clock: Indicates the BCLK/LRCLK are always active.
- bitclock-inversion: Indicates the BCLK should be inverted.
- frame-inversion: Indicates the LRCLK should be inverted.
- bitclock-master: Indicates the DAI is the LRCLK master.
- frame-master: Indicates the DAI is the LRCLK master.
- img,i2s-clock-loopback: Indicates that the I2S out BCLK/LRCLK should be
  looped-back internally to the I2S in DAI.  Only applicable to the I2S in
  CPU node.  Note that the I2S out block must be configured as the clock
  master.

S/PDIF out:
-----------
The S/PDIF out sub-node must be named "spdif-out".  A single "cpu" sub-node
is required.

S/PDIF in:
----------
The S/PDIF in sub-node must be named "spdif-in".  A single "cpu" sub-node
is required.

S/PDIF CPU sub-node required properties:
----------------------------------------
- sound-dai: Must contain a phandle to the CPU DAI.

Parallel out:
-------------
The parallel out sub-node must be named "parallel-out".  A single "cpu" sub-node
is required.

Parallel out CPU sub-node required properties:
----------------------------------------------
- sound-dai: Must contain a phandle to the CPU DAI.

Example:
--------
	sound {
		compatible = "google,concerto-audio";
		model = "Google Kennet";
		clocks = <&clk_core CLK_AUDIO_PLL>, <&clk_core CLK_I2S>;
		clock-names = "audio_pll", "mclk";

		img,cr-periph = <&cr_periph>;
		img,cr-top = <&cr_top>;

		i2s-out {
			cpu {
				sound-dai = <&i2s_out>;
				format = "i2s";
				bitclock-master;
				frame-master;
			};
		};

		i2s-in {
			cpu {
				sound-dai = <&i2s_in>;
				format = "i2s";
				img,i2s-clock-loopback;
			};
		};

		parallel-out {
			cpu {
				sound-dai = <&parallel_out>;
			};
		};
	};
```
