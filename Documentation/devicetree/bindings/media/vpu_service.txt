## Documentation/devicetree/bindings/sound/img,i2s-in.txt
```
Imagination Technologies I2S In Controller

Required properties:

  - compatible : Compatible list, must contain "img,i2s-in"

  - #sound-dai-cells : Must be equal to 0

  - reg : Offset and length of the register set for the device

  - clocks : Must contain an entry for each entry in clock-names
	See ../clock/clock-bindings.txt for details

  - clock-names : Must include the following entries:
	"sys"	The system clock

  - dmas: Must contain an entry for each entry in dma-names. Depending on
	the configuration, there may be one dma used for all active channels,
	one dma per I2S channel, or both a shared dma and and a dma per I2S
	channel
	See ../dma/dma.txt for details

  - dma-names: Must include one or both of the following:
	"rx"				The dma channel used to service all
					active channels
	"rxN" for N = 1..i2s-channels	Per-channel dma

  - img,i2s-channels : Number of I2S channels instantiated in the I2S in block

Optional Properties:

  - interrupts : Contains the I2S in interrupts. Depending on
	the configuration, there may be no interrupts, one interrupt,
	or an interrupt per I2S channel

  - resets: Should contain a phandle to the I2S in reset signal, if any

  - reset-names: Should contain the reset signal name "rst", if a
	reset phandle is given

Example:

i2s_in: i2s-in@18100800 {
	compatible = "img,i2s-in";
	#sound-dai-cells = <0>;
	reg = <0x18100800 0x200>;
	interrupts = <GIC_SHARED 7 IRQ_TYPE_LEVEL_HIGH>;
	dmas = <&mdc 30 0xffffffff 0>;
	dma-names = "rx";
	clocks = <&system_clk>;
	clock-names = "sys";
	img,i2s-channels = <6>;
};
```

## Documentation/devicetree/bindings/sound/img,i2s-out.txt
```
Imagination Technologies I2S Out Controller

Required properties:

  - compatible : Compatible list, must contain "img,i2s-out"

  - #sound-dai-cells : Must be equal to 0

  - reg : Offset and length of the register set for the device

  - clocks : Must contain an entry for each entry in clock-names
	See ../clock/clock-bindings.txt for details

  - clock-names : Must include the following entries:
	"sys"	The system clock
	"ref"	The reference clock

  - dmas: Must contain an entry for each entry in dma-names. Depending on
	the configuration, there may be one dma used for all active channels,
	one dma per I2S channel, or both a shared dma and and a dma per I2S
	channel
	See ../dma/dma.txt for details

  - dma-names: Must include one or both of the following:
	"tx"				The dma channel used to service all
					active channels
	"txN" for N = 1..i2s-channels	Per-channel dma

  - img,i2s-channels : Number of I2S channels instantiated in the I2S out block

Optional Properties:

  - interrupts : Contains the I2S out interrupts. Depending on
	the configuration, there may be no interrupts, one interrupt,
	or an interrupt per I2S channel

  - resets: Should contain a phandle to the I2S out reset signal, if any

  - reset-names: Should contain the reset signal name "rst", if a
	reset phandle is given

Example:

i2s_out: i2s-out@18100A00 {
	compatible = "img,i2s-out";
	#sound-dai-cells = <0>;
	reg = <0x18100A00 0x200>;
	interrupts = <GIC_SHARED 13 IRQ_TYPE_LEVEL_HIGH>;
	dmas = <&mdc 23 0xffffffff 0>;
	dma-names = "tx";
	clocks = <&system_clk>, <&clk_audio>;
	clock-names = "sys", "ref";
	img,i2s-channels = <6>;
};
```

## Documentation/devicetree/bindings/sound/img,parallel-out.txt
```
Imagination Technologies Parallel Out Controller

Required properties:

  - compatible : Compatible list, must contain "img,parallel-out".

  - #sound-dai-cells : Must be equal to 0

  - reg : Offset and length of the register set for the device.

  - interrupts : Contains the parallel out interrupt

  - dmas : Generic dma devicetree binding as described in
  Documentation/devicetree/bindings/dma/dma.txt.

  - dma-names : Includes "tx".

  - clocks : Contains an entry for each entry in clock-names.

  - clock-names : Includes the following entries:
	"sys"	The system clock
	"ref"	The reference clock

Optional Properties:

  - resets: Should contain a phandle to the parallel out reset signal, if any

  - reset-names: Should contain the reset signal name "rst", if a
	reset phandle is given

Example:

parallel_out: parallel-out@18100C00 {
	compatible = "img,parallel-out";
	#sound-dai-cells = <0>;
	reg = <0x18100C00 0x100>;
	interrupts = <GIC_SHARED 19 IRQ_TYPE_LEVEL_HIGH>;
	dmas = <&mdc 16 0xffffffff 0>;
	dma-names = "tx";
	clocks = <&system_clk>, <&clk_audio>;
	clock-names = "sys", "ref";
};
```

## Documentation/devicetree/bindings/sound/img,spdif-in.txt
```
Imagination Technologies SPDIF In Controller

Required properties:

  - compatible : Compatible list, must contain "img,spdif-in"

  - #sound-dai-cells : Must be equal to 0

  - reg : Offset and length of the register set for the device

  - interrupts : Contains the spdif in interrupt

  - dmas : Generic dma devicetree binding as described in
  Documentation/devicetree/bindings/dma/dma.txt

  - dma-names : Includes "rx"

  - clocks : Contains an entry for each entry in clock-names

  - clock-names : Includes the following entries:
	"sys"	The system clock

Optional Properties:

  - resets: Should contain a phandle to the spdif in reset signal, if any

  - reset-names: Should contain the reset signal name "rst", if a
	reset phandle is given

Example:

spdif_in: spdif-in@18100E00 {
	compatible = "img,spdif-in";
	#sound-dai-cells = <0>;
	reg = <0x18100E00 0x100>;
	interrupts = <GIC_SHARED 20 IRQ_TYPE_LEVEL_HIGH>;
	dmas = <&mdc 15 0xffffffff 0>;
	dma-names = "rx";
	clocks = <&system_clk>;
	clock-names = "sys";
};
```

## Documentation/devicetree/bindings/sound/img,spdif-out.txt
```
Imagination Technologies SPDIF Out Controller

Required properties:

  - compatible : Compatible list, must contain "img,spdif-out"

  - #sound-dai-cells : Must be equal to 0

  - reg : Offset and length of the register set for the device

  - interrupts : Contains the spdif out interrupt

  - dmas : Generic dma devicetree binding as described in
           Documentation/devicetree/bindings/dma/dma.txt

  - dma-names : Includes "tx"

  - clocks : Contains an entry for each entry in clock-names

  - clock-names : Includes the following entries:
	"sys"	The system clock
	"ref"	The reference clock

Optional Properties:

  - resets: Should contain a phandle to the spdif out reset signal, if any

  - reset-names: Should contain the reset signal name "rst", if a
	reset phandle is given

Example:

spdif_out: spdif-out@18100D00 {
	compatible = "img,spdif-out";
	#sound-dai-cells = <0>;
	reg = <0x18100D00 0x100>;
	interrupts = <GIC_SHARED 21 IRQ_TYPE_LEVEL_HIGH>;
	dmas = <&mdc 14 0xffffffff 0>;
	dma-names = "tx";
	clocks = <&system_clk>, <&clk_audio>;
	clock-names = "sys", "ref";
};
```
