## Documentation/devicetree/bindings/media/vpu_service.txt
```
* Rockchip Video Process Unit (VPU)

Rockchip Video Process Unit (VPU) is the IP present in Rockchip SoCs which
supports video decoding and encoding functionalities.
The VPU device driver can encode video raw sequences to h.264 elementary
streams, vp8 ivf and jpeg. decode variable format video streams.

Required properties:
  - compatible : value should be either one among the following
	(a) "vpu_service" for a common version present in Rockchip SoCs
	(b) "rockchip,rk322xh-vdpu" for the vpu service present in rk322xh SoC

  - reg : Physical base address of the IP registers and length of memory
	  mapped region.

  - interrupts : RKVENC interrupt number to the CPU.

  - clocks : RKVENC clock source.

Optional properties:

  - resets : The reset controller to reset the ip.

  - rockchip,grf : general register set, used to configure the general feature
		   in the Rockchip SoCs.

Example:
SoC specific DT entry:

vdpu: vpu_service@ff350000 {
	compatible = "rockchip,rk322x-vdpu", "vpu_service";
	rockchip,grf = <&grf>;
	iommu_enabled = <1>;
	reg = <0x0 0xff350000 0x0 0x400>;
	interrupts = <GIC_SPI 9 IRQ_TYPE_LEVEL_HIGH>;
	clocks = <&aclk_vpu>, <&clk_gates11 8>;
	clock-names = "aclk_vcodec", "hclk_vcodec";
	resets = <&reset RK322XH_SRST_VCODEC_H>,
		<&reset RK322XH_SRST_VCODEC_A>;
	reset-names = "video_h", "video_a";
	dev_mode = <0>;
	name = "vpu_service";
	status = "disabled";
};

Board specific DT entry:

vdpu {
	status = "okay";
};
```

## Documentation/devicetree/bindings/mfd/rk808.txt
```
RK808 Power Management Integrated Circuit

Required properties:
- compatible: "rockchip,rk808"
- reg: I2C slave address
- interrupt-parent: The parent interrupt controller.
- interrupts: the interrupt outputs of the controller.
- #clock-cells: RK808 has 2 clkout, they are always 32khz,
  the value should be 1

Optional properties:
- clock-output-names: From common clock binding to override the
  default output clock name
- rockchip,system-power-controller: Telling whether or not this pmic is controlling
  the system power.

Regulators: All the regulators of RK808 to be instantiated shall be
listed in a child node named 'regulators'. Each regulator is represented
by a child node of the 'regulators' node.

	regulator-name {
		/* standard regulator bindings here */
	};

Following regulators of the RK808 PMIC block are supported. Note that
the 'n' in regulator name, as in DCDC_REGn or LDOn, represents the DCDC or LDO
number as described in RK808 datasheet.

	- DCDC_REGn
		- valid values for n are 1 to 4.
	- LDO_REGn
		- valid values for n are 1 to 8.
	- SWITCH_REGn
		- valid values for n are 1 to 2

Standard regulator bindings are used inside regulator subnodes. Check
  Documentation/devicetree/bindings/regulator/regulator.txt
for more details

Example:
	rk808: pmic@1b {
		compatible = "rockchip,rk808";
		interrupt-parent = <&gpio0>;
		interrupts = <4 IRQ_TYPE_EDGE_FALLING>;
		pinctrl-names = "default";
		pinctrl-0 = <&pmic_int>;
		reg = <0x1b>;
		#clock-cells = <1>;
		clock-output-names = "xin32k0", "xin32k1";
		rockchip,system-power-controller;

		regulators {
			rk808_dcdc1_reg: DCDC_REG1 {
				regulator-always-on;
				regulator-boot-on;
				regulator-min-microvolt = <1200000>;
				regulator-max-microvolt = <1200000>;
				regulator-name = "vdd_arm";
			};

			rk808_dcdc2_reg: DCDC_REG2 {
				regulator-always-on;
				regulator-boot-on;
				regulator-min-microvolt = <850000>;
				regulator-max-microvolt = <1250000>;
				regulator-name = "vdd_gpu";
			};

			rk808_dcdc3_reg: DCDC_REG3 {
				regulator-always-on;
				regulator-boot-on;
				regulator-name = "vdd_ddr";
			};

			rk808_dcdc4_reg: DCDC_REG4 {
				regulator-always-on;
				regulator-boot-on;
				regulator-min-microvolt = <3300000>;
				regulator-max-microvolt = <3300000>;
				regulator-name = "vccio";
			};

			rk808_ldo1_reg: LDO_REG1 {
				regulator-always-on;
				regulator-boot-on;
				regulator-min-microvolt = <3300000>;
				regulator-max-microvolt = <3300000>;
			};

			rk808_ldo2_reg: LDO_REG2 {
				regulator-always-on;
				regulator-boot-on;
				regulator-min-microvolt = <3300000>;
				regulator-max-microvolt = <3300000>;
			};

			rk808_ldo3_reg: LDO_REG3 {
				regulator-always-on;
				regulator-boot-on;
				regulator-min-microvolt = <1000000>;
				regulator-max-microvolt = <1000000>;
				regulator-name = "LDO_REG3";
			};

			rk808_ldo4_reg: LDO_REG4 {
				regulator-always-on;
				regulator-boot-on;
				regulator-min-microvolt = <1800000>;
				regulator-max-microvolt = <1800000>;
			};

			rk808_ldo5_reg: LDO_REG5 {
				regulator-always-on;
				regulator-boot-on;
				regulator-min-microvolt = <1800000>;
				regulator-max-microvolt = <3300000>;
			};

			rk808_ldo6_reg: LDO_REG6 {
				regulator-always-on;
				regulator-boot-on;
				regulator-min-microvolt = <1000000>;
				regulator-max-microvolt = <1000000>;
			};

			rk808_ldo7_reg: LDO_REG7 {
				regulator-always-on;
				regulator-boot-on;
				regulator-min-microvolt = <1800000>;
				regulator-max-microvolt = <1800000>;
			};

			rk808_ldo8_reg: LDO_REG8 {
				regulator-always-on;
				regulator-boot-on;
				regulator-min-microvolt = <3300000>;
				regulator-max-microvolt = <3300000>;
			};

			rk808_switch1_reg: SWITCH_REG1 {
				regulator-always-on;
				regulator-boot-on;
			};

			rk808_switch2_reg: SWITCH_REG2 {
				regulator-always-on;
				regulator-boot-on;
			};
		};
	};
```

## Documentation/devicetree/bindings/mmc/nvidia,tegra20-sdhci.txt
```
* NVIDIA Tegra Secure Digital Host Controller

This controller on Tegra family SoCs provides an interface for MMC, SD,
and SDIO types of memory cards.

This file documents differences between the core properties described
by mmc.txt and the properties used by the sdhci-tegra driver.

Required properties:
- compatible : Should be "nvidia,<chip>-sdhci"
- clocks : Must contain one entry, for the module clock.
  See ../clocks/clock-bindings.txt for details.
- resets : Must contain an entry for each entry in reset-names.
  See ../reset/reset.txt for details.
- reset-names : Must include the following entries:
  - sdhci

Optional properties:
- power-gpios : Specify GPIOs for power control
- nvidia,no-runtime-suspend : No runtime PM support on the host
- nvidia,host-off-card-on : The host is powered off while the card is powered
  on during suspend
- tap-delay : initial tap delay value (for Rx at high freqs)
- trim-delay : trim delay value (for Tx at high freqs)
- ddr-trim-delay : trim delay value for DDR50
- calib-3v3-offsets : Autocal HW offset for 3v3
- calib-1v8-offsets : Autocal HW offset for 1v8
- calib-1v8-offsets-uhs-modes : Mask for UHS mode calibration.  Valid values are:
	Bit 1: SDR12
	Bit 2: SDR25
	Bit 3: SDR50
	Bit 4: DDR50
	Bit 5: SDR104
	Bit 6: HS200
- uhs-mask : disables a UHS mode when corresponding bit set to 1.  Valid values are:
	Bit 1: SDR12
	Bit 2: SDR25
	Bit 3: SDR50
	Bit 4: DDR50
	Bit 5: SDR104
	Bit 6: HS200
- ddr-clk-limit : max clock frequency in DDR mode

Example:

sdhci@c8000200 {
	compatible = "nvidia,tegra20-sdhci";
	reg = <0xc8000200 0x200>;
	interrupts = <47>;
	clocks = <&tegra_car 14>;
	resets = <&tegra_car 14>;
	reset-names = "sdhci";
	cd-gpios = <&gpio 69 0>; /* gpio PI5 */
	wp-gpios = <&gpio 57 0>; /* gpio PH1 */
	power-gpios = <&gpio 155 0>; /* gpio PT3 */
	bus-width = <8>;
	nvidia,no-runtime-suspend;
	nvidia,host-off-card-on;
};

Example 2:

sdhci@700b0600 {
	compatible = "nvidia,tegra124-sdhci", "nvidia,tegra114-sdhci";
	reg = <0x700b0600 0x200>;
	interrupts = <0 31 0x04>;
	clocks = <&tegra_car 15>;
	tap-delay = <0x4>;
	trim-delay = <0x4>;
	ddr-trim-delay = <0x4>;
	ddr-clk-limit = <51000000>;
	calib-3v3-offsets = <0x0202>;
	calib-1v8-offsets = <0x0202>;
	calib-1v8-offsets-uhs-modes = <0x28>; /* DDR50 | HS200 */
	uhs-mask = <0x00>;
};
```

## Documentation/devicetree/bindings/mtd/spi-nand.txt
```
* NAND driver for MT29F, GD5F and similar serial NAND flash chips

Required properties:
- #address-cells, #size-cells : Must be present if the device has sub-nodes
  representing partitions.
- compatible : Should be the manufacturer and the name of the chip. Bear in mind
               the DT binding is not Linux-only, but in case of Linux, see the
               "spi_nand_id_table" array in drivers/mtd/spi-nand/spi-nand-devices.c
               for the list of supported chips.
- reg : Chip-Select number
- spi-max-frequency : Maximum frequency of the SPI bus the chip can operate at

Example:

	flash: flash@0 {
		#address-cells = <1>;
		#size-cells = <1>;
		compatible = "gigadevice,gd5f";
		reg = <0>;
		spi-max-frequency = <40000000>;
	};
```

## Documentation/devicetree/bindings/net/pistachio-dwmac.txt
```
IMG Pistachio Ethernet Controller
=================================

This device is a variant of the DWMAC and inherits the properties described
in ./stmmac.txt.

Required properties:
--------------------
 - compatible: Must contain "img,pistachio-dwmac" and "snps,dwmac".
 - clocks: Must contain an entry for each entry in clock-names.
   See ../clock/clock-bindings.txt for details.
 - clock-names: Must include "stmmaceth" and "sys".

Example:
--------
ethernet@18140000 {
	compatible = "img,pistachio-dwmac";
	reg = <0x18140000 0x2000>;
	interrupts = <GIC_SHARED 50 IRQ_TYPE_LEVEL_HIGH>;
	interrupt-names = "macirq";
	clocks = <&clk_core CLK_ENET>, <&cr_periph SYS_CLK_ENET>;
	clock-names = "stmmaceth", "sys";
	phy-mode = "rmii";
};
```

## Documentation/devicetree/bindings/net/qca8337-lite.txt
```
QCA8337 is a switch product family used in home gateway. The QCA8337-lite driver
is a temporary driver done to initialize the QCA8337 hardware at init.

The following device-tree properties may be used to describe the expected
default switch configuration.

Compatible: Should contain "qca8337-lite"

Optional Properies:

- qca,vlan-portmap: one or more sets of 2 cells. Each set represent a certain
  VLAN port base group. The first cell indicates the VLAN ID, while the second
  set represents a bitmask of all the switch ports to include in this VLAN.

Example:

	qca8337-lite {
		device-type = "network";
		compatible = "qca8337-lite";
		mdiobus = <&mdio>;
		qca,vlan-portmap = <
			0x1	0x42	/* VLAN1 Ports 1/6 */
			0x2	0x5	/* VLAN2 Ports 0/2 */
		>;
	}
```

## Documentation/devicetree/bindings/net/wireless/rockchip-wlan.txt
```
* Rockchip wlan controller

Required SoC Specific Properties:

- compatible : "wlan-platdata"

Example:

wireless-wlan { {
	compatible = "wlan-platdata";

	wifi_chip_type = "rtl8723cs";
	sdio_vref = <1800>;
	WIFI,host_wake_irq = <&gpio3 GPIO_C7 GPIO_ACTIVE_HIGH>;
	WIFI,poweren_gpio  = <&gpio3 GPIO_D3 GPIO_ACTIVE_HIGH>;
};
```

## Documentation/devicetree/bindings/panel/jdi,lpm102a188a.txt
```
JDI LPM102A188A panel

Required properties for master panel:
- power-supply: regulator controlling avdd(vdd_30) line into the panel
- ddi-supply: regulator controlling vddi(vdd_18) line into the panel
- enable-gpio: gpio controlling the power_en line into the panel
- reset-gpio: gpio controlling the rstx(resx) line into the panel

Required properties for slave panel:
- master: phandle pointing to the master panel

Optional properties:
- None

Example:
	panel: panel@0 {
		compatible = "jdi,lpm102a188a";

		reg = <0 0>;

		power-supply = <&pplcd_vdd>;
		ddi-supply = <&pp1800_lcdio>;

		enable-gpio = <&gpio TEGRA_GPIO(H, 5) GPIO_ACTIVE_HIGH>;
		reset-gpio = <&gpio TEGRA_GPIO(H, 3) GPIO_ACTIVE_LOW>;
	};
```

## Documentation/devicetree/bindings/phy/phy-rockchip-inno-usb3.txt
```
ROCKCHIP USB3.0 PHY WITH INNO IP BLOCK

Required properties (phy (parent) node):
 - compatible : should be one of the listed compatibles:
	* "rockchip,rk322xh-u3phy"
 - reg : the base address of usb3phy.
 - rockchip,u3phygrf : phandle to the syscon managing the
	"usb3.0 phy general register files".
 - interrupts : specify an interrupt for each entry in interrupt-names.
 - interrupt-names : a list which shall be the following entries:
	* "linestate" : for the host/otg linestate interrupt.
 - usb30-drv : gpio control for usb3.0 vbus.

Optional properties:
 - clocks : phandle + phy specifier pair, for the input clock of phy.
 - clock-names : input clock name of phy, must be "phyclk".

Required nodes : a sub-node is required for usb3.0 or usb2.0 the phy provides.
		 The sub-node name is used to identify phy type, and shall be
		 the following entries:
	* "pipe" : usb3.0 pipe phy.
	* "utmi" : usb2.0 utmi phy.

Required properties (port (child) node):
 - reg : address and length of the register set for the port.
 - #phy-cells : must be 0. See ./phy-bindings.txt for details.

Optional properties for utmi node:
 - rockchip,odt-val-tuning : specify 45ohm ODT tuning value.

Optional properties for pipe node:
 - rockchip,refclk-25m-quirk : phy reference clock changed to 25m quirk.

Example:

usb3phy_grf: syscon@ff460000 {
	compatible = "rockchip,usb3phy-grf", "syscon";
	reg = <0x0 0xff460000 0x0 0x1000>;
};

...

u3phy: usb3-phy@ff470000 {
	compatible = "rockchip,rk322xh-u3phy";
	reg = <0x0 0xff470000 0x0 0x0>;
	rockchip,usb3grf = <&usb3phy_grf>;
	interrupts = <GIC_SPI 77 IRQ_TYPE_LEVEL_HIGH>;
	interrupt-names = "linestate";
	usb30_drv = <&gpio0 GPIO_A0 GPIO_ACTIVE_LOW>;
	#address-cells = <2>;
	#size-cells = <2>;
	ranges;

	u3phy_pipe: pipe@ff470000 {
		reg = <0x0 0xff470000 0x0 0x8000>;
		#phy-cells = <0>;
	};

	u3phy_utmi: utmi@ff478000 {
		reg = <0x0 0xff478000 0x0 0x8000>;
		#phy-cells = <0>;
	};
};
```

## Documentation/devicetree/bindings/phy/phy-rockchip-usb2.txt
```
ROCKCHIP USB2.0 PHY WITH INNO IP BLOCK

Required properties (phy grf node):
 - compatible : should be the listed compatibles:
	* "rockchip,rk322xh-usb2phy-grf"
	* "rockchip,usb2phy-grf"
	* "syscon"
	* "simple-mfd";
- reg : the base address of grf for usb-phy configuration.

Required properties (phy (parent) node):
- compatible : should be the listed compatibles:
	* "rockchip,rk322xh-usb-phy"
	* "rockchip,rk322x-usb-phy"
- #address-cells : should be 1
- #size-cells : should be 0

Required properties (port (child) node):
- #phy-cells : must be 0. See ./phy-bindings.txt for details.
- reg : the address offset of grf for usb-phy configuration.
- interrupts : specify an interrupt for each entry in interrupt-names.
- interrupt-names : a list which shall be the following entries:
	* "linestate" : for the host linestate interrupt.
Example:

usb2phy_grf: syscon@ff450000 {
	compatible = "rockchip,rk322xh-usb2phy-grf",
		     "rockchip,usb2phy-grf", "syscon", "simple-mfd";
	reg = <0x0 0xff450000 0x0 0x1000>;

	u2phy: usb2-phy@104 {
		compatible = "rockchip,rk322xh-usb-phy",
			     "rockchip,rk322x-usb-phy";
		#address-cells = <1>;
		#size-cells = <0>;
		status = "disabled";

		u2phy_host: host-port {
			#phy-cells = <0>;
			reg = <0x104>;
			interrupts =<GIC_SPI 62 IRQ_TYPE_LEVEL_HIGH> ;
			interrupt-names = "linestate";
		};
	};
};
```

## Documentation/devicetree/bindings/phy/phy-rv1108-usb2.txt
```
RV1108 USB2.0 Host(EHCI & OHCI) PHY Driver

Required properties (phy (parent) node):
 - compatible : should only be the below compatibles:
	* "rockchip,rv1108-usb2phy"
 - rockchip,grf : phandle to the syscon managing the "general register files".
 - rockchip,usbgrf : phandle to the syscon managing the "usb general register
	files".
 - interrupts : specify an interrupt for each entry in interrupt-names.
 - interrupt-names : a list which shall be the following entries:
	* "linestate" : for the host/otg linestate interrupt.
 - #clock-cells : must be 0. See ./phy-bindings.txt for details.

Optional properties:
 - clocks : phandle + phy specifier pair, for the input clock of phy.

Example:

u2phy: usb2-phy {
	compatible = "rockchip,rv1108-usb2phy";
	rockchip,grf = <&grf>;
	rockchip,usbgrf = <&usbgrf>;
	interrupts = <GIC_SPI 51 IRQ_TYPE_LEVEL_HIGH>;
	interrupt-names = "linestate";
	#phy-cells = <0>;
	status = "okay";
};
```
