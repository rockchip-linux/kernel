## Documentation/devicetree/bindings/pinctrl/img,pistachio-pinctrl.txt
```
Imagination Technologies Danube GPIO and MFIO controller

The Danube gpio-mfio module is a combined GPIO controller, (GPIO) interrupt
controller, and pinmux + pinconf device.

Required properties:

- compatible: "img,pistachio-pinctrl".

- reg: Address range of the pinctrl registers.

- interrupts : GPIO interrupts. Contains 6 interrupts.

- gpio-controller: Marks the device node as a GPIO controller.

- #gpio-cells : Should be two. The first cell is the gpio pin number and the
		second cell is used for optional parameters.

- interrupt-controller: Marks the device node as an interrupt controller.

- #interrupt-cells: Should be two. The first cell is the gpio pin number and
			the second cell is used for optional parameters.

Please refer to ../gpio/gpio.txt and ../interrupt-controller/interrupts.txt for
a general description of GPIO and interrupt bindings.

Please refer to pinctrl-bindings.txt for details of the
common pinctrl bindings used by client devices, including the meaning of the
phrase "pin configuration node".

Each pin configuration node must list the pin(s) to which it applies. The list
either comes from a "pins" property (list of pins), or a single group specified
using the "group" property.

In addition to the pins, a single mux function may be specified using the
"function" property, and/or configuration options may be presented
("img,pull","img,drive","img,slew","img,schmitt","img,forceio").

For each configuration, either a single value may be given, or an array of
cells (which must match the number of pins). In the single case, the same
configuration will be applied to every pin. In the multiple case, the settings
will be applied to the pins in the order the pins appear either in the
"pins" list or in the table below if "img,group" is used instead.

Required subnode-properties:
- pins or group
	pins - an array of cells. Each cell contains the ID of a pin.
	group - a single string containing a group name.

Optional subnode-properties:
- function - Single string that specifies the function name.
	     "group" must be present if a function is given.

- img,pull - Integer (single or array), specifies pull value
	0 - High impedance
	1 - Pull up
	2 - Pull down
	3 - Repeater

- img,drive - Integer (single or array), specifies drive strength
	0 - 2mA
	1 - 4mA
	2 - 8mA
	3 - 12mA

- img,slew - Integer (single or array), specifies slew rate
	0 - slow
	1 - fast

- img,schmitt
	0 - none
	1 - schmitt active

- img,forceio
	For each pad, there is a separate input and output connection to the pad,
	and corresponding input/output enables. When a pin is selected as gpio,
	the gpio controller typically controls these signals. When a pin is not
	selected for gpio, it is the block of hardware using the pin that
	typically controls this (which block this is depends on which mfio
	function is selected for the pin). Using img,forceio will bypass all
	other controls for this signal, and force a particular combination
	instead.

	0 - don't force input or output enable. These controls will instead by
	    controlled by either gpio, or the currently selected mfio function
	    for the pin
	1 - force input. The input enable will be forced active, and the output
	    enable forced inactive
	2 - force output. The output enable will be forced active. The input
	    enable will be controlled by either gpio, or the currently selected
	    mfio function for the pin
	3 - force loopback. The output and input enable will both be forced
	    active

The Pistachio board has 99 pins. Pins 0-89 are MFIO (Multi-Function I/O) and
can also be selected as GPIOs. Configurations ("img,pull","img,drive",
"img,slew","img,schmitt","img,forceio") can be specified for all pins.


PIN	NAME		FUNCTION		GROUP

0	mfio0		spim1_cs0		spim1_cs0
1	mfio1		spim1_cs1		spim1_cs1
			spim0_cs1		spim0_cs1
			uart1_cts_rts		uart1_cts_rts
2	mfio2		spim1_cs2		spim1_cs2
			spim0_cs0		spim0_cs0
			uart1_cts_rts		uart1_cts_rts
3	mfio3		spim1			spim1
4	mfio4		spim1			spim1
5	mfio5		spim1			spim1
6	mfio6		spim1_quad		spim1_quad
7	mfio7		spim1_quad		spim1_quad
8	mfio8		spim0			spim0
9	mfio9		spim0			spim0
10	mfio10		spim0			spim0
11	mfio11		spis0			spis0
12	mfio12		spis0			spis0
13	mfio13		spis0			spis0
14	mfio14		spis0			spis0
15	mfio15		sdhost			sdhost
			mips_trace_clk		mips_trace_clk_0
			mips_trace_data		mips_trace_data_0
16	mfio16		sdhost			sdhost
			mips_trace_dint		mips_trace_dint_0
			mips_trace_data		mips_trace_data_0
17	mfio17		sdhost			sdhost
			mips_trace_trigout	mips_trace_trigout_0
			mips_trace_data		mips_trace_data_0
18	mfio18		sdhost			sdhost
			mips_trace_trigin	mips_trace_trigin_0
			mips_trace_data		mips_trace_data_0
19	mfio19		sdhost			sdhost
			mips_trace_dm		mips_trace_dm_0
			mips_trace_data		mips_trace_data_0
20	mfio20		sdhost			sdhost
			mips_probe_n		mips_probe_n_0
			mips_trace_data		mips_trace_data_0
21	mfio21		sdhost			sdhost
			mips_trace_data		mips_trace_data_0
22	mfio22		sdhost			sdhost
			mips_trace_data		mips_trace_data_0
23	mfio23		sdhost			sdhost
24	mfio24		sdhost			sdhost
25	mfio25		sdhost			sdhost
26	mfio26		sdhost			sdhost
27	mfio27		sdhost			sdhost
28	mfio28		i2c0			i2c0
			spim0_cs2		spim0_cs2_1
29	mfio29		i2c0			i2c0
			spim0_cs3		spim0_cs3_1
30	mfio30		i2c1			i2c1
			spim0_cs4		spim0_cs3_4
31	mfio31		i2c1			i2c1
			spim1_cs2		spim1_cs2_1
32	mfio32		i2c2			i2c2
33	mfio33		i2c2			i2c2
34	mfio34		i2c3			i2c3
35	mfio35		i2c3			i2c3
36	mfio36		i2sout_mclk		i2sout_mclk
			audio_clk_in		audio_clk_in
37	mfio37		i2sout			i2sout
			debug_raw_cca_ind	debug_raw_cca_ind
38	mfio38		i2sout			i2sout
			debug_ed_sec20_cca_ind	debug_ed_sec20_cca_ind
39	mfio39		i2sout			i2sout
			debug_ed_sec40_cca_ind	debug_ed_sec40_cca_ind
40	mfio40		i2sout_dat1		i2sout_dat1
			debug_agc_done0		debug_agc_done0
41	mfio41		i2sout_dat2		i2sout_dat2
			debug_agc_done1		debug_agc_done1
42	mfio42		i2sout_dat3		i2sout_dat3
			debug_ed_cca_ind	debug_ed_cca_ind
43	mfio43		i2sout_dat4		i2sout_dat4
			debug_s2l_done		debug_s2l_done
44	mfio44		i2sout_dat5		i2sout_dat5
45	mfio45		i2sdac			i2sdac
			audiosync		audiosync
46	mfio46		audiotrigger		audiotrigger
47	mfio47		i2sin			i2sin
48	mfio48		i2sin			i2sin
49	mfio49		i2sin			i2sin
50	mfio50		i2sin_dat1		i2sin_dat1
51	mfio51		i2sin_dat2		i2sin_dat2
52	mfio52		i2sin_dat3		i2sin_dat3
53	mfio53		i2sin_dat4		i2sin_dat4
54	mfio54		i2sin_dat5		i2sin_dat5
			spdifin			spdifin_1
55	mfio55		uart0			uart0
			spim0_cs2		spim0_cs2_0
			spim1_cs2		spim1_cs2_2
56	mfio56		uart0			uart0
			spim0_cs3		spim0_cs3_0
			spim1_cs3		spim1_cs3
57	mfio57		uart0_cts_rts		uart0_cts_rts
			spim0_cs4		spim0_cs4_0
			spim1_cs4		spim1_cs4
58	mfio58		uart0_cts_rts		uart0_cts_rts
			spim1_cs1		spim1_cs1_1
59	mfio59		uart1			uart1
60	mfio60		uart1			uart1
61	mfio61		spdifout		spdifout
62	mfio62		spdifin			spdifin_0
63	mfio63		eth			eth
			mips_trace_clk		mips_trace_clk_1
			mips_trace_data		mips_trace_data_1
64	mfio64		eth			eth
			mips_trace_dint		mips_trace_dint_1
			mips_trace_data		mips_trace_data_1
65	mfio65		eth			eth
			mips_trace_trigout	mips_trace_trigout_1
			mips_trace_data		mips_trace_data_1
66	mfio66		eth			eth
			mips_trace_trigin	mips_trace_trigin_1
			mips_trace_data		mips_trace_data_1
67	mfio67		eth			eth
			mips_trace_dm		mips_trace_dm_1
			mips_trace_data		mips_trace_data_1
68	mfio68		eth			eth
			mips_probe_n		mips_probe_n_1
			mips_trace_data		mips_trace_data_0
69	mfio69		eth			eth
			mips_trace_data		mips_trace_data_1
70	mfio70		eth			eth
			mips_trace_data		mips_trace_data_1
71	mfio71		eth			eth
72	mfio72		ir			ir
73	mfio73		pwmpdm0			pwmpdm0
			mips_trace_clk		mips_trace_clk_2
			valid_enable0		valid_enable0
74	mfio74		pwmpdm1			pwmpdm1
			mips_trace_dint		mips_trace_dint_2
			valid_enable0		valid_enable0
75	mfio75		pwmpdm2			pwmpdm2
			mips_trace_trigout	mips_trace_trigout_2
			valid_enable1		valid_enable1
76	mfio76		pwmpdm3			pwmpdm3
			mips_trace_trigin	mips_trace_trigin_2
			valid_enable1		valid_enable1
77	mfio77		valid_enable8		valid_enable8
			mips_trace_dm		mips_trace_dm_2
			valid_enable2		valid_enable2
78	mfio78		valid_enable8		valid_enable8
			mips_probe_n		mips_probe_n_2
			valid_enable2		valid_enable2
79	mfio79		valid_enable9		valid_enable9
			mips_trace_data		mips_trace_data_2
			valid_enable3		valid_enable3
80	mfio80		valid_enable9		valid_enable9
			mips_trace_data		mips_trace_data_2
			valid_enable3		valid_enable3
81	mfio81		dreq0			dreq0
			mips_trace_data		mips_trace_data_2
			valid_enable4		valid_enable4
82	mfio82		dreq1			dreq1
			mips_trace_data		mips_trace_data_2
			valid_enable4		valid_enable4
83	mfio83		pll_lock0		pll_lock0
			mips_trace_data		mips_trace_data_2
			valid_enable5		valid_enable5
84	mfio84		pll_lock1		pll_lock1
			mips_trace_data		mips_trace_data_2
			valid_enable5		valid_enable5
85	mfio85		pll_lock2		pll_lock2
			mips_trace_data		mips_trace_data_2
			valid_enable6		valid_enable6
86	mfio86		pll_lock3		pll_lock3
			mips_trace_data		mips_trace_data_2
			valid_enable6		valid_enable6
87	mfio87		pll_lock4		pll_lock4
			dreq2			dreq2
			valid_enable7		valid_enable7
88	mfio88		pll_lock5		pll_lock5
			dreq3			dreq3
			valid_enable7		valid_enable7
89	mfio89		pll_lock6		pll_lock6
			dreq4			dreq4
			dreq5			dreq5
90	TCK
91	TRSTN
92	TDI
93	TMS
94	TDO
95	JTAG_COMPLY
96	SAFE_MODE
97	POR_DISABLE
98	RESETN



Example:

	pinctrl: pinctrl@18101C00 {
		compatible = "img,pistachio-pinctrl";

		reg = <0x18101C00 0x400>;

		interrupts = <GIC_SHARED 71 IRQ_TYPE_LEVEL_HIGH
			GIC_SHARED 72 IRQ_TYPE_LEVEL_HIGH
			GIC_SHARED 73 IRQ_TYPE_LEVEL_HIGH
			GIC_SHARED 74 IRQ_TYPE_LEVEL_HIGH
			GIC_SHARED 75 IRQ_TYPE_LEVEL_HIGH
			GIC_SHARED 76 IRQ_TYPE_LEVEL_HIGH>;

		gpio-controller;
		#gpio-cells = <2>;
		interrupt-controller;
		#interrupt-cells = <2>;

		pinctrl_spim1: pinctrl_spim1 {
			group = "spim1";
			function = "spim1";
			img,pull = <1 1 2>;
		}

		pinctrl_sdhost_gpio: pinctrl_sdhost_gpio {
			pins = <15 16 17 18 19 20 21 22 23 24 25 26 27>;
			img,drive = <1 2 1 1 2 1 2 2 1 1 2 1 1>;
			img,pull = <1>;
		}
	};

	spfi0: spi@... {
		...

		pinctrl-names = "default";
		pinctrl-0 = <&pinctrl_spim1>;
	};

	sdhost_gpio: sdhost@... {
		...

		interrupt-parent = <&pinctrl>;
		interrupts = <15 IRQ_TYPE_EDGE_BOTH 16 IRQ_TYPE_EDGE_RISING>
		gpios = <&pinctrl 17 0 &pinctrl 18 0 &pinctrl 19 0
				&pinctrl 20 0 &pinctrl 21 0 &pinctrl 22 0
				 &pinctrl 23 0 &pinctrl 24 0 &pinctrl 25 0
				 &pinctrl 26 0 &pinctrl 27>;
	};
```
