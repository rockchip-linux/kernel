## Documentation/devicetree/bindings/display/bridge/lontium,lt9611.txt
```
Lontium LT9611 MIPI-DSI to HDMI bridge bindings

Required properties:
 - compatible: "lontium,lt9611"
 - reg: i2c address of the bridge
 - reset-gpios: a GPIO spec for the reset pin
 - interrupts-extended: Specify the interrupts associated with external
 - vdd-supply: Reference to the regulator powering the bridge 1.8V power supply pins
 - vcc-supply: Reference to the regulator powering the bridge 3.3V power supply pins

ptional properties:
 - enable-gpios: a GPIO spec for the power supply enable control

Example:

&dsi {
	status = "okay";

	ports {
		#address-cells = <1>;
		#size-cells = <0>;

		port@1 {
			reg = <1>;
			dsi_out_lt9611: endpoint {
				remote-endpoint = <&lt9611_in_dsi>;
			};
		};
	};

};

&i2c0 {
	status = "okay";

	lontium-lt9611@39 {
		compatible = "lontium,lt9611";
		status = "okay";
		reg = <0x39>;
		interrupts-extended = <&gpio0 RK_PB5 IRQ_TYPE_EDGE_FALLING>;
		reset-gpios = <&gpio0 RK_PB6 GPIO_ACTIVE_HIGH>;
		vdd-supply = <&lt9611_1v8>;
		vcc-supply = <&lt9611_3v3>;

		ports {
			#address-cells = <1>;
			#size-cells = <0>;

			port@0 {
				reg = <0>;

				lt9611_in_dsi: endpoint {
					remote-endpoint = <&dsi_out_lt9611>;
				};
			};

		};

	};
};
```

## Documentation/devicetree/bindings/display/bridge/ps8622.txt
```
ps8622-bridge bindings

Required properties:
	- compatible: "parade,ps8622" or "parade,ps8625"
	- reg: first i2c address of the bridge
	- sleep-gpios: OF device-tree gpio specification for PD_ pin.
	- reset-gpios: OF device-tree gpio specification for RST_ pin.

Optional properties:
	- lane-count: number of DP lanes to use
	- use-external-pwm: backlight will be controlled by an external PWM
	- video interfaces: Device node can contain video interface port
			    nodes for panel according to [1].
	- dual-channel: boolean. if it exists, enable dual channel mode

[1]: Documentation/devicetree/bindings/media/video-interfaces.txt

Example:

&i2c4 {
	status = "okay";

	ps8625: ps8625@48 {
		compatible = "parade,ps8625";
		reg = <0x48>;
		sleep-gpios = <&gpio1 4 GPIO_ACTIVE_HIGH>;
		reset-gpios = <&gpio2 4 GPIO_ACTIVE_HIGH>;
		lane-count = <2>;
		use-external-pwm;

		ports {
			#address-cells = <1>;
			#size-cells = <0>;

			port@0 {
				reg = <0>;

				ps8625_in_edp: endpoint {
					remote-endpoint = <&edp_out_ps8625>;
				};
			};

			port@1 {
				reg = <1>;

				ps8625_out_panel: endpoint {
					remote-endpoint = <&panel_in_ps8625>;
				};
			};
		};
	};
};
```

## Documentation/devicetree/bindings/dram/rk312x_ddr_timing.txt
```
* rk312x dram default timing is at arch/arm/boot/dts/rk312x-ddr-default-timing.dtsi

Required properties:
- compatible : Should be "rockchip,ddr-timing"

- ddr3_speed_bin : Value is defined at include/dt-bindings/clock/ddr.h.
  It select ddr3 cl-trp-trcd type, default value "DDR3_DEFAULT".it must selected
  according to "Speed Bin" in ddr3 datasheet, DO NOT use smaller "Speed Bin" than
  ddr3 exactly is.

- pd_idle : Config the PD_IDLE value, defined the power-down idle period, memories
  are places into power-down mode if bus is idle for PD_IDLE DFI clocks.

- sr_idle : Configure the SR_IDLE value, defined the selfrefresh idle period,
  memories are places into self-refresh mode if bus is idle for SR_IDLE*32 DFI
  clocks (DFI clocks freq is half of dram's clocks), defaule value is "1".

- auto_pd_dis_freq : It's defined the auto power-down frequency in MHz (Mega Hz),
  when ddr freq greater than this setting value, auto power-down will disable.

- auto_sr_dis_freq : It's defined the auto selfrefresh frequency in MHz (Mega Hz),
  when ddr freq greater than this setting value, auto selfrefresh will disable.

- ddr3_dll_disb_freq : It's defined the ddr3 dll bypass frequency in MHz (Mega Hz),
  when ddr freq less than this setting value, ddr3 dll will bypssed.
  note: if dll was bypassed, the odt also stop working.

- lpddr2_dll_disb_freq : It's defined the lpddr2 dll bypass frequency in MHz (Mega Hz),
  when ddr freq less than this setting value, lpddr2 dll will bypssed.

- phy_dll_disb_freq : Defined the PHY dll bypass frequency in MHz (Mega Hz),
  when ddr freq less than this setting value, phy dll will bypssed.
  note: phy dll and phy odt are independent.

- ddr3_odt_disb_freq : Defined the ddr3 odt disable frequency in
  MHz (Mega Hz), when ddr frequency less then this setting value, the ddr3
  ODT are disabled.

- phy_ddr3_odt_disb_freq : Defined the phy odt disable frequency in
  MHz (Mega Hz), when ddr frequency less then this setting value, the phy
  ODT are disabled.

- ddr3_drv : Define the DDR3 driver strength in ohm.

- ddr3_odt : Define the DDR3 ODT in ohm.

- phy_ddr3_clk_drv : Define the phy clocks driver strength in ohm.
  when connect DDR3.

- phy_ddr3_cmd_drv : Define the phy commands driver strength in ohm.
  when connect DDR3.

- phy_ddr3_cmd_drv : Define the phy dqs and dq driver strength in ohm.
  when connect DDR3.

- phy_ddr3_odt : Define the phy odt in ohm when connect DDR3.

- lpddr2_drv : Define the LPDDR2 driver strength in ohm.

- phy_lpddr2_clk_drv : Define the phy clocks driver strength in ohm
  when connect LPDDR2.

- phy_lpddr2_cmd_drv : Define the phy commands driver strength in ohm
  when connect LPDDR2.

- phy_lpddr2_dqs_drv : Define the phy dqs and dq driver strength in ohm
  when connect LPDDR2.

Example:
/ {
	ddr_timing: ddr_timing {
		compatible = "rockchip,ddr-timing";
		ddr3_speed_bin = <DDR3_DEFAULT>;
		pd_idle = <0x40>;
		sr_idle = <0x1>;

		auto_pd_dis_freq = <533>;
		auto_sr_dis_freq = <533>;
		ddr3_dll_dis_freq = <300>;
		lpddr2_dll_dis_freq = <300>;
		phy_dll_dis_freq = <266>;

		ddr3_odt_dis_freq = <333>;
		phy_ddr3_odt_disb_freq = <333>;
		ddr3_drv = <DDR3_DS_40ohm>;
		ddr3_odt = <DDR3_ODT_120ohm>;
		phy_ddr3_clk_drv = <PHY_RON_44ohm>;
		phy_ddr3_cmd_drv = <PHY_RON_44ohm>;
		phy_ddr3_dqs_drv = <PHY_RON_44ohm>;
		phy_ddr3_odt = <PHY_RTT_216ohm>;

		lpddr2_drv = <LP2_DS_34ohm>;
		phy_lpddr2_clk_drv = <PHY_RON_44ohm>;
		phy_lpddr2_cmd_drv = <PHY_RON_44ohm>;
		phy_lpddr2_dqs_drv = <PHY_RON_44ohm>;
	};
};
```

## Documentation/devicetree/bindings/dram/rk322xh_dram_timing.txt
```
* rk322xh dram default timing is at arch/arm64/boot/dts/rk322xh-dram-default-timing.dtsi

Required properties:
- compatible : Should be "rockchip,ddr-timing"
- ddr3_speed_bin : value is defined at include/dt-bindings/clock/ddr.h
  it select ddr3 cl-trp-trcd type, default value "DDR3_DEFAULT".it must selected
  according to "Speed Bin" in ddr3 datasheet, DO NOT use smaller "Speed Bin" than
  ddr3 exactly is.

- ddr4_speed_bin : value is defined at include/dt-bindings/clock/ddr.h
  it select ddr4 cl-trp-trcd type, default value "DDR4_DEFAULT".it must selected
  according to "Speed Bin" in ddr4 datasheet, DO NOT use smaller "Speed Bin" than
  ddr4 exactly is.

- sr_idle : no used for rk322xh, because rk322xh controller not support sr_idle
  modify after system boot.

- pd_idle : no used for rk322xh, because rk322xh controller not support pd_idle
  modify after system boot.

- sr_mc_gate_idle : no used for rk322xh

- srpd_lite_idle : no used for rk322xh

- standby_idle: no used for rk322xh

- auto_pd_dis_freq: it's defined the frequency of disable auto power-down
  function in MHz (Mega Hz). when ddr work frequency greater than or equal
  this setting value, will disable auto power-down function.

- auto_sr_dis_freq: it's defined the frequency of disable auto self-refresh
  function in MHz (Mega Hz). when ddr work frequency greater than or equal
  this setting value, will disable auto self-refresh function.

- ddr3_dll_dis_freq : it's defined the DDR3 dll bypass frequency in MHz (Mega Hz),
  when ddr freq less than or equal this setting value, ddr3 dll will bypssed
  note: if dll was bypassed, the odt also stop working.

- ddr4_dll_dis_freq : it's defined the DDR4 dll bypass frequency in MHz (Mega Hz),
  when ddr freq less than or equal this setting value, ddr4 dll will bypssed
  note: if dll was bypassed, the odt also stop working.

- phy_dll_dis_freq : defined the PHY dll bypass frequency in MHz (Mega Hz),
  when ddr freq less than or equal this setting value, phy dll will bypssed
  note: phy dll and phy odt are independent

- ddr3_odt_dis_freq : defined the DDR3 odt disable frequency in
  MHz (Mega Hz), when ddr frequency less then or equal this setting value,
  the DDR3 ODT are disabled.

- phy_ddr3_odt_dis_freq : defined the PHY side odt disable frequency in
  MHz (Mega Hz), when ddr3 frequency less then or equal this setting value
  for DDR3 system

- ddr3_drv : define the DDR3 driver strength in ohm

- ddr3_odt : define the DDR3 ODT in ohm

- phy_ddr3_ca_drv : define the phy commands and address driver strength in ohm
  when connect DDR3

- phy_ddr3_ck_drv : define the phy clocks driver strength in ohm
  when connect DDR3

- phy_ddr3_dq_drv : define the phy dqs and dq driver strength in ohm
  when connnect DDR3

- phy_ddr3_odt : define the phy odt in ohm when connect DDR3


- lpddr3_odt_dis_freq : defined the LPDDR3 odt disable frequency in
  MHz (Mega Hz), when ddr frequency less then or equal this setting value,
  the LPDDR3 ODT are disabled.

- phy_lpddr3_odt_dis_freq : defined the PHY side odt disable frequency in
  MHz (Mega Hz), when lpddr3 frequency less then or equal this setting value
  for LPDDR3 system

- lpddr3_drv : define the LPDDR3 driver strength in ohm

- lpddr3_odt : define the LPDDR3 ODT in ohm

- phy_lpddr3_ca_drv : define the phy commands and address driver strength in ohm
  when connect LPDDR3

- phy_lpddr3_ck_drv : define the phy clocks driver strength in ohm
  when connect LPDDR3

- phy_lpddr3_dq_drv : define the phy dqs and dq driver strength in ohm
  when connnect LPDDR3

- phy_lpddr3_odt : define the phy odt in ohm when connect LPDDR3


- lpddr4_odt_dis_freq : defined the LPDDR4 odt disable frequency in
  MHz (Mega Hz), when ddr frequency less then or equal this setting value,
  the LPDDR4 ODT are disabled.

- phy_lpddr4_odt_dis_freq : defined the PHY side odt disable frequency in
  MHz (Mega Hz), when lpddr4 frequency less then or equal this setting value
  for LPDDR4 system

- lpddr4_drv : define the LPDDR4 driver strength in ohm

- lpddr4_dq_odt : define the LPDDR4 DQ ODT in ohm

- lpddr4_ca_odt : define the LPDDR4 CA ODT in ohm

- phy_lpddr4_ca_drv : define the phy commands and address driver strength in ohm
  when connect LPDDR4

- phy_lpddr4_ck_cs_drv : define the phy clocks driver strength in ohm
  when connect LPDDR4

- phy_lpddr4_dq_drv : define the phy dqs and dq driver strength in ohm
  when connnect LPDDR4

- phy_lpddr4_odt : define the phy odt in ohm when connect LPDDR4


- ddr4_odt_dis_freq : defined the DDR4 odt disable frequency in
  MHz (Mega Hz), when ddr frequency less then or equal this setting value,
  the DDR4 ODT are disabled.

- phy_ddr4_odt_dis_freq : defined the PHY side odt disable frequency in
  MHz (Mega Hz), when ddr4 frequency less then or equal this setting value
  for DDR4 system

- ddr4_drv : define the DDR4 driver strength in ohm

- ddr4_odt : define the DDR4 ODT in ohm

- phy_ddr4_ca_drv : define the phy commands and address driver strength in ohm
  when connect DDR4

- phy_ddr4_ck_drv : define the phy clocks driver strength in ohm
  when connect DDR4

- phy_ddr4_dq_drv : define the phy dqs and dq driver strength in ohm
  when connnect DDR4

- phy_ddr4_odt : define the phy odt in ohm when connect DDR4

- ddr3a1_ddr4a9_de-skew : define DDR3 address A1 or DDR4 address A9 de-skew value
  one step is 47.8ps, range 0-15
  other CA de-skew is similar

- cs0_dm0_rx_de-skew : CS0 DM0 receive end's de-skew
  RX one step is 25.1ps, range 0-15
  other DATA RX de-skew is similar

- cs0_dm0_tx_de-skew : CS0 DM0 transmit end's de-skew
  TX one step is 47.8ps, range 0-15
  other DATA TX de-skew is similar

- cs1_dm0_rx_de-skew : CS1 DM0 receive end's de-skew

- cs1_dm0_tx_de-skew : CS1 DM0 transmit end's de-skew


the driver strength and odt value are defined at include/dt-bindings/dram/rockchip,rk322x.h

Example:

/ {
	ddr_timing: ddr_timing {
		compatible = "rockchip,ddr-timing";
		ddr3_speed_bin = <DDR3_DEFAULT>;
		ddr4_speed_bin = <DDR4_DEFAULT>;
		pd_idle = <0>;
		sr_idle = <0>;
		sr_mc_gate_idle = <0>;
		srpd_lite_idle	= <0>;
		standby_idle = <0>;

		auto_pd_dis_freq = <1066>;
		auto_sr_dis_freq = <800>;
		ddr3_dll_dis_freq = <300>;
		ddr4_dll_dis_freq = <625>;
		phy_dll_dis_freq = <400>;

		ddr3_odt_dis_freq = <100>;
		ddr3_drv = <DDR3_DS_40ohm>;
		ddr3_odt = <DDR3_ODT_120ohm>;
		phy_ddr3_ca_drv = <PHY_DDR3_RON_RTT_34ohm>;
		phy_ddr3_ck_drv = <PHY_DDR3_RON_RTT_45ohm>;
		phy_ddr3_dq_drv = <PHY_DDR3_RON_RTT_34ohm>;
		phy_ddr3_odt = <PHY_DDR3_RON_RTT_225ohm>;

		lpddr3_odt_dis_freq = <666>;
		lpddr3_drv = <LP3_DS_40ohm>;
		lpddr3_odt = <LP3_ODT_240ohm>;
		phy_lpddr3_ca_drv = <PHY_DDR4_LPDDR3_RON_RTT_34ohm>;
		phy_lpddr3_ck_drv = <PHY_DDR4_LPDDR3_RON_RTT_43ohm>;
		phy_lpddr3_dq_drv = <PHY_DDR4_LPDDR3_RON_RTT_34ohm>;
		phy_lpddr3_odt = <PHY_DDR4_LPDDR3_RON_RTT_240ohm>;

		lpddr4_odt_dis_freq = <800>;
		lpddr4_drv = <LP4_PDDS_60ohm>;
		lpddr4_dq_odt = <LP4_DQ_ODT_40ohm>;
		lpddr4_ca_odt = <LP4_CA_ODT_40ohm>;
		phy_lpddr4_ca_drv = <PHY_DDR4_LPDDR3_RON_RTT_40ohm>;
		phy_lpddr4_ck_cs_drv = <PHY_DDR4_LPDDR3_RON_RTT_80ohm>;
		phy_lpddr4_dq_drv = <PHY_DDR4_LPDDR3_RON_RTT_80ohm>;
		phy_lpddr4_odt = <PHY_DDR4_LPDDR3_RON_RTT_60ohm>;

		ddr4_odt_dis_freq = <666>;
		ddr4_drv = <DDR4_DS_34ohm>;
		ddr4_odt = <DDR4_RTT_NOM_240ohm>;
		phy_ddr4_ca_drv = <PHY_DDR4_LPDDR3_RON_RTT_34ohm>;
		phy_ddr4_ck_drv = <PHY_DDR4_LPDDR3_RON_RTT_43ohm>;
		phy_ddr4_dq_drv = <PHY_DDR4_LPDDR3_RON_RTT_34ohm>;
		phy_ddr4_odt = <PHY_DDR4_LPDDR3_RON_RTT_240ohm>;

		/* CA de-skew, one step is 47.8ps, range 0-15 */
		ddr3a1_ddr4a9_de-skew = <7>;
		ddr3a0_ddr4a10_de-skew = <7>;
		ddr3a3_ddr4a6_de-skew = <8>;

		/* DATA de-skew
		 * RX one step is 25.1ps, range 0-15
		 * TX one step is 47.8ps, range 0-15
		 */
		cs0_dm0_rx_de-skew = <7>;
		cs0_dm0_tx_de-skew = <8>;
		cs0_dq0_rx_de-skew = <7>;
	};
};
```

## Documentation/devicetree/bindings/dram/rockchip_rk312x_ddr.txt
```
* Rockchip rk312x DDR device driver

Required properties:
- compatible : Should be "rockchip,rk312x-ddr"
- rockchip,grf : Get GRF base address for DDR monitor.
- ddr_timing : DDR timing need to pass to optee firmware.
- vop-dclk-mode : Define how to process dclk when DDR change frequency.
	Parameter:
	0 = Use standard flow,decide by lcdc type if process dclk.
	1 = Vop dclk never divided.
	2 = Vop dclk always divided.

Example:
	ddr: ddr {
		compatible = "rockchip,rk312x-ddr";
		rockchip,grf = <&grf>;
		rockchip,ddr_timing = <&ddr_timing>;
		vop-dclk-mode = <0>;
		status = "disabled";
	};
```

## Documentation/devicetree/bindings/edp/tegra_cpu_edp.txt
```
* Tegra VDD_CPU EDP Management

The CPU EDP management prevents the CPU from drawing more
current from voltage regulator. Limit maximum CPU frequency
based on temperature and number of on-line CPUs to keep
CPU rail current within power supply capabilities.

.. CPU EDP node required properties:

- compatible : "nvidia,tegra124-cpu-edp", "nvidia,tegra132-cpu-edp"
- nvidia,edp-limit: maximum cpu current support, in milliampere.
                This vlaue is platform dependent. The CPU EDP management
                will limit the cpu frequency as neccessary to keep
                VDD CPU consumption within this value.

Example:

cpu_edp {
	compatible = "nvidia,tegra124-cpu-edp";
	nvidia,edp-limit = <8000>;
};
```
