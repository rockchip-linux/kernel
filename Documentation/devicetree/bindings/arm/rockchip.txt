## Documentation/devicetree/bindings/arm/tegra/nvidia,tegra20-pmc.txt
```
NVIDIA Tegra Power Management Controller (PMC)

The PMC block interacts with an external Power Management Unit. The PMC
mostly controls the entry and exit of the system from different sleep
modes. It provides power-gating controllers for SoC and CPU power-islands.

Required properties:
- name : Should be pmc
- compatible : Should contain "nvidia,tegra<chip>-pmc".
- reg : Offset and length of the register set for the device
- clocks : Must contain an entry for each entry in clock-names.
  See ../clocks/clock-bindings.txt for details.
- clock-names : Must include the following entries:
  "pclk" (The Tegra clock of that name),
  "clk32k_in" (The 32KHz clock input to Tegra).

Optional properties:
- nvidia,invert-interrupt : If present, inverts the PMU interrupt signal.
  The PMU is an external Power Management Unit, whose interrupt output
  signal is fed into the PMC. This signal is optionally inverted, and then
  fed into the ARM GIC. The PMC is not involved in the detection or
  handling of this interrupt signal, merely its inversion.
- nvidia,suspend-mode : The suspend mode that the platform should use.
  Valid values are 0, 1 and 2:
  0 (LP0): CPU + Core voltage off and DRAM in self-refresh
  1 (LP1): CPU voltage off and DRAM in self-refresh
  2 (LP2): CPU voltage off
- nvidia,core-power-req-active-high : Boolean, core power request active-high
- nvidia,sys-clock-req-active-high : Boolean, system clock request active-high
- nvidia,combined-power-req : Boolean, combined power request for CPU & Core
- nvidia,cpu-pwr-good-en : Boolean, CPU power good signal (from PMIC to PMC)
			   is enabled.

Required properties when nvidia,suspend-mode is specified:
- nvidia,cpu-pwr-good-time : CPU power good time in uS.
- nvidia,cpu-pwr-off-time : CPU power off time in uS.
- nvidia,core-pwr-good-time : <Oscillator-stable-time Power-stable-time>
			      Core power good time in uS.
- nvidia,core-pwr-off-time : Core power off time in uS.

Hardware-triggered thermal reset:
On Tegra30, Tegra114 and Tegra124, if the 'i2c-thermtrip' subnode exists,
hardware-triggered thermal reset will be enabled.

Required properties for hardware-triggered thermal reset (inside 'i2c-thermtrip'):
- nvidia,pmu : Phandle to power management unit / PMIC handling poweroff
- nvidia,reg-addr : I2C register address to write poweroff command to
- nvidia,reg-data : Poweroff command to write to PMU

Optional properties for hardware-triggered thermal reset (inside 'i2c-thermtrip'):
- nvidia,pinmux-id : Pinmux used by the hardware when issuing poweroff command.
                     Defaults to 0.

Example:

/ SoC dts including file
pmc@7000f400 {
	compatible = "nvidia,tegra20-pmc";
	reg = <0x7000e400 0x400>;
	clocks = <&tegra_car 110>, <&clk32k_in>;
	clock-names = "pclk", "clk32k_in";
	nvidia,invert-interrupt;
	nvidia,suspend-mode = <1>;
	nvidia,cpu-pwr-good-time = <2000>;
	nvidia,cpu-pwr-off-time = <100>;
	nvidia,core-pwr-good-time = <3845 3845>;
	nvidia,core-pwr-off-time = <458>;
	nvidia,core-power-req-active-high;
	nvidia,sys-clock-req-active-high;
};

/ Tegra board dts file
{
	...
	pmc@7000f400 {
		i2c-thermtrip {
			nvidia,pmu = <&pmic>;
			nvidia,reg-addr = <0x36>;
			nvidia,reg-data = <0x2>;
		};
	};
	...
	clocks {
		compatible = "simple-bus";
		#address-cells = <1>;
		#size-cells = <0>;

		clk32k_in: clock {
			compatible = "fixed-clock";
			reg=<0>;
			#clock-cells = <0>;
			clock-frequency = <32768>;
		};
	};
	...
};
```

## Documentation/devicetree/bindings/arm/tegra/nvidia,tegra30-flowctrl.txt
```
NVIDIA Tegra30 Flow Controller

Required properties:
- compatible: "nvidia,tegra30-flowctrl"
- reg: Should contain one register range (address and length)

Example:

	flow-controller@60007000 {
		compatible = "nvidia,tegra30-flowctrl";
		reg = <0x60007000 0x1000>;
	};
```

## Documentation/devicetree/bindings/ata/qcom-sata.txt
```
* Qualcomm AHCI SATA Controller

SATA nodes are defined to describe on-chip Serial ATA controllers.
Each SATA controller should have its own node.

Required properties:
- compatible		: compatible list, contains "qcom,msm-ahci"
- interrupts		: <interrupt mapping for SATA IRQ>
- reg			: <registers mapping>
- phys			: Must contain exactly one entry as specified
			  in phy-bindings.txt
- phy-names		: Must be "sata-phy"

Required properties for "qcom,ipq806x-ahci" compatible:
- clocks		: Must contain an entry for each entry in clock-names.
- clock-names		: Shall be:
				"slave_iface" - Fabric port AHB clock for SATA
				"iface" - AHB clock
				"core" - core clock
				"rxoob" - RX out-of-band clock
				"pmalive" - Power Module Alive clock

Example:
	sata@29000000 {
		compatible = "qcom,ipq806x-ahci", "qcom,msm-ahci";
		reg = <0x29000000 0x180>;

		interrupts = <0 209 0x0>;

		clocks = <&gcc SFAB_SATA_S_H_CLK>,
			 <&gcc SATA_H_CLK>,
			 <&gcc SATA_A_CLK>,
			 <&gcc SATA_RXOOB_CLK>,
			 <&gcc SATA_PMALIVE_CLK>;
		clock-names = "slave_iface", "iface", "core",
				"rxoob", "pmalive";

		phys = <&sata_phy>;
		phy-names = "sata-phy";
	};
```

## Documentation/devicetree/bindings/axd.txt
```
* AXD Audio Processing IP Binding *

Required properties:
- compatible: "img,axd"
- clocks: phandle for the clock that drives AXD.
- interrupts: the GIC interrupt where AXD is connected or software interrupt
  1 (not recommended).

Optional properties:
- gic-irq: it takes two non-zero values, the first one is the host hwirq and
           the second one is axd's. Host's hwirq should match the value in
           interrupts.
           If not using GIC, then axd will revert to using software interrupt 1
           which is a fallback mechanism for systems without GIC. It is
           recommended to use GIC whenever possible. Some systems will only work
           with GIC so this property will not be optional then.
- vpe: VPE number on which axd should start. Must be provided if axd is
       running as a single VPE along Linux on the same core.
       It can't be VPE0.
       The VPE must be offlined by Linux before axd is loaded.
- inbuf-size: size of shared input buffers area. by default it's 0x7800 bytes.
- outbuf-size: size of shared output buffers area. by default it's 0x3c000 bytes.
- fw-base: base address where to load the firmware. This is required if not
           using CMA and will be ignored if using CMA.
- buf-base: base address of buffers area if not using CMA. This is required if
            not using CMA and will be ignored if using CMA.


Example:

		axdclk: axdclk@400M {
			#clock-cells = <0>;
			compatible = "fixed-clock";
			clock-frequency = <400000000>;
		};

		axd {
			compatible = "img,axd";
			clocks = <&axdclk>;
			interrupts = <36 IRQ_TYPE_EDGE_RISING>;
			gic-irq = <36 37>;
			vpe = <1>;
		};
```

## Documentation/devicetree/bindings/chromeos-firmware.txt
```
ChromeOS Firmware

This node specifies information of ChromeOS verified-boot firmware.  The
firmware might update this node prior to booting the kernel.

Required properties:

  - write-protect-gpio : Describe the write-protect GPIO of the system.
  - nonvolatile-context-storage : Storage device type that firmware used for
    vboot nonvolatile context.  It should be one of "disk", "cros-ec", or
    "nvram". Kernel should look for the device that firmware actually used in
    the corresponding optional property below.

Optional properties:

  - chromeos-vbc-blk : If nonvolatile-context-storage is "disk", kernel should
    look for the block device used for storing vboot context in this property.
    It is a 4-tuple of block device phandle, LBA of the block storing vboot
    context, byte offset in the block, and size of vboot context in bytes.
  - chromeos-vbc-ec : If nonvolatile-context-storage is "cros-ec", kernel should
    look for the phandle to the device tree node of EC in this property.
  - recovery-switch : Describe the recovery switch GPIO of the system.
  - developer-switch : Describe the developer switch GPIO of the system.

Example:

firmware {
	chromeos {
		write-protect-gpio = <&gpd1 6 0 0x10000 0>;
		nonvolatile-context-storage = "disk";
		chromeos-vbc-blk = <&mshc_0 0 0 16>;
		chromeos-vbc-ec = <&ec>;
	};
};

Example:

firmware {
	chromeos {
		pinctrl-0 = <&fw_pins>;
		pinctrl-names = "default";
		write-protect-gpio = <&qcom_pinmux 17 1>;
		recovery-switch = <&qcom_pinmux 16 1>;
		developer-switch = <&qcom_pinmux 15 1>;
	};
};
```

## Documentation/devicetree/bindings/clock/nvidia,tegra132-ccplex-clk.txt
```
NVIDIA Tegra132 ccplex clocks

This binding uses the common clock binding:
Documentation/devicetree/bindings/clock/clock-bindings.txt

The Tegra132 ccplex clock module on Tegra132 is the HW module responsible
for the ccplex related clocks.

Required properties :
- compatible : Should be "nvidia,tegra132-ccplex-clk"
- reg : Should contain ccplex clock registers location and length
- #clock-cells : Should be 1.
  In clock consumers, this cell represents the clock ID exposed by the
  ccplex clock module. The assignments may be found in header file
  <dt-bindings/clock/tegra132-ccplex.h>.

Example SoC include file:

/ {
	ccplex-clock@0,70040000 {
		compatible = "nvidia,tegra132-ccplex-clk";
		reg = <0x0 0x70040000 0x0 0x1000>;
		status = "okay";
		#clock-cells = <1>;
	};

};
```

## Documentation/devicetree/bindings/clock/pistachio-clock.txt
```
* IMG Pistachio SoC clock controllers

Pistachio has three clock controllers (core clock, peripheral clock, and
peripheral control) which are instantiated individually from the device-tree.

External clocks:

There are four external inputs to the clock controllers which should
be defined with the following clock-output-names:
- "xtal": External 52Mhz oscillator (required)
- "audio_refclk": Alternate audio reference clock (optional)
- "ext_enet_in": Alternate ethernet PHY clock (optional)

Top-level control:

The top level control block contains miscellaneous control registers and gates
for the external clocks audio_refclk and ext_enet_in.

Required properties:
- compatible: Must include "img,pistachio-cr-top"
- reg: Must contain the base address and length of the top-level
  control registers.
- clocks: Must contain an entry for each clock in clock-names.
- clock-names: Two optional clocks, "audio_refclk" and "ext_enet_in" (see
  "External clocks")
- #clock-cells: Must be 1.  The single cell is the clock identifier.
  See dt-bindings/clock/pistachio-clk.h for the list of valid identifiers.

Example:
	clk_top: clk_top@18144800 {
		compatible = "img,pistachio-cr-top";
		reg = <0x18149000 0x200>;
		clocks = <&audio_refclk &ext_enet_in>;
		clock-names = "audio_refclk", "ext_enet_in";
		#clock-cells = <1>;
	};

Core clock controller:

The core clock controller generates clocks for the CPU, RPU (WiFi + BT
co-processor), audio, and several peripherals.

Required properties:
- compatible: Must be "img,pistachio-clk".
- reg: Must contain the base address and length of the core clock controller.
- #clock-cells: Must be 1.  The single cell is the clock identifier.
  See dt-bindings/clock/pistachio-clk.h for the list of valid identifiers.
- clocks: Must contain an entry for each clock in clock-names.
- clock-names: Must include "xtal" (see "External clocks") and
  "audio_refclk_ext_gate", "ext_enet_in_gate" which are generated by the
  top level control.

Example:
	clk_core: clk_core@18144000 {
		compatible = "img,pistachio-clk";
		reg = <0x18144000 0x800>;
		clocks = <&osc &clk_top EXT_CLK_AUDIO_IN
			&clk_top EXT_CLK_ENET_IN>;
		clock-names = "xtal", "audio_refclk_ext_gate",
			"ext_enet_in_gate";

		#clock-cells = <1>;
	};

Peripheral clock controller:

The peripheral clock controller generates clocks for the DDR, ROM, and other
peripherals.  The peripheral system clock ("periph_sys_core") generated by
the core clock controller is the input clock to the peripheral clock controller.

Required properties:
- compatible: Must be "img,pistachio-periph-clk".
- reg: Must contain the base address and length of the peripheral clock
  controller.
- #clock-cells: Must be 1.  The single cell is the clock identifier.
  See dt-bindings/clock/pistachio-clk.h for the list of valid identifiers.
- clocks: Must contain an entry for each clock in clock-names.
- clock-names: Must include "periph_sys_core", the peripheral system clock
  generated by the core clock controller.

Example:
	clk_periph: clk_periph@18144800 {
		compatible = "img,pistachio-clk-periph";
		reg = <0x18144800 0x800>;
		clocks = <&clk_core CLK_PERIPH_SYS_CORE>;
		clock-names = "periph_sys_core";

		#clock-cells = <1>;
	};

Peripheral general control:

The peripheral general control block generates system interface clocks and
resets for various peripherals.  It also contains miscellaneous peripheral
control registers.  The peripheral system clock ("periph_sys") generated by
the peripheral clock controller is the input clock to the system clock
controller.

Required properties:
- compatible: Must include "img,pistachio-cr-periph" and "syscon".
- reg: Must contain the base address and length of the peripheral general
  control registers.
- #clock-cells: Must be 1.  The single cell is the clock identifier.
  See dt-bindings/clock/pistachio-clk.h for the list of valid identifiers.
- clocks: Must contain an entry for each clock in clock-names.
- clock-names: Must include "sys", the peripheral system clock
  generated by the peripheral clock controller.

Example:
	clk_sys: clk_sys@18144800 {
		compatible = "img,pistachio-cr-periph";
		reg = <0x18148000 0x1000>;
		clocks = <&clk_periph PERIPH_CLK_SYS>;
		clock-names = "sys";

		#clock-cells = <1>;
	};
```

## Documentation/devicetree/bindings/clock/qcom,gcc.txt
```
Qualcomm Global Clock & Reset Controller Binding
------------------------------------------------

Required properties :
- compatible : shall contain only one of the following:

			"qcom,gcc-apq8064"
			"qcom,gcc-apq8084"
			"qcom,gcc-ipq8064"
			"qcom,gcc-msm8660"
			"qcom,gcc-msm8960"
			"qcom,gcc-msm8974"
			"qcom,gcc-msm8974pro"
			"qcom,gcc-msm8974pro-ac"

- reg : shall contain base register location and length
- #clock-cells : shall contain 1
- #reset-cells : shall contain 1

Optional child nodes:
	Child nodes could be any device nodes with its own bindings which
	fall inside the memory-map of the Clock controller, for example
	thermal sensor driver.

Example:
	clock-controller@900000 {
		compatible = "qcom,gcc-msm8960";
		reg = <0x900000 0x4000>;
		#clock-cells = <1>;
		#reset-cells = <1>;
	};
```

## Documentation/devicetree/bindings/clock/qcom,rpm.txt
```
Qualcomm RPM Clock & Reset Controller Binding
------------------------------------------------

Required properties :
- compatible : shall contain only one of the following:

			"qcom,rpm-clk"

- reg : shall contain base register location
- qcom,rpm-clk-name  : shall contain name of clock
- qcom,rpm-clk-freq  : shall contain clock frequency
- qcom,rpm-clk-active-only : shall mention if active only clock
- qcom,rpm-clk-branch : shall mention if branch clock

Example:
			ebi1_clk: ebi1-clk {
				compatible = "qcom,rpm-clk";
				reg = <QCOM_RPM_EBI1_CLK>;

				qcom,rpm-clk-name = "ebi1";
				qcom,rpm-clk-freq = <533000000>;
				qcom,rpm-clk-active-only;
			};
	};
```
