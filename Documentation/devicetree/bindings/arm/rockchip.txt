## Documentation/devicetree/bindings/input/elants_i2c.txt
```
Elantech I2C Touchscreen

Required properties:
- compatible: must be "elan,i2c_touchscreen".
- reg: I2C address of the chip.
- interrupt-parent: a phandle for the gpio controller (see interrupt
  binding[0]).
- interrupts: (gpio) interrupt to which the chip is connected (see interrupt
  binding[0]).

Optional properties:
- wakeup-source: touchpad should be configured as a wakeup source.
- pinctrl-names: should be "default" (see pinctrl binding [1]).
- pinctrl-0: a phandle pointing to the pin settings for the device (see
  pinctrl binding [1]).

[0]: Documentation/devicetree/bindings/interrupt-controller/interrupts.txt
[1]: Documentation/devicetree/bindings/pinctrl/pinctrl-bindings.txt

Example:
	&i2c1 {
		/* ... */

		touchscreen@10 {
			compatible = "elan,i2c_touchscreen";
			reg = <0x10>;
			interrupt-parent = <&gpio4>;
			interrupts = <0x0 IRQ_TYPE_EDGE_FALLING>;
			wakeup-source;
		};

		/* ... */
	};
```

## Documentation/devicetree/bindings/interrupt-controller/nvidia,tegra20-ictlr.txt
```
NVIDIA Tegra Legacy Interrupt Controller

The legacy interrupt controller is divided into units that serve 32 interrupts
each. Tegra20 implements four units, whereas Tegra30 and later implement five.

Required properties:
- compatible: "nvidia,tegra<chip>-ictlr"
- reg: Physical base address and length of the controller's registers. There
  should be one entry for each unit.

Example:

	interrupt-controller@60004000 {
		compatible = "nvidia,tegra20-ictlr";
		reg = <0x60004000 0x40>, /* primary controller */
		      <0x60004100 0x40>, /* secondary controller */
		      <0x60004200 0x40>, /* tertiary controller */
		      <0x60004300 0x40>; /* quaternary controller */
	};
```

## Documentation/devicetree/bindings/mailbox/nvidia,tegra124-xusb-mbox.txt
```
NVIDIA Tegra XUSB mailbox
=========================

The Tegra XUSB mailbox is used by the Tegra xHCI controller's firmware to
communicate requests to the host and PHY drivers.

Refer to ./mailbox.txt for generic information about mailbox device-tree
bindings.

Required properties:
--------------------
 - compatible: Should be "nvidia,tegra124-xusb-mbox".
 - reg: Address and length of the XUSB FPCI registers.
 - interrupts: XUSB mailbox interrupt.
 - #mbox-cells: Should be 0.  There is only one physical channel.

Example:
--------
	xusb_mbox: mailbox@0,70098000 {
		compatible = "nvidia,tegra124-xusb-mbox";
		reg = <0x0 0x70098000 0x0 0x1000>;
		interrupts = <GIC_SPI 40 IRQ_TYPE_LEVEL_HIGH>;

		#mbox-cells = <0>;
	};

	usb@0,70090000 {
		...
		mboxes = <&xusb_mbox>;
		mbox-names = "xusb";
		...
	};
```

## Documentation/devicetree/bindings/media/i2c/ar0144.txt
```
* Aptina AR0144 MIPI sensor

Required Properties:
- compatible: should be "aptina,ar0144"
- clocks: reference to the 24M xvclk input clock.
- clock-names: should be "xvclk".
- dovdd-supply: Digital I/O voltage supply, 1.8/2.8 volts
- avdd-supply: Analog voltage supply, 2.8 volts
- dvdd-supply: Digital core voltage supply, 1.2 volts
- reset-gpios: Low active reset gpio

The device node must contain one 'port' child node for its digital output
video port, in accordance with the video interface bindings defined in
Documentation/devicetree/bindings/media/video-interfaces.txt.

Example:
ar0144: ar0144@10 {
	compatible = "aptina,ar0144";
	status = "okay";
	reg = <0x10>;
	clocks = <&cru SCLK_CIF_OUT>;
	clock-names = "xvclk";

	//conflict with csi-ctl-gpios
	reset-gpios = <&gpio4 26 GPIO_ACTIVE_LOW>;
	pwdn-gpios = <&gpio4 25 GPIO_ACTIVE_HIGH>;
	pinctrl-names = "rockchip,camera_default";
	pinctrl-0 = <&cif_clkout>;
	rockchip,camera-module-index = <0>;
	rockchip,camera-module-facing = "back";
	rockchip,camera-module-name = "default";
	rockchip,camera-module-lens-name = "default";
	port {
		ucam_out3: endpoint {
			remote-endpoint = <&mipi_in_ucam3>;
			data-lanes = <1>;
		};
	};
};
```
