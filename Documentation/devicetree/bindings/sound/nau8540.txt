## Documentation/devicetree/bindings/usb/nvidia,tegra-xusb-phy.txt
```
Tegra SOC XUSB PHY

The device node for the Tegra SOC XUSB PHY:

Required properties:
 - compatible: Should be "nvidia,tegra114-xusb-phy" or
   "nvidia,tegra124-xusb-phy".
 - reg: Address and length of the register sets.  There should be two
   entries in the following order: XUSB_PADCTL registers and USB2.0 PHY
   registers.
 - interrupts: PADCTL interrupt, used for wake from runtime and LP0 suspend.
 - clocks: Handles to XUSB SS, SS source, PLL_U_480M, CLK_M, and pad clocks.
 - clock-names: Should be "xusb_ss", "xusb_ss_src", "pll_u_480M", "clk_m",
   and "pad_clk" respectively.
 - nvidia,pmc: Handle to the PMC syscon node.
 - nvidia,clkrst: Handle to the clock-reset module syscon node.
 - nvidia,ss-pads: Bitmap of enabled SuperSpeed pads:
     bit 0 - SuperSpeed port 0
     bit 1 - SuperSpeed port 1
 - nvidia,utmi-pads: Bitmap of enabled USB2.0 UTMI pads:
     bit 0 - UTMI port 0
     bit 1 - UTMI port 1
     bit 2 - UTMI port 2
 - nvidia,hsic-pads: Bitmap of enabled USB2.0 HSIC pads:
     bit 0 - HSIC port 0
     bit 1 - HSIC port 1
 - nvidia,hsic{0,1}-config: byte array with 9 elements specifiying the
   configuration for the corresponding HISC port:
     byte 0 - rx_strobe_trim
     byte 1 - rx_data_trim
     byte 2 - tx_rtune_n
     byte 3 - tx_rtune_p
     byte 4 - tx_slew_n
     byte 5 - tx_slew_p
     byte 6 - auto_term_en
     byte 7 - strb_trim_val
     byte 8 - pretend_connect
   Only required for enabled HISC ports.
 - nvidia,ss-portmap: Mapping from SS ports to their corresponding USB2.0 port:
     bits 3-0 - SuperSpeed port 0
     bits 7-4 - SuperSpeed port 1
   Both fields have valid values from 0 to 2 (USB2.0 ports 0, 1, 2).
 - nvidia,lane-owner: Program ownership of lanes owned by USB3.0:
     bit 0 - set when super-speed port 1 uses SATA lane. Valid for Tegra124.
	   = 0 (SATA lane owner = SATA)
	   = 1 (SATA lane owner = USB3_SS port1)
     bit 1 - set when super-speed port 0 uses PCIe lane 0 (always).
           = 0 (PCIe lane0 owner = PCIe),
           = 1 (PCIe lane0 owner = USB3_SS port0)
     bit 2 - set when super-speed port 1 uses PCIe lane 1.
           = 0 (PCIe lane1 owner = PCIe),
           = 1 (PCIe lane1 owner = USB3_SS port1)
 - vbus{1,2,3}-supply: VBUS regulator for the corresponding UTMI pad.
   Only required when the respective UTMI pad is enabled.
 - vddio-hsic-supply: HSIC supply regulator.  Only required when HSIC ports
   are enabled.
Optional properties:
 - nvidia,xusb-hs-xcvr-setup-offset: used for high-speed transceiver setup
     and for data eye swing.
     bit   7-0: for PAD0 (port0)
     bit  15-8: for PAD1 (port1)
     bit 23-16: for PAD2 (port2)
   USB parameter HS_CURR_LEVEL is calibrated and fused. Software reads
   the fuse value and programs it to the correct level.
   Actual product may have additional losses on the PCB (connectors).
   This reduces the actual signal at the USB connector.

   Software has the option of adding an offset to the FUSE value before
   it is programmed to register.
   Programmed value = Fuse value + Offset
   This corrects any losses.

   The objective is to get the data eye swing as close as possible to 400mv
   without falling below the mark under typical operating conditions.

   Offset (nvidia,xusb-hs-xcvr-setup-offset) is design dependant
   (PCB type, length of PCB, switches used, etc).
   If "nvidia,xusb-hs-xcvr-setup-offset" is not defined or has
   value 0 for the pad, then
   Programmed value = Fuse value

	usb@70090000 {
		...
		nvidia,xusb-phy = <&xusb_phy>;
		...
	};

	xusb_phy: phy@7009f000 {
		compatible = "nvidia,tegra124-xusb-phy";
		reg = <0x0 0x7009f000 0x1000>,
		      <0x0 0x7000e400 0x800>;
		interrupts = <GIC_SPI 49 IRQ_TYPE_LEVEL_HIGH>;
		clocks = <&tegra_car TEGRA124_CLK_XUSB_SS>,
			 <&tegra_car TEGRA124_CLK_XUSB_SS_SRC>,
			 <&tegra_car TEGRA124_CLK_PLL_U_480M>,
			 <&tegra_car TEGRA124_CLK_CLK_M>,
			 <&tegra_car TEGRA124_CLK_USBD>;
		clock-names = "xusb_ss", "xusb_ss_src", "pll_u_480M",
			      "clk_m", "pad_clk";
		nvidia,pmc = <&pmc>;
		nvidia,clkrst = <&tegra_car>;
		nvidia,ss-pads = <0x3>; /* SSP0, SSP1 */
		nvidia,hsic-pads = <0x0>;
		nvidia,utmi-pads = <0x7>; /* USB2P0, USB2P1, USB2P2 */
		nvidia,ss-portmap = <0x20>; /* SSP0->USB2P0, SSP1->USB2P2 */
		nvidia,lane-owner = <0x6>; /* USB3P0 USB3P1 */
		vbus1-supply = <&usb1_vbus_reg>;
		vbus2-supply = <&run_cam_2v8>;
		vbus3-supply = <&usb3_vbus_reg>;
		vddio-hsic-supply = <&gen_avdd_1v2>;
		nvidia,xusb-hs-xcvr-setup-offset = <0x020004>;
	};
```

## Documentation/devicetree/bindings/usb/nvidia,tegra124-xhci.txt
```
NVIDIA Tegra xHCI controller
============================

The Tegra xHCI controller supports both USB2 and USB3 interfaces exposed
by the Tegra XUSB pad controller.

Required properties:
--------------------
 - compatible: Should be "nvidia,tegra124-xhci".
 - reg: Address and length of the register sets.  There should be three
   entries in the following order: xHCI host registers, FPCI registers, and
   IPFS registers.
 - interrupts: xHCI host interrupt.
 - clocks: Must contain an entry for each entry in clock-names.
   See ../clock/clock-bindings.txt for details.
 - clock-names: Must include the following entries:
    - xusb_host
    - xusb_host_src
    - xusb_dev
    - xusb_dev_src
    - xusb_falcon_src
    - xusb_ss
    - xusb_ss_src
    - xusb_ss_div2
    - xusb_hs_src
    - xusb_fs_src
    - pll_u_480m
    - clk_m
    - pll_e
 - resets: Must contain an entry for each entry in reset-names.
   See ../reset/reset.txt for details.
 - reset-names: Must include the following entries:
   - xusb_host
   - xusb_dev
   - xusb_ss
   - xusb
   Note that xusb_dev is the shared reset for xusb_dev and xusb_dev_src and
   that xusb is the shared reset for xusb_{ss,hs,fs,falcon,host}_src.
 - mboxes: Must contain an entry for the XUSB mailbox channel.
   See ../mailbox/mailbox.txt for details.
 - mbox-names: Must include the following entries:
   - xusb

Optional properties:
--------------------
 - phys: Must contain an entry for each entry in phy-names.
   See ../phy/phy-bindings.txt for details.
 - phy-names: Should include an entry for each PHY used by the controller.
   May be a subset of the following:
    - utmi-{0,1,2}
    - hsic-{0,1}
    - usb3-{0,1}
 - avddio-pex-supply: PCIe/USB3 analog logic power supply.  Must supply 1.05V.
 - dvddio-pex-supply: PCIe/USB3 digital logic power supply.  Must supply 1.05V.
 - avdd-usb-supply: USB controller power supply.  Must supply 3.3V.
 - avdd-pll-utmip-supply: UTMI PLL power supply.  Must supply 1.8V.
 - avdd-pll-erefe-supply: PLLE reference PLL power supply.  Must supply 1.05V.
 - avdd-pex-pll-supply: PCIe/USB3 PLL power supply.  Must supply 1.05V.
 - hvdd-pex-supply: High-voltage PCIe/USB3 power supply.  Must supply 3.3V.
 - hvdd-pex-plle-supply: High-voltage PLLE power supply.  Must supply 3.3V.

Example:
--------
	usb@0,70090000 {
		compatible = "nvidia,tegra124-xhci";
		reg = <0x0 0x70090000 0x0 0x8000>,
		      <0x0 0x70098000 0x0 0x1000>,
		      <0x0 0x70099000 0x0 0x1000>;
		interrupts = <GIC_SPI 39 IRQ_TYPE_LEVEL_HIGH>;
		clocks = <&tegra_car TEGRA124_CLK_XUSB_HOST>,
			 <&tegra_car TEGRA124_CLK_XUSB_HOST_SRC>,
			 <&tegra_car TEGRA124_CLK_XUSB_DEV>,
			 <&tegra_car TEGRA124_CLK_XUSB_DEV_SRC>,
			 <&tegra_car TEGRA124_CLK_XUSB_FALCON_SRC>,
			 <&tegra_car TEGRA124_CLK_XUSB_SS>,
			 <&tegra_car TEGRA124_CLK_XUSB_SS_DIV2>,
			 <&tegra_car TEGRA124_CLK_XUSB_SS_SRC>,
			 <&tegra_car TEGRA124_CLK_XUSB_HS_SRC>,
			 <&tegra_car TEGRA124_CLK_XUSB_FS_SRC>,
			 <&tegra_car TEGRA124_CLK_PLL_U_480M>,
			 <&tegra_car TEGRA124_CLK_CLK_M>,
			 <&tegra_car TEGRA124_CLK_PLL_E>;
		clock-names = "xusb_host", "xusb_host_src", "xusb_dev",
			      "xusb_dev_src", "xusb_falcon_src", "xusb_ss",
			      "xusb_ss_div2", "xusb_ss_src", "xusb_hs_src",
			      "xusb_fs_src", "pll_u_480m", "clk_m", "pll_e";
		resets = <&tegra_car 89>, <&tegra_car 95>, <&tegra_car 156>,
			 <&tegra_car 143>;
		reset-names = "xusb_host", "xusb_dev", "xusb_ss", "xusb";
		mboxes = <&xusb_mbox>;
		mbox-names = "xusb";
		phys = <&padctl TEGRA_XUSB_PADCTL_UTMI_P1>, /* mini-PCIe USB */
		       <&padctl TEGRA_XUSB_PADCTL_UTMI_P2>, /* USB A */
		       <&padctl TEGRA_XUSB_PADCTL_USB3_P0>; /* USB A */
		phy-names = "utmi-1", "utmi-2", "usb3-0";
		avddio-pex-supply = <&vdd_1v05_run>;
		dvddio-pex-supply = <&vdd_1v05_run>;
		avdd-usb-supply = <&vdd_3v3_lp0>;
		avdd-pll-utmip-supply = <&vddio_1v8>;
		avdd-pll-erefe-supply = <&avdd_1v05_run>;
		avdd-pex-pll-supply = <&vdd_1v05_run>;
		hvdd-pex-supply = <&vdd_3v3_lp0>;
		hvdd-pex-plle-supply = <&vdd_3v3_lp0>;
	};
```

## Documentation/devicetree/bindings/usb/qcom,dwc3.txt
```
Qualcomm SuperSpeed DWC3 USB SoC controller


QCOM DWC3 Highspeed USB PHY
========================
Required properities:
- compatible:	should contain "qcom,dwc3-hsphy";
- reg:			offset and length of the register set in the memory map
- clocks:		A list of phandle + clock-specifier pairs for the
				clocks listed in clock-names
- clock-names:	Should contain the following:
  "utmi"		UTMI clock
- v1p8-supply:	phandle to the regulator for the 1.8v supply to HSPHY.
- v3p3-supply:	phandle to the regulator for the 3.3v supply to HSPHY.
- vbus-supply:	phandle to the regulator for the vbus supply for host
		mode.
- vddcx-supply: phandle to the regulator for the vdd supply for HSPHY
                digital circuit operation.

Optional clocks:
  "xo"			External reference clock


QCOM DWC3 Superspeed USB PHY
=========================
Required properities:
- compatible:	should contain "qcom,dwc3-ssphy";
- reg:			offset and length of the register set in the memory map
- clocks:		A list of phandle + clock-specifier pairs for the
				clocks listed in clock-names
- clock-names:	Should contain the following:
  "ref"			Reference clock used in host mode.
- v1p8-supply:	phandle to the regulator for the 1.8v supply to HSPHY.
- vddcx-supply: phandle to the regulator for the vdd supply for HSPHY
                digital circuit operation.

Optional clocks:
  "xo"			External reference clock

QCOM DWC3 controller wrapper
===========================
Required properties:
- compatible:	should contain "qcom,dwc3"
- clocks:		A list of phandle + clock-specifier pairs for the
				clocks listed in clock-names
- clock-names:	Should contain the following:
  "core"		Master/Core clock, have to be >= 125 MHz for SS
				operation and >= 60MHz for HS operation

Optional clocks:
  "iface"		System bus AXI clock.  Not present on all platforms
  "sleep"		Sleep clock, used when USB3 core goes into low
				power mode (U3).

Optional regulator:
- gdsc-supply:	phandle to the regulator from globally distributed
				switch controller

Required child node:
A child node must exist to represent the core DWC3 IP block. The name of
the node is not important. The content of the node is defined in dwc3.txt.

Example device nodes:

		hs_phy_0: phy@110f8800 {
			compatible = "qcom,dwc3-hsphy";
			reg = <0x110f8800 0x30>;
			clocks = <&gcc USB30_0_UTMI_CLK>;
			clock-names = "utmi";

			status = "disabled";
		};

		ss_phy_0: phy@110f8830 {
			compatible = "qcom,dwc3-ssphy";
			reg = <0x110f8830 0x30>;

			clocks = <&gcc USB30_0_MASTER_CLK>;
			clock-names = "ref";

			status = "disabled";
		};

		usb3_0: usb30@0 {
			compatible = "qcom,dwc3";
			#address-cells = <1>;
			#size-cells = <1>;
			clocks = <&gcc USB30_0_MASTER_CLK>;
			clock-names = "core";

			ranges;

			status = "disabled";

			dwc3@11000000 {
				compatible = "snps,dwc3";
				reg = <0x11000000 0xcd00>;
				interrupts = <0 110 0x4>;
				usb-phy = <&hs_phy_0>, <&ss_phy_0>;
				phy-names = "usb2-phy", "usb3-phy";
				tx-fifo-resize;
				dr_mode = "host";
			};
		};
```

## Documentation/devicetree/bindings/usb/rockchip,dwc3.txt
```
Rockchip SuperSpeed DWC3 USB SoC controller

Required properties:
- compatible:	should contain "rockchip,rk322xh-dwc3" for rk322xh SoC
- clocks:	A list of phandle + clock-specifier pairs for the
		clocks listed in clock-names
- clock-names:	Should contain the following:
  "ref_clk"	Controller reference clk, have to be 24 MHz
  "suspend_clk"	Controller suspend clk, have to be 24 MHz or 32 KHz
  "bus_clk"	Master/Core clock, have to be >= 62.5 MHz for SS
		operation and >= 30MHz for HS operation

Required child node:
A child node must exist to represent the core DWC3 IP block. The name of
the node is not important. The content of the node is defined in dwc3.txt.

Phy documentation is provided in the following places:
Documentation/devicetree/bindings/phy/rockchip,dwc3-usb-phy.txt

Example device nodes:

	usbdrd3: usb@ff600000 {
		compatible = "rockchip,rk322xh-dwc3";
		clocks = <&clk_usb3otg_ref>, <&clk_usb3otg0_s>,
			 <&clk_gates19 14>;
		clock-names = "ref_clk", "suspend_clk",
			      "bus_clk";
		#address-cells = <2>;
		#size-cells = <2>;
		ranges;
		status = "disabled";
		usbdrd_dwc3: dwc3@ff600000 {
			compatible = "snps,dwc3";
			reg = <0x0 0xff600000 0x0 0x100000>;
			interrupts = <GIC_SPI 67 IRQ_TYPE_LEVEL_HIGH>;
			dr_mode = "host";
			status = "disabled";
		};
	};
```

## Documentation/devicetree/bindings/video/rockchip-edp.txt
```
Rockchip RK3288 EDP interface
================================

Required properties:
- compatible: "rockchip,rk3288-edp";

- reg: physical base address of the controller and length
- clocks: from common clock binding: handle to dp clock.
	of memory mapped region.
- clock-names: from common clock binding:
	Required elements: "clk_edp"
			"clk_edp_24m"
			"pclk_edp"
- resets: Must contain an entry for each entry in reset-names.
	See ../reset/reset.txt for details.
- reset-names: Must include the name "edp"

- rockchip,grf: this soc should set GRF regs, so need get grf here.
- rockchip,panel: required a simple panel node as described by
	Documentation/devicetree/bindings/panel/simple-panel.txt

- ports: contain a port node with endpoint definitions as defined in
  Documentation/devicetree/bindings/media/video-interfaces.txt.

Example:
	edp: edp@ff970000 {
		compatible = "rockchip,rk3288-edp";
		reg = <0xff970000 0x4000>;
		interrupts = <GIC_SPI 98 IRQ_TYPE_LEVEL_HIGH>;
		clocks = <&cru SCLK_EDP>, <&cru SCLK_EDP_24M>, <&cru PCLK_EDP_CTRL>;
		clock-names = "clk_edp", "clk_edp_24m", "pclk_edp";
		rockchip,grf = <&grf>;
		resets = <&cru 111>;
		reset-names = "edp";
		rockchip,panel = <&panel>;
		ports {
			edp_in: port {
				#address-cells = <1>;
				#size-cells = <0>;
				edp_in_vopb: endpoint@0 {
					reg = <0>;
					remote-endpoint = <&vopb_out_edp>;
				};
				edp_in_vopl: endpoint@1 {
					reg = <1>;
					remote-endpoint = <&vopl_out_edp>;
				};
			};
		};
	};
```
