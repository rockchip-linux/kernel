## Documentation/devicetree/bindings/sound/nau8540.txt
```
Nuvoton NAU8540 audio codec

This device supports I2C only.

Required properties:
  - compatible : Must be "nuvoton,nau8540"

  - reg : the I2C address of the device. This is either 0x1c (CSB=0) or 0x1d (CSB=1).

Example:

nau8540: nau8540@1c {
	compatible = "nuvoton,nau8540";
	reg = <0x1c>;
};
```

## Documentation/devicetree/bindings/sound/nvidia,tegra124-hda.txt
```
NVIDIA Tegra30 HDA controller

Required properties:
- compatible : "nvidia,tegra30-hda"
- reg : Should contain the HDA registers location and length.
- interrupts : The interrupt from the hda controller.

Example:

hda@70030000 {
	compatible = "nvidia,tegra-hda";
	reg = <0x0 0x70030000 0x10000>;
	interrupts = <GIC_SPI 81 IRQ_TYPE_LEVEL_HIGH>;
};
```

## Documentation/devicetree/bindings/sound/qcom,ipq806x-max98357a.txt
```
* Qualcomm Technologies IPQ806x-MAX98357A SoundCard

This node models a soundcard for boards with the Qualcomm Technologies IPQ806x
SOC connected to a MAX98357A DAC via I2S.

Required properties:

- compatible	: "qcom,ipq806x-max98357a"
- qcom,model	: The user-visible name of this sound card.
- cpu		: Phandle of the CPU DAI
- codec		: Phandle of the codec DAI
- codec-dai	: Name of the codec DAI which must be selected from one of the
		  following entries:
			* max98357a

Example:

sound {
	compatible = "qcom,ipq806x-max98357a";
	model = "ipq806x-max98357a";
	cpu = <&lpass_cpu>;
	codec = <&max98357a>;
	codec-dai = "max98357a";
};
```

## Documentation/devicetree/bindings/sound/qcom,ipq806x-snd-card.txt
```
* Qualcomm Technologies IPQ806x SoundCard

This node models the Qualcomm Technologies IPQ806x LPASS Audio SoundCard,
with a connection between the CPU MI2S DAI and the external DAC.

Required properties:
- compatible : "qcom,ipq806x-snd-card"
- qcom,model : The user-visible name of this sound card
			* <any string is valid>
- platform   : This is a phandle reference to platform device driver node (for the soundcard dai-link)
- cpu        : This is a phandle reference to CPU DAI device driver node (for the soundcard dai-link)
- codec      : This is a phandle reference to codec DAI device driver node (for the soundcard dai-link)
- codec-dai  : This is a string that names the codec DAI device (for the soundcard dai-link)
			* max98357a-codec-dai

Example:

sound {
	compatible = "qcom,ipq806x-snd-card";
	model = "ipq806x-snd-card";
	platform = <&lpass_pcm_mi2s>;
	cpu = <&lpass_cpu_mi2s>;
	codec = <&max98357a_codec>;
	codec-dai = "max98357a-codec-dai";
};
```

## Documentation/devicetree/bindings/sound/qcom,lpass-cpu-dai.txt
```
* Qualcomm Technologies IPQ806x LPASS DAI

This node models the Qualcomm Technologies IPQ806x LPASS MI2S DAI port.

Required properties:
- compatible      : "qcom,lpass-cpu-mi2s"
- clocks          : A list of clock specifiers for the audio interface
			* AHBIX bus clock
			* MI2S OSR clock
			* MI2S Bit clock
- clock-names     : A list of audio interface clock names
			* ahbix_clk
			* mi2s_osr_clk
			* mi2s_bit_clk
- interrupts      : Phandle to the LPASS audio interface interrupt
- interrupt-names : The name of the LPASS audio interface interrupt
			* lpass-lpaif-irq
- pinctrl-names : A list of names indicating the state of the MI2S pins
			* mi2s-disabled
			* mi2s-enabled
- pinctrl-0     : The disabled state of the MI2S pins
- pinctrl-1     : The enabled state of the MI2S pins
- reg             : Address space for the LPASS audio interface registers
- reg-names       : The name of the LPASS audio interface register address space
			* lpass-lpaif-mem

Example:

lpass-cpu-mi2s {
	compatible = "qcom,lpass-cpu-dai";
	clocks = <&lcc AHBIX_CLK>, <&lcc MI2S_OSR_CLK>, <&lcc MI2S_BIT_CLK>;
	clock-names = "ahbix_clk", "mi2s_osr_clk", "mi2s_bit_clk";
	interrupts = <0 85 1>;
	interrupt-names = "lpass-lpaif-irq";
	pinctrl-names = "mi2s-disabled", "mi2s_enabled";
	pinctrl-0 = <&mi2s_disabled>;
	pinctrl-1 = <&mi2s_enabled>;
	reg = <0x28100000 0x10000>;
	reg-names = "lpass-lpaif-mem";
};
```

## Documentation/devicetree/bindings/sound/qcom,lpass-cpu.txt
```
* Qualcomm Technologies LPASS CPU DAI

This node models the Qualcomm Technologies LPASS DAI ports.

Required properties:

- compatible		: "qcom,lpass-cpu"
- clocks		: Must contain an entry for each entry in clock-names.
- clock-names		: A list which must include the following entries:
				* "ahbix-clk"
				* "mi2s-osr-clk"
				* "mi2s-bit-clk"
- interrupts		: Must contain an entry for each entry in
			  interrupt-names.
- interrupt-names	: A list which must include the following entries:
				* "lpass-irq-lpaif"
- pinctrl-N		: One property must exist for each entry in
			  pinctrl-names.  See ../pinctrl/pinctrl-bindings.txt
			  for details of the property values.
- pinctrl-names		: Must contain a "default" entry.
- reg			: Must contain an address for each entry in reg-names.
- reg-names		: A list which must include the following entries:
				* "lpass-lpaif"
				* "lpass-lpm"

Optional properties:

- qcom,system-clock-shift		: Add this bool property if the default
					  frequency of the system clock needs to
					  be reduced.
- qcom,system-clock-shift-compare	: A numerical value used to right-shift
					  the default system clock frequency for
					  comparison with the target bit clock
					  frequency.
- qcom,system-clock-shift-amount	: A numerical value used to right-shift
					  the default system clock frequency.
- qcom,alternate-sysclk			: Add this bool property if the default
					  frequency of the system clock cannot
					  divide down to the target bit clock
					  frequency.
- qcom,alternate-sysclk-bitwidth	: A numerical value representing the
					  sample bitwidth which requires use of
					  the alternate system clock frequency.
- qcom,alternate-sysclk-frequency	: A numerical value representing the new
					  system clock frequency to use.

Example:

lpass-cpu@28100000 {
	compatible = "qcom,lpass-cpu";
	clocks = <&lcc AHBIX_CLK>, <&lcc MI2S_OSR_CLK>, <&lcc MI2S_BIT_CLK>;
	clock-names = "ahbix-clk", "mi2s-osr-clk", "mi2s-bit-clk";
	interrupts = <0 85 1>;
	interrupt-names = "lpass-irq-lpaif";
	pinctrl-names = "default", "idle";
	pinctrl-0 = <&mi2s_default>;
	pinctrl-1 = <&mi2s_idle>;
	reg = <0x28100000 0x10000>, <0x28400000 0x4000>;
	reg-names = "lpass-lpaif", "lpass-lpm";
	qcom,system-clock-shift;
	qcom,system-clock-shift-compare = <4>;
	qcom,system-clock-shift-amount = <3>;
	qcom,alternate-sysclk;
	qcom,alternate-systclk-bitwidth = <24>;
	qcom,alternate-systclk-frequency = <4608000>;
};
```

## Documentation/devicetree/bindings/sound/qcom,max98357a-codec.txt
```
Maxim MAX98357A audio DAC

This node models the Maxim MAX98357A DAC as a codec DAI.

Required properties:
- compatible  : "maxim,max98357a-codec"
- sdmode-gpios: Phandle to the GPIO specifier for the GPIO -> DAC SDMODE pin

Example:

max98357a-codec {
	compatible = "maxim,max98357a-codec";
	sdmode-gpios = <&qcom_pinmux 25 0>;
};
```

## Documentation/devicetree/bindings/sound/rockchip,rockchip-audio-hdmi.txt
```
Rockchip hdmi audio bindings

Required properties:
- compatible: platform specific
- i2s-controller: the device of i2s controller

Example:

sound {
	compatible = "rockchip,rk3288-hdmi-audio";
	i2s-controller = <&i2s>;
};
```

## Documentation/devicetree/bindings/sound/rockchip-pdm.txt
```
* Rockchip PDM controller

Required SoC Specific Properties:

- compatible : "rockchip,pdm"
- reg: physical base address of the controller and length of memory mapped
  region.
- clocks: must include clock specifiers corresponding to entries in the
  clock-names property.
- clocks-names: list of clock names sorted in the same order as the clocks
  property. Must contain "pdm_clk" and "pdm_hclk".
- interrupts: interrupt number to the cpu.
- dmas: list of DMA controller phandle and DMA request line ordered pairs.
- dma-names: identifier string for each DMA request line in the dmas property.
  These strings correspond 1:1 with the ordered pairs in dmas.
- pinctrl-names: must contain a "default" entry.
- pinctrl-0: pin control group to be used for this controller.
- pinctrl-1: pin control group to be used for gpio.

Example:

pdm: pdm@ff040000 {
	compatible = "rockchip,pdm";
	reg = <0x0 0xff040000 0x0 0x1000>;
	clocks = <&clk_pdm>, <&clk_gates28 0>;
	clock-names = "pdm_clk", "pdm_hclk";
	dmas = <&pdma 16>;
	#dma-cells = <1>;
	dma-names = "rx";
	pinctrl-names = "default", "sleep";
	pinctrl-0 = <&pdmm0_clk
		     &pdmm0_fsync
		     &pdmm0_sdi0
		     &pdmm0_sdi1
		     &pdmm0_sdi2
		     &pdmm0_sdi3>;
	pinctrl-1 = <&pdmm0_sleep>;
};
```

## Documentation/devicetree/bindings/sound/tas5717.txt
```
Texas Instruments TAS5717/TAS5719 stereo power amplifier

The codec is controlled through an I2C interface.  It also has two other
signals that can be wired up to GPIOs: reset (strongly recommended), and
powerdown (optional).

Required properties:

- compatible: "ti,tas5717"
- reg: The I2C address of the device
- #sound-dai-cells: must be equal to 0

Optional properties:

- reset-gpios: GPIO specifier for the TAS5717's active low reset line
- pdn-gpios: GPIO specifier for the TAS5717's active low powerdown line
- clocks: clock phandle for the MCLK input
- clock-names: should be "mclk"
- VDD-supply: regulator phandle for the AVDD/DVDD/HP_VDD supply
- PVDD-supply: regulator phandle for the PVDD supply

Example:

	tas5717: audio-codec@2a {
		compatible = "ti,tas5717";
		reg = <0x2a>;
		#sound-dai-cells = <0>;

		reset-gpios = <&gpio5 1 GPIO_ACTIVE_HIGH>;
		pdn-gpios = <&gpio5 2 GPIO_ACTIVE_HIGH>;

		clocks = <&clk_core CLK_I2S>;
		clock-names = "mclk";
	};
```

## Documentation/devicetree/bindings/thermal/qcom-thermal.txt
```
* QCOM SoC Temperature Sensor (TSENS)

Required properties:
- compatible : "qcom,qcom-tsens"
- qcom,tsens-slopes : Must contain slope value for each of the sensors controlled
			by this device
- qcom,qfprom : An arry of triplets containing tsens calibration data.
		The first element in the triplet is a phandle
                to qfprom compatible node, second element is an offset to calibration
                data within this node, third element indicates size of calibration
                data. In general, there would be two elements in this array - the
                first containing information on primary calibration data
                and second containing information on backup calibration data
- qcom,qfprom-names : Names for each calibration data
- #thermal-sensor-cells : Should be 1. See ./thermal.txt for a description.

Example:

tsens: tsens-msm8960 {
		compatible = "qcom,qcom-tsens";
		qcom,tsens-slopes = <1176 1176 1154 1176 1111
				1132 1132 1199 1132 1199
				1132>;
		qcom,qfprom = <&imem 0x400 11>, <&imem 0x410 11>;
		qcom,qfprom-names = "calib", "backup_calib";
		#thermal-sensor-cells = <1>;
	};

Example: referring to thermal sensors:
thermal-zones {
	cpu_thermal: cpu_thermal {
		polling-delay-passive = <1000>; /* milliseconds */
		polling-delay = <5000>; /* milliseconds */

		/* sensor ID */
		thermal-sensors = <&tsens 1>;

		trips {
			cpu_alert0: cpu_alert {
				temperature = <80000>; /* millicelsius */
				hysteresis = <2000>; /* millicelsius */
				type = "passive";
			};
			cpu_crit: cpu_crit {
				temperature = <120000>; /* millicelsius */
				hysteresis = <2000>; /* millicelsius */
				type = "critical";
			};
		};

		cooling-maps {
			map0 {
				trip = <&cpu_alert0>;
				cooling-device =
					<&cpu0 THERMAL_NO_LIMIT THERMAL_NO_LIMIT>;
			};
		};
	};
};
```

## Documentation/devicetree/bindings/thermal/rockchip-thermal.txt
```
* Temperature Sensor ADC (TSADC) on rockchip SoCs

Required properties:
- compatible : "rockchip,rk3288-tsadc"
- reg : physical base address of the controller and length of memory mapped
	region.
- interrupts : The interrupt number to the cpu. The interrupt specifier format
	       depends on the interrupt controller.
- clocks : Must contain an entry for each entry in clock-names.
- clock-names : Shall be "tsadc" for the converter-clock, and "apb_pclk" for
		the peripheral clock.
- #thermal-sensor-cells : Should be 1. See ./thermal.txt for a description.
- hw-shut-temp : The hardware-controlled shutdown temperature value.
- tsadc-tshut-mode : The hardware-controlled shutdown mode 0:CRU 1:GPIO.
- tsadc-tshut-polarity : The hardware-controlled active polarity 0:LOW 1:HIGH.

Exiample:
tsadc: tsadc@ff280000 {
	compatible = "rockchip,rk3288-tsadc";
	reg = <0xff280000 0x100>;
	interrupts = <GIC_SPI 37 IRQ_TYPE_LEVEL_HIGH>;
	clocks = <&cru SCLK_TSADC>, <&cru PCLK_TSADC>;
	clock-names = "tsadc", "apb_pclk";
	pinctrl-names = "default";
	pinctrl-0 = <&otp_out>;
	#thermal-sensor-cells = <1>;
	hw-shut-temp = <125000>;
	tsadc-tshut-mode = <0>;
	tsadc-tshut-polarity = <0>;
};

Example: referring to thermal sensors:
thermal-zones {
	cpu_thermal: cpu_thermal {
		polling-delay-passive = <1000>; /* milliseconds */
		polling-delay = <5000>; /* milliseconds */

		/* sensor	ID */
		thermal-sensors = <&tsadc	1>;

		trips {
			cpu_alert0: cpu_alert {
				temperature = <80000>; /* millicelsius */
				hysteresis = <2000>; /* millicelsius */
				type = "passive";
			};
			cpu_crit: cpu_crit {
				temperature = <120000>; /* millicelsius */
				hysteresis = <2000>; /* millicelsius */
				type = "critical";
			};
		};

		cooling-maps {
			map0 {
				trip = <&cpu_alert0>;
				cooling-device =
					<&cpu0 THERMAL_NO_LIMIT THERMAL_NO_LIMIT>;
			};
		};
	};
};
```
