## Documentation/devicetree/bindings/thermal/tegra-soctherm.txt
```
Tegra124 SOCTHERM thermal management system

The SOCTHERM IP block contains thermal sensors, support for polled
or interrupt-based thermal monitoring, CPU and GPU throttling based
on temperature trip points, and handling external overcurrent
notifications. It is also used to manage emergency shutdown in an
overheating situation.

Required properties :
- compatible : "nvidia,tegra124-soctherm" or "nvidia,tegra132-soctherm"
- reg : Should contain at least 2 entry:
  - SOCTHERM register set
  - Tegra CAR register set
  - CCROC register set for Tegra132
- reg-names : Must inclue the following entries:
  - soctherm-reg
  - car-reg
  - ccroc-reg (this is for Tegra132)
- interrupts : Defines the interrupt used by SOCTHERM
- clocks : Must contain an entry for each entry in clock-names.
  See ../clocks/clock-bindings.txt for details.
- clock-names : Must include the following entries:
  - tsensor
  - soctherm
- resets : Must contain an entry for each entry in reset-names.
  See ../reset/reset.txt for details.
- reset-names : Must include the following entries:
  - soctherm
- #thermal-sensor-cells : Should be 1. See ./thermal.txt for a description
    of this property. See <dt-bindings/thermal/tegra124-soctherm.h> for a
    list of valid values when referring to thermal sensors.
- throttle-cfgs: A sub-node which is a container of throttle configs.
- hw-trips : A sub-node which is a container of sensor group.

* throttle-cfgs
* throttle-control:
These node is used to describe the HW throttle info, named as
"light", "heavy", "oc1", "oc2", "oc3", "oc4", "oc5".
"light"/"heavy" correspond to soctherm internal alarm/interrupt event.
"oc1" to "oc5" correspond to specific pins, which connect to the chip.

Required properties:
- priority: Each throttles has its own throttle settings, so the SW need
    to set priorities for various throttle, the HW arbiter can select the
    final throttle settings.
    Bigger value indicates higher priority, In general, higher priority
    translates to lower target frequency. SW needs to ensure that critical
    thermal/OC alarms are given higher priority, and ensure that there is
    no race if priority of two vectors is set to the same value.
- cpu-throt-level: Level of pulse skippers, which used to throttle
    clock frequencies. It indicates cpu clock throttling depth, and
    the depth can be programmed.
    Must set as following values:
    TEGRA_SOCTHERM_THROT_LEVEL_LOW, TEGRA_SOCTHERM_THROT_LEVEL_MED
    TEGRA_SOCTHERM_THROT_LEVEL_HIGH, TEGRA_SOCTHERM_THROT_LEVEL_NONE
Optional properties:
- alarm-filter: Number of clocks to filter event. When the filter expires
   (which means the OC event has not occurred for a long time), the counter
   is cleared and filter is rearmed. Required for OCx.
- alarm-cnt-threshold: Event count threshold to raise interrupt,
    0-rise interrupt for every event. Required for OCx.
- polarity: Alarm polarity, 1-assert low, 0-assert high.
    Required for OCx.

* hw-trips
Required properties:
- sensor-groups : A sub-node which is a container of sensors, used to
    describe the HW trip points.

* sensors:
These node is used to describe the HW trip points info, named as
"cpu", "gpu", "mem", "pll".

Required properties:
- therm-temp : shutdown temperature, once the temperature of this
    sensor higher than the therm-temp, the system will be shutdown.

Optional properties:
- throt-temp : HW throttle temperature, once the temperature of this
    sensor higher then the throt-temp, the HW throttle will be triggered
    in soctherm.


Example :

	soctherm@0,700e2000 {
		compatible = "nvidia,tegra124-soctherm";
		reg = <0x700e2000 0x1000 /* 0: SOC_THERM reg_base */
			0x60006000 0x400 /* 1: T124: CAR reg_base */
			0x70040000 0x200>; /* 2: T132: CCROC reg_base */
		reg-names = "soctherm-reg", "car-reg", "ccroc-reg";
		interrupts = <GIC_SPI 48 IRQ_TYPE_LEVEL_HIGH>;
		clocks = <&tegra_car TEGRA124_CLK_TSENSOR>,
			<&tegra_car TEGRA124_CLK_SOC_THERM>;
		clock-names = "tsensor", "soctherm";
		resets = <&tegra_car 78>;
		reset-names = "soctherm";

		#thermal-sensor-cells = <1>;

		throttle-cfgs {
			heavy {
				alarm-filter = <5100000>;
				alarm-cnt-threshold = <0>;
				polarity = <1>; /* ACTIVE_LOW */
				priority = <100>;
				cpu_throt_level = <TEGRA_SOCTHERM_THROT_LEVEL_HIGH>;
			};
		};

		hw-trips {
			sensor-groups {
				cpu {
					therm-temp = <105000>;
					throt-temp = <101000>;
				};
			};
		};
	};

Example: referring to thermal sensors :

       thermal-zones {
                cpu {
                        polling-delay-passive = <1000>;
                        polling-delay = <1000>;

                        thermal-sensors =
                                <&soctherm TEGRA124_SOCTHERM_SENSOR_CPU>;
                };
	};
```

## Documentation/devicetree/bindings/thermal/tegra-thermal-action.txt
```
* Tegra thermal reaction node
* This device can act as cooling device in of-thermal framework, and can set
* trips and cooling-maps node in the thermal-zones node.
----------------------------------------------------

Tegra DFLL cdev action device.
** Required properties:
- compatible : "nvidia,tegra-dfll-cdev-action".
- act-dev: Node of the device which will implement the real cooling action.
- cdev-type: Name of the cooling device. Valid values are "DFLL-floor" and
             "DFLL-cap".

Note: for the trips, the corresponding temperatures are defined in the
include/dt-bindings/thermal/tegra132-dfll-trips.h.

Tegra CPU-EDP cdev action device.
** Required properties:
- compatible : "nvidia,tegra132-cpu-edp-cdev-action".
- act-dev: Node of the device which will implement the real cooling action.
- cdev-type: Name of the cooling device. Valid value is "CPU-EDP-cap".

Note: for the trips, the corresponding temperatures are defined in the
include/dt-bindings/thermal/tegra-cpu-edp-trips.h.
For the cpu edp trips, there may be a margin on the trip temperature,
so we need to set trip as (TEGRA_CPU_EDP_THERMAL_CAP_* - margin).

Example node:

dfll_floor: dfll_cdev_floor {
	compatible = "nvidia,tegra-dfll-cdev-action";
	act-dev = <&{/dfll@70110000}>;
	cdev-type = "DFLL-floor";
};

cpu_edp_cap: cpu_edp_cdev_cap {
	compatible = "nvidia,tegra132-cpu-edp-cdev-action";
	act-dev = <&cpu_edp>;
	cdev-type = "CPU-EDP-cap";
	#cooling-cells = <2>; /* min followed by max */
};

thermal-zones {
	cpu {
		trips {
			dfll_floor_trip0: dfll_floor_trip0 {
				temperature = <TEGRA132_DFLL_THERMAL_FLOOR_0>; /* millicelsius */
				hysteresis = <1000>; /* millicelsius */
				type = "active";
			};
			cpu_edp_cap_trip0: cpu_edp_cap_trip0 {
				/* margin is 5000,
				 * temperature is TEGRA_CPU_EDP_THERMAL_CAP_0 - 5000
				 */
				temperature = <18000>; /* millicelsius */
				hysteresis = <1000>;
				type = "active";
			};
		};
		cooling-maps {
			map0 {
				trip = <&dfll_floor_trip0>;
				cooling-device = <&dfll_floor 1 1>;
			};
			map1 {
				trip = <&cpu_edp_cap_trip0>;
				cooling-device = <&cpu_edp_cap 1 1>;
			};
		};
	};
};
```

## Documentation/devicetree/bindings/usb/dwc3.txt
```
synopsys DWC3 CORE

DWC3- USB3 CONTROLLER

Required properties:
 - compatible: must be "snps,dwc3"
 - reg : Address and length of the register set for the device
 - interrupts: Interrupts used by the dwc3 controller.

Optional properties:
 - usb-phy : array of phandle for the PHY device.  The first element
   in the array is expected to be a handle to the USB2/HS PHY and
   the second element is expected to be a handle to the USB3/SS PHY
 - phys: from the *Generic PHY* bindings
 - phy-names: from the *Generic PHY* bindings
 - tx-fifo-resize: determines if the FIFO *has* to be reallocated.
 - snps,usb3_lpm_capable: determines if platform is USB3 LPM capable
 - snps,u2ss_inp3_quirk: set if we enable P3 OK for U2/SS Inactive quirk
 - snps,dis_enblslpm_quirk: when set clears the enblslpm in GUSB2PHYCFG,
			disabling the suspend signal to the PHY.
 - snps,dis-u3-autosuspend-quirk: when set USB core driver will disable
			USB3 autosuspend function.
 - snps,dis_u3_susphy_quirk: when set core will disable USB3 suspend phy.
 - snps,dis_u2_susphy_quirk: when set core will disable USB2 suspend phy.
 - snps,dis-u2-freeclk-exists-quirk: when set, clear the u2_freeclk_exists
			in GUSB2PHYCFG, specify that USB2 PHY doesn't provide
			a free-running PHY clock.
 - snps,del_phy_power_chg_quirk: when set core will delay PHY power change
			from P0 to P1/P2/P3.
 - snps,dis-del-phy-power-chg-quirk: when set core will change PHY power
			from P0 to P1/P2/P3 without delay.
 - snps,tx-ipgap-linecheck-dis-quirk: when set, disable u2mac linestate check
			during HS transmit.

This is usually a subnode to DWC3 glue to which it is connected.

dwc3@4a030000 {
	compatible = "snps,dwc3";
	reg = <0x4a030000 0xcfff>;
	interrupts = <0 92 4>
	usb-phy = <&usb2_phy>, <&usb3,phy>;
	tx-fifo-resize;
};
```

## Documentation/devicetree/bindings/usb/hynetek,husb311.txt
```
Hynetek Husb311 Type-C Port controllers DT bindings

Required properties:
- compatible:       hynetek,husb311

- reg:              the i2c slave address of typec port controller device.
- interrupt-parent: the phandle to the interrupt controller which provides
                    the interrupt.
- interrupts:       interrupt specification for tcpci alert.
- vbus-supply:      vbus regulator

Required sub-node:
- connector: The "usb-c-connector" attached to the tcpci chip, the bindings
  of connector node are specified in
  Documentation/devicetree/bindings/connector/usb-connector.txt

Example:

#include "dt-bindings/usb/pd.h"

husb0: husb311@4e {
	compatible = "hynetek,husb311";
	reg = <0x4e>;
	interrupt-parent = <&gpio1>;
	interrupts = <2 IRQ_TYPE_LEVEL_LOW>;
	vbus-supply = <&vcc5v0_typec>;
	status = "okay";

	usb_con: connector {
		data-role = "dual";
		power-role = "dual";
		try-power-role = "sink";
		source-pdos = <PDO_FIXED(5000, 2000, PDO_FIXED_USB_COMM)>;
		sink-pdos = <PDO_FIXED(5000, 2000, PDO_FIXED_USB_COMM)>;
		op-sink-microwatt = <10000000>;

	};
};
```

## Documentation/devicetree/bindings/usb/nvidia,tegra-xhci.txt
```
Tegra SOC XHCI controller

The device node for the Tegra XHCI host controller.

Required properties:
 - compatible: Should be "nvidia,tegra114-xhci" or "nvidia,tegra124-xhci" for
   XHCI controllers used in host mode.
 - reg: Address and length of the register sets.  There should be three
   entries in the following order: XHCI host registers, FPCI registers, and
   IPFS registers.
 - interrupts: Interrupts used by the controller.  There should be two
   entries in the following order: XHCI host interrupt and firmware mailbox
   interrupt.
 - clocks: Handles to XUSB host, falcon, and EMC clocks.
 - clock-names: Should be "xusb_host", "xusb_falcon_src", and "xusb.emc"
   respectively.
 - nvidia,xusb-phy: Handle to the corresponding XUSB PHY.
 - s1p05v-supply: 1.05V supply regulator.
 - s1p8v-supply: 1.8V supply regulator.
 - s3p3v-supply: 3.3V supply regulator.

Example:
	usb@70090000 {
		compatible = "nvidia,tegra124-xhci";
		reg = <0x0 0x70090000 0x8000>,
		      <0x0 0x70098000 0x1000>,
		      <0x0 0x70099000 0x1000>;
		interrupts = <GIC_SPI 39 IRQ_TYPE_LEVEL_HIGH>,
			     <GIC_SPI 40 IRQ_TYPE_LEVEL_HIGH>;
		clocks = <&tegra_car TEGRA124_CLK_XUSB_HOST>,
			 <&tegra_car TEGRA124_CLK_XUSB_FALCON_SRC>,
			 <&tegra_car TEGRA124_CLK_XUSB_EMC>;
		clock-names = "xusb_host", "xusb_falcon_src", "xusb.emc";
		nvidia,xusb-phy = <&xusb_phy>;
		s3p3v-supply = <&_3v3_lp0>;
		s1p8v-supply = <&vddio_1v8>;
		s1p05v-supply = <&avdd_hdmi_pex>;
		status = "okay";
	};
```
