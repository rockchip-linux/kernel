## arch/arm64/configs/rk3326_linux_robot_defconfig
```kconfig
# CONFIG_LOCALVERSION_AUTO is not set
CONFIG_DEFAULT_HOSTNAME="localhost"
CONFIG_SYSVIPC=y
CONFIG_FHANDLE=y
CONFIG_NO_HZ=y
CONFIG_HIGH_RES_TIMERS=y
CONFIG_LOG_CPU_MAX_BUF_SHIFT=10
CONFIG_CGROUPS=y
CONFIG_CGROUP_FREEZER=y
CONFIG_CGROUP_DEVICE=y
CONFIG_CPUSETS=y
CONFIG_CGROUP_CPUACCT=y
CONFIG_CGROUP_SCHED=y
CONFIG_CFS_BANDWIDTH=y
CONFIG_NAMESPACES=y
CONFIG_USER_NS=y
CONFIG_RELAY=y
CONFIG_BLK_DEV_INITRD=y
# CONFIG_RD_BZIP2 is not set
# CONFIG_RD_LZMA is not set
# CONFIG_RD_XZ is not set
# CONFIG_RD_LZO is not set
# CONFIG_RD_LZ4 is not set
CONFIG_CC_OPTIMIZE_FOR_SIZE=y
CONFIG_EMBEDDED=y
# CONFIG_SLUB_DEBUG is not set
# CONFIG_COMPAT_BRK is not set
CONFIG_PROFILING=y
CONFIG_JUMP_LABEL=y
CONFIG_MODULES=y
CONFIG_MODULE_UNLOAD=y
# CONFIG_BLK_DEV_BSG is not set
CONFIG_PARTITION_ADVANCED=y
# CONFIG_MSDOS_PARTITION is not set
# CONFIG_RK_PARTITION is not set
# CONFIG_IOSCHED_DEADLINE is not set
# CONFIG_IOSCHED_CFQ is not set
CONFIG_ARCH_ROCKCHIP=y
# CONFIG_ARM64_ERRATUM_826319 is not set
# CONFIG_ARM64_ERRATUM_827319 is not set
# CONFIG_ARM64_ERRATUM_824069 is not set
# CONFIG_ARM64_ERRATUM_819472 is not set
# CONFIG_ARM64_ERRATUM_832075 is not set
# CONFIG_CAVIUM_ERRATUM_22375 is not set
# CONFIG_CAVIUM_ERRATUM_23154 is not set
CONFIG_SCHED_MC=y
CONFIG_NR_CPUS=4
CONFIG_PREEMPT=y
CONFIG_HZ_1000=y
# CONFIG_SPARSEMEM_VMEMMAP is not set
# CONFIG_COMPACTION is not set
CONFIG_DEFAULT_MMAP_MIN_ADDR=32768
CONFIG_ZSMALLOC=y
CONFIG_SECCOMP=y
CONFIG_ARMV8_DEPRECATED=y
CONFIG_SWP_EMULATION=y
CONFIG_CP15_BARRIER_EMULATION=y
CONFIG_SETEND_EMULATION=y
# CONFIG_EFI is not set
CONFIG_COMPAT=y
# CONFIG_WAKELOCK is not set
CONFIG_PM_DEBUG=y
CONFIG_PM_ADVANCED_DEBUG=y
CONFIG_WQ_POWER_EFFICIENT_DEFAULT=y
CONFIG_CPU_IDLE=y
# CONFIG_CPU_IDLE_GOV_LADDER is not set
CONFIG_ARM_CPUIDLE=y
CONFIG_CPU_FREQ=y
CONFIG_CPU_FREQ_DEFAULT_GOV_INTERACTIVE=y
CONFIG_CPU_FREQ_GOV_PERFORMANCE=y
CONFIG_CPU_FREQ_GOV_POWERSAVE=y
CONFIG_CPU_FREQ_GOV_USERSPACE=y
CONFIG_CPUFREQ_DT=y
CONFIG_ARM_ROCKCHIP_CPUFREQ=y
CONFIG_NET=y
CONFIG_PACKET=y
CONFIG_UNIX=y
CONFIG_NET_KEY=y
CONFIG_INET=y
CONFIG_SYN_COOKIES=y
# CONFIG_INET_XFRM_MODE_TRANSPORT is not set
# CONFIG_INET_XFRM_MODE_TUNNEL is not set
# CONFIG_INET_XFRM_MODE_BEET is not set
# CONFIG_INET_LRO is not set
# CONFIG_INET_DIAG is not set
# CONFIG_IPV6 is not set
# CONFIG_ANDROID_PARANOID_NETWORK is not set
CONFIG_CFG80211_WEXT=y
CONFIG_RFKILL=y
CONFIG_DEVTMPFS=y
CONFIG_DEVTMPFS_MOUNT=y
# CONFIG_FIRMWARE_IN_KERNEL is not set
# CONFIG_ALLOW_DEV_COREDUMP is not set
CONFIG_ZRAM=y
CONFIG_NETDEVICES=y
# CONFIG_ETHERNET is not set
CONFIG_WL_ROCKCHIP=y
CONFIG_WIFI_BUILD_MODULE=y
CONFIG_AP6XXX=m
# CONFIG_RTL_WIRELESS_SOLUTION is not set
# CONFIG_INPUT_MOUSEDEV is not set
CONFIG_INPUT_EVDEV=y
CONFIG_KEYBOARD_ADC=y
# CONFIG_KEYBOARD_ATKBD is not set
CONFIG_KEYBOARD_GPIO=y
# CONFIG_INPUT_MOUSE is not set
CONFIG_INPUT_MISC=y
CONFIG_INPUT_RK8XX_PWRKEY=y
# CONFIG_SERIO is not set
CONFIG_VT_HW_CONSOLE_BINDING=y
CONFIG_DEVPTS_MULTIPLE_INSTANCES=y
# CONFIG_LEGACY_PTYS is not set
# CONFIG_DEVKMEM is not set
CONFIG_SERIAL_8250=y
CONFIG_SERIAL_8250_CONSOLE=y
CONFIG_SERIAL_8250_NR_UARTS=6
CONFIG_SERIAL_8250_RUNTIME_UARTS=6
CONFIG_SERIAL_8250_DW=y
CONFIG_SERIAL_OF_PLATFORM=y
CONFIG_HW_RANDOM=y
CONFIG_HW_RANDOM_ROCKCHIP=y
CONFIG_I2C_CHARDEV=y
CONFIG_I2C_MUX=y
CONFIG_I2C_RK3X=y
CONFIG_SPI=y
CONFIG_SPI_BITBANG=y
CONFIG_SPI_ROCKCHIP=y
CONFIG_PINCTRL_RK805=y
CONFIG_GPIO_SYSFS=y
CONFIG_GPIO_GENERIC_PLATFORM=y
CONFIG_GPIO_RK8XX=y
CONFIG_BATTERY_RK817=y
CONFIG_CHARGER_RK817=y
CONFIG_SYSCON_REBOOT_MODE=y
CONFIG_POWER_AVS=y
CONFIG_ROCKCHIP_IODOMAIN=y
# CONFIG_HWMON is not set
CONFIG_THERMAL=y
CONFIG_THERMAL_WRITABLE_TRIPS=y
CONFIG_THERMAL_DEFAULT_GOV_POWER_ALLOCATOR=y
CONFIG_THERMAL_GOV_FAIR_SHARE=y
CONFIG_THERMAL_GOV_STEP_WISE=y
CONFIG_CPU_THERMAL=y
CONFIG_DEVFREQ_THERMAL=y
CONFIG_ROCKCHIP_THERMAL=y
CONFIG_WATCHDOG=y
CONFIG_DW_WATCHDOG=y
CONFIG_MFD_RK808=y
CONFIG_REGULATOR=y
CONFIG_REGULATOR_FIXED_VOLTAGE=y
CONFIG_REGULATOR_GPIO=y
CONFIG_REGULATOR_PWM=y
CONFIG_REGULATOR_RK808=y
CONFIG_MEDIA_SUPPORT=y
CONFIG_MEDIA_CAMERA_SUPPORT=y
CONFIG_MEDIA_CONTROLLER=y
CONFIG_VIDEO_V4L2_SUBDEV_API=y
CONFIG_V4L_PLATFORM_DRIVERS=y
CONFIG_VIDEO_ROCKCHIP_ISP1=y
CONFIG_V4L_MEM2MEM_DRIVERS=y
# CONFIG_MEDIA_SUBDRV_AUTOSELECT is not set
CONFIG_VIDEO_OV5695=y
# CONFIG_VIDEO_GC2355 is not set
# CONFIG_VIDEO_SC031GS is not set
CONFIG_VIDEO_ROCKCHIP_PREISP=y
# CONFIG_DVB_AU8522_V4L is not set
# CONFIG_DVB_TUNER_DIB0070 is not set
# CONFIG_DVB_TUNER_DIB0090 is not set
CONFIG_DRM=y
CONFIG_DRM_LOAD_EDID_FIRMWARE=y
CONFIG_DRM_DMA_SYNC=y
CONFIG_DRM_ROCKCHIP=y
CONFIG_MALI_PWRSOFT_765=y
CONFIG_MALI_BIFROST_FOR_LINUX=y
CONFIG_MALI_BIFROST=y
CONFIG_MALI_BIFROST_DEVFREQ=y
CONFIG_MALI_PLATFORM_NAME="rk"
CONFIG_MALI_BIFROST_EXPERT=y
CONFIG_ROCKCHIP_RGA2=y
CONFIG_RK_VCODEC=y
CONFIG_ROCKCHIP_MPP_SERVICE=y
CONFIG_ROCKCHIP_MPP_DEVICE=y
CONFIG_SOUND=y
CONFIG_SND=y
# CONFIG_SND_PCM_TIMER is not set
# CONFIG_SND_SUPPORT_OLD_API is not set
# CONFIG_SND_PROC_FS is not set
# CONFIG_SND_DRIVERS is not set
# CONFIG_SND_SPI is not set
CONFIG_SND_SOC=y
CONFIG_SND_SOC_ROCKCHIP=y
CONFIG_SND_SOC_ROCKCHIP_I2S=y
CONFIG_SND_SOC_RK817=y
CONFIG_SND_SIMPLE_CARD=y
# CONFIG_HID is not set
CONFIG_USB_DWC2=y
CONFIG_USB_GADGET=y
CONFIG_USB_GADGET_VBUS_DRAW=500
CONFIG_USB_CONFIGFS=y
CONFIG_USB_CONFIGFS_F_FS=y
CONFIG_USB_CONFIGFS_UEVENT=y
CONFIG_USB_CONFIGFS_F_UVC=y
CONFIG_MMC=y
CONFIG_MMC_BLOCK_MINORS=32
CONFIG_MMC_DW=y
CONFIG_MMC_DW_ROCKCHIP=y
CONFIG_RTC_CLASS=y
CONFIG_RTC_DRV_RK808=y
CONFIG_DMADEVICES=y
CONFIG_PL330_DMA=y
CONFIG_STAGING=y
# CONFIG_ANDROID_TIMED_OUTPUT is not set
CONFIG_FIQ_DEBUGGER=y
CONFIG_FIQ_DEBUGGER_NO_SLEEP=y
CONFIG_FIQ_DEBUGGER_CONSOLE=y
CONFIG_FIQ_DEBUGGER_CONSOLE_DEFAULT_ENABLE=y
CONFIG_COMMON_CLK_RK808=y
# CONFIG_COMMON_CLK_XGENE is not set
CONFIG_ROCKCHIP_IOMMU=y
# CONFIG_CPU_RK3328 is not set
# CONFIG_CPU_RK3368 is not set
# CONFIG_CPU_RK3399 is not set
CONFIG_ROCKCHIP_PM_DOMAINS=y
CONFIG_ROCKCHIP_PVTM=y
CONFIG_ROCKCHIP_SUSPEND_MODE=y
CONFIG_PM_DEVFREQ=y
CONFIG_DEVFREQ_GOV_PERFORMANCE=y
CONFIG_DEVFREQ_GOV_POWERSAVE=y
CONFIG_DEVFREQ_GOV_USERSPACE=y
CONFIG_ARM_ROCKCHIP_BUS_DEVFREQ=y
CONFIG_ARM_ROCKCHIP_DMC_DEVFREQ=y
CONFIG_PM_DEVFREQ_EVENT=y
CONFIG_IIO=y
CONFIG_ROCKCHIP_SARADC=y
CONFIG_PWM=y
CONFIG_PWM_ROCKCHIP=y
CONFIG_PHY_ROCKCHIP_INNO_USB2=y
CONFIG_ANDROID=y
CONFIG_NVMEM=y
CONFIG_ROCKCHIP_OTP=y
CONFIG_RK_FLASH=y
CONFIG_RK_NANDC_NAND=y
CONFIG_ROCKCHIP_SIP=y
CONFIG_EXT4_FS=y
CONFIG_EXT4_FS_POSIX_ACL=y
CONFIG_EXT4_FS_SECURITY=y
# CONFIG_DNOTIFY is not set
CONFIG_VFAT_FS=m
CONFIG_FAT_DEFAULT_CODEPAGE=936
CONFIG_FAT_DEFAULT_IOCHARSET="utf8"
CONFIG_TMPFS=y
CONFIG_TMPFS_POSIX_ACL=y
CONFIG_SQUASHFS=y
CONFIG_PSTORE=y
CONFIG_PSTORE_CONSOLE=y
CONFIG_PSTORE_RAM=y
# CONFIG_NETWORK_FILESYSTEMS is not set
CONFIG_NLS_DEFAULT="utf8"
CONFIG_PRINTK_TIME=y
CONFIG_DYNAMIC_DEBUG=y
CONFIG_DEBUG_INFO=y
CONFIG_DEBUG_FS=y
CONFIG_MAGIC_SYSRQ=y
CONFIG_MAGIC_SYSRQ_DEFAULT_ENABLE=0
CONFIG_LOCKUP_DETECTOR=y
CONFIG_BOOTPARAM_HARDLOCKUP_PANIC=y
CONFIG_BOOTPARAM_SOFTLOCKUP_PANIC=y
CONFIG_BOOTPARAM_HUNG_TASK_PANIC=y
CONFIG_SCHEDSTATS=y
CONFIG_TIMER_STATS=y
CONFIG_DEBUG_SPINLOCK=y
CONFIG_STACKTRACE=y
CONFIG_DEBUG_CREDENTIALS=y
CONFIG_RCU_CPU_STALL_TIMEOUT=60
# CONFIG_FTRACE is not set
CONFIG_LKDTM=y
CONFIG_STRICT_DEVMEM=y
# CONFIG_CRYPTO_ECHAINIV is not set
CONFIG_CRYPTO_ANSI_CPRNG=y
CONFIG_CRYPTO_USER_API_HASH=y
CONFIG_CRYPTO_USER_API_SKCIPHER=y
CONFIG_ARM64_CRYPTO=y
CONFIG_CRYPTO_SHA1_ARM64_CE=y
CONFIG_CRYPTO_SHA2_ARM64_CE=y
CONFIG_CRYPTO_GHASH_ARM64_CE=y
CONFIG_CRYPTO_AES_ARM64_CE_CCM=y
CONFIG_CRYPTO_AES_ARM64_CE_BLK=y
```

## arch/arm64/configs/rk356x_defconfig
```kconfig
# Sample rk356x_defconfig for RK3566

# Basic architecture configuration
CONFIG_ARCH_ROCKCHIP=y
CONFIG_ARCH_ARM64=y
CONFIG_ARCH_MULTI_V7=y
CONFIG_ARM64=y
CONFIG_ARM64_32=y
CONFIG_ARM64_64=y
CONFIG_ARM64_PA_BITS=40
CONFIG_ARM64_VA_BITS=48
CONFIG_ARMV8_DEPRECATED=y
CONFIG_ARMV8_CRYPTO=y

# CPU features
CONFIG_CPU_PABRT=y
CONFIG_CPU_PAN=y
CONFIG_CPU_V7=y
CONFIG_CPU_V8=y

# Memory configuration
CONFIG_ARM64_COHERENT_POOL=y
CONFIG_PHYS_ADDR_T_64BIT=y
CONFIG_ARM64_PA_BITS=40

# Rockchip specific configuration
CONFIG_ROCKCHIP_PHY=y
CONFIG_ROCKCHIP_VOP=y
CONFIG_ROCKCHIP_DRM=y
CONFIG_ROCKCHIP_HDMI=y
CONFIG_ROCKCHIP_RGA=y
CONFIG_ROCKCHIP_CE=y
CONFIG_ROCKCHIP_SDMA=y

# Kernel features
CONFIG_NETFILTER=y
CONFIG_NETFILTER_ADVANCED=y
CONFIG_INET=y
CONFIG_IP_NF_IPTABLES=y
CONFIG_IP_NF_TARGET_MASQUERADE=y
CONFIG_IPV6=y
CONFIG_INET6=y
CONFIG_NETDEVICES=y
CONFIG_PACKET=y
CONFIG_UNIX=y

# File system support
CONFIG_EXT4_FS=y
CONFIG_F2FS_FS=y
CONFIG_SQUASHFS=y
CONFIG_FUSE_FS=y
CONFIG_OVERLAY_FS=y

# Power management
CONFIG_PM=y
CONFIG_PM_SLEEP=y
CONFIG_ARM64_CPU_IDLE=y
CONFIG_ARM64_RAS=y

# Debugging
CONFIG_DEBUG_INFO=y
CONFIG_KGDB=y
CONFIG_KDB=y

# Networking
CONFIG_NET=y
CONFIG_NETFILTER=y
CONFIG_NETFILTER_XT_MATCH_IPVS=y

# Generic defconfig
CONFIG_CMDLINE="root=/dev/mmcblk0p2 rootwait rw"

# DMA configuration
CONFIG_DMA_BUF=y
CONFIG_DMA_SHARED_BUFFER=y

# Enable USART (UART) ports
# Enabling driver support for UART
CONFIG_SERIAL_8250=y
CONFIG_SERIAL_8250_CONSOLE=y
CONFIG_SERIAL_8250_RUNTIME_UARTS=4  # Change this to the number of UARTs you have
CONFIG_SERIAL_8250_DW=y

# Enable specific USART port driver
CONFIG_SERIAL_8250_PNP=y
CONFIG_SERIAL_8250_RSA=y  # For Rockchip-specific UART support (if applicable)
CONFIG_SERIAL_8250_RSA_NR_PORTS=4  # Change this to your port number if needed

# Enable specific console ports for UART (use ttyS0, ttyS1, etc.)
CONFIG_CONSOLE_POLL=y
CONFIG_SERIAL_8250_PNP=y
CONFIG_SERIAL_8250_EXTENDED=y

# Enable DMA for UARTs if needed
CONFIG_SERIAL_8250_DMA=y

# Ensure all ports are enabled for use (if not specified, you might need to check with hardware configuration)
CONFIG_SERIAL_8250_NR_UARTS=4  # Change this based on how many UART ports you have
CONFIG_SERIAL_8250_SHARE_IRQ=y

# Enable debugging for serial (optional)
CONFIG_SERIAL_DEBUG=y

# Miscellaneous kernel options
CONFIG_ZLIB_DEFLATE=y
CONFIG_SQUASHFS=y

# Enable DMA and DMA Buffer Subsystem
CONFIG_DMA_ENGINE=y
CONFIG_DMA_VIRTUAL=y
CONFIG_DMA_DIRECT=y

# Enable specific Rockchip DMA options (if applicable)
CONFIG_ROCKCHIP_DMA=y
CONFIG_ROCKCHIP_DRM_DMA=y

# Ensure proper support for `dma-buf` buffer management
CONFIG_DMA_BUF=y
CONFIG_DMA_SHARED_BUFFER=y
CONFIG_DMA_CMA=y  # Contiguous Memory Allocator for DMA
CONFIG_DMA_API=y  # Enable the DMA API interface
```

## drivers/amba/Kconfig
```kconfig
comment "AMBA bus drivers"

config TEGRA_AHB
	bool "Enable AHB driver for NVIDIA Tegra SoCs"
	default ARCH_TEGRA
	help
	  Adds AHB configuration functionality for NVIDIA Tegra SoCs,
	  which controls AHB bus master arbitration and some
	  performance parameters(priority, prefech size).
```

## drivers/crypto/rockchip/Kconfig
```kconfig
config CRYPTO_DEV_ROCKCHIP_ENCRYPT
	bool "Encryption acceleration support"
	select CRYPTO_AES
	select CRYPTO_TDES
	select CRYPTO_HASH
	select CRYPTO_RSA

	help
	  Say Y here to support for Rockchip encryption acceleration.
	  This module supports acceleration for AES(ecb/cbc/ctr),
	  DES/TDES(ecb/cbc), HASH(sha1/sha256/md5) and RSA algorithms.

	  Say N here if you don't want to use the processor.
```

## drivers/devfreq/rockchip/Kconfig
```kconfig
config ARM_RK3288_DMC_DEVFREQ
	tristate "ARM RK3288 DMC DEVFREQ Driver"
	depends on ARCH_ROCKCHIP
	select ARCH_HAS_OPP
	select DEVFREQ_GOV_SIMPLE_ONDEMAND
	help
	  This adds the DEVFREQ driver for the RK3288 dmc. It sets the frequency
	  for the memory controller and reads the usage counts from hardware.
```

## drivers/firmware/google/Kconfig
```kconfig
config GOOGLE_FIRMWARE
	bool "Google Firmware Drivers"
	default n
	help
	  These firmware drivers are used by Google's servers.  They are
	  only useful if you are working directly on one of their
	  proprietary servers.  If in doubt, say "N".

menu "Google Firmware Drivers"
	depends on GOOGLE_FIRMWARE

config GOOGLE_SMI
	tristate "SMI interface for Google platforms"
	depends on X86 && ACPI && DMI
	help
	  Say Y here if you want to enable SMI callbacks for Google
	  platforms.  This provides an interface for writing to and
	  clearing the event log.  If EFI_VARS is also enabled this
	  driver provides an interface for reading and writing NVRAM
	  variables.

config GOOGLE_COREBOOT_TABLE
	tristate "Coreboot Table Access"
	depends on OF
	help
	  This option enable the coreboot_table module, which provide other
	  firmware modules to access coreboot table.

config GOOGLE_MEMCONSOLE_X86
	tristate "Firmware Memory Console - X86"
	depends on X86 && ACPI && DMI
	help
	  This option enables the kernel to search for a firmware log in
	  the EBDA / ACPI on Google servers on x86.  If found, this log is
	  exported to userland in the file /sys/firmware/log.

config GOOGLE_MEMCONSOLE_OF
	tristate "Firmware Memory Console - OF"
	depends on GOOGLE_COREBOOT_TABLE
	help
	  This option enables the kernel to search for a firmware log on
	  coreboot platforms using device tree.  If found, this log is exported
	  to userland in the file /sys/firmware/log.

config GOOGLE_VPD
	tristate "Vital Product Data"
	depends on GOOGLE_COREBOOT_TABLE
	help
	  This option enables the kernel to expose the content of Google VPD
	  under /sys/firmware/vpd.

endmenu
```

## drivers/gpu/drm/rockchip/Kconfig
```kconfig
config DRM_ROCKCHIP
	tristate "DRM Support for Rockchip"
	depends on DRM && ROCKCHIP_IOMMU && ARM_DMA_USE_IOMMU && IOMMU_API
	select DRM_KMS_HELPER
	select DRM_KMS_FB_HELPER
	select DRM_PANEL
	select FB_CFB_FILLRECT
	select FB_CFB_COPYAREA
	select FB_CFB_IMAGEBLIT
	select VT_HW_CONSOLE_BINDING if FRAMEBUFFER_CONSOLE
	select VIDEOMODE_HELPERS
	help
	  Choose this option if you have a Rockchip soc chipset.
	  This driver provides kernel mode setting and buffer
	  management to userspace. This driver does not provide
	  2D or 3D acceleration; acceleration is performed by other
	  IP found on the SoC.

config ROCKCHIP_DW_HDMI
	bool "Rockchip specific extensions for Synopsys DW HDMI"
	depends on DRM_ROCKCHIP
	select DRM_DW_HDMI
	help
	 This selects support for Rockchip SoC specific extensions
	 for the Synopsys DesignWare HDMI driver. If you want to
	 enable HDMI on RK3288 based SoC, you should selet this
	 option.

config ROCKCHIP_EDP
	bool "Rockchip edp support"
	depends on DRM_ROCKCHIP
	help
	  Choose this option if you have a Rockchip eDP.
	  Rockchip rk3288 SoC has eDP TX Controller can be used.
	  If you have an Embedded DisplayPort Panel, say Y to enable its
	  driver.
```

## drivers/gpu/drm/rockchip/ebc-dev/Kconfig
```kconfig
# SPDX-License-Identifier: GPL-2.0

menuconfig ROCKCHIP_EBC_DEV
	bool "Rockchip eBook Device Driver"
	help
	Rockchip eBook Device Dirver could help to driver the electronic ink screen.

config EPD_TPS65185_SENSOR
    bool "eink pmic Tps65185"
    depends on ROCKCHIP_EBC_DEV
    default y
```

## drivers/iio/imu/inv_icm40605/Kconfig
```kconfig
# SPDX-License-Identifier: GPL-2.0
# Copyright (C) 2021 Rockchip Electronics Co., Ltd
#
# ICM40605 IMU driver
#

config ICM40605
	tristate
	select IIO_BUFFER
	select IIO_TRIGGERED_BUFFER

config ICM40605_I2C
	tristate "Invensense ICM40605 I2C driver"
	depends on I2C
	select ICM40605
	select REGMAP_I2C
	help
	  If you say yes here you get support for ICM40605 IMU on I2C with
	  accelerometer, gyroscope.

	  This driver can also be built as a module. If so, the module will be
	  called ICM40605_i2c.

config ICM40605_SPI
	tristate "Invensense ICM40605 SPI driver"
	depends on SPI
	select ICM40605
	select REGMAP_SPI
	help
	  If you say yes here you get support for ICM40605 IMU on SPI with
	  accelerometer, gyroscope.

	  This driver can also be built as a module. If so, the module will be
	  called ICM40605_spi.
```
