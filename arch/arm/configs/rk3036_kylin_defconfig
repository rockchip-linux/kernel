## drivers/input/remotectl/Kconfig
```kconfig
# SPDX-License-Identifier: GPL-2.0
#
# Input remotectl driver configuration
#
menuconfig ROCKCHIP_REMOTECTL
	bool "rockchip remotectl"
	default n
	help
	  Say Y here, will suport rk remotectl.
	  This option doesn't affect the kernel.
	  If unsure, say Y.

if ROCKCHIP_REMOTECTL

config ROCKCHIP_REMOTECTL_PWM
	bool "rockchip remoctrl pwm capture"
	default n

config RK_IR_NO_DEEP_SLEEP
    bool "rk_pwm-remoctrl no Deep Sleep"
    depends on ROCKCHIP_REMOTECTL
    default n

endif
```

## drivers/input/sensors/accel/da380/Kconfig
```kconfig
#
# I2C gsensor chip drivers configuration
#

config SENSORS_DA380
	bool "DA380 acceleration sensor support"
	default n
	help
	  If you say yes here you get support for Bosch Sensortec's
	  acceleration sensors DA380.
```

## drivers/input/touchscreen/friendlyelec/Kconfig
```kconfig
#
# Touchscreen driver configuration
#

menuconfig TOUCHSCREEN_FE_PANELS
	bool "Support for FriendlyElec Panels"

if TOUCHSCREEN_FE_PANELS

config TOUCHSCREEN_GT9XX
	tristate "Goodix GT9xx touchscreen driver"
	depends on I2C
	default n
	help
	  Say Y here if you have the Goodix GT9xx touchscreen.

	  If unsure, say N.

choice
prompt "Select Touch Protocol"
depends on TOUCHSCREEN_GT9XX
default TOUCHSCREEN_PROT_MT_SLOT

config TOUCHSCREEN_PROT_MT_SYNC
	bool "Multi-touch Protocol A"
	help
	  This enables the stateless type A protocol for QT + tslib.

config TOUCHSCREEN_PROT_MT_SLOT
	bool "Multi-touch Protocol B"
	help
	  This enables the stateful type B slot protocol for Android.

config TOUCHSCREEN_PROT_SINGLE
	bool "Single-touch Protocol"
	help
	  This disables multi-touch mode for Debian (xserver-xorg-input-evdev).

endchoice

endif
```

## drivers/input/touchscreen/gt910/Kconfig
```kconfig
config TOUCHSCREEN_GT910
	tristate "goodix gt910 touchscreen"
	depends on I2C
	help
	  Say Y here if you have a goodix gt910 touchscreen.
```

## drivers/media/i2c/soc_camera/rockchip/Kconfig
```kconfig
config VIDEO_OV8858
	tristate "ov8858 driver adapt to rockchip cif isp platform"
	depends on VIDEO_V4L2 && VIDEO_RK_CIF_ISP11 && I2C
	default n
	---help---
	  This is ov8858 camera driver adapt to rockchip cif isp platform.

config VIDEO_OV2710
	tristate "ov2710 driver adapt to rockchip cif isp platform"
	depends on VIDEO_V4L2 && VIDEO_RK_CIF_ISP11 && I2C
	default n
	---help---
	  This is ov2710 camera driver adapt to rockchip cif isp platform.
```

## drivers/media/pci/go2001/Kconfig
```kconfig
config VIDEO_GO2001
	tristate "GO2001 codec driver"
	depends on VIDEO_V4L2 && PCI
	select VIDEOBUF2_DMA_SG
	---help---
	  Support for GO2001 codec.
```

## drivers/media/platform/rk-cif/Kconfig
```kconfig
#
#rk cif
#
menuconfig VIDEO_RK_CIF_CIF10
	tristate "Rockchip cif cif10 camera sensors"
	depends on VIDEO_V4L2 && I2C
	select VIDEOBUF_GEN
	select VIDEOBUF_DMA_CONTIG
	select VIDEOBUF_VMALLOC
	default n
	---help---
	  Say Y here to enable selecting the
	  rockchip cif isp10 camera sensors

choice
	prompt "select cif work mode"
	depends on VIDEO_RK_CIF_CIF10
	default CIF_PINGPONG_MODE

config CIF_PINGPONG_MODE
	bool "pingpong mode"
	depends on VIDEO_RK_CIF_CIF10
	---help---
	  Say Y here to enable cif work on pingpong mode

config CIF_ONEFRAME_MODE
	bool "oneframe mode"
	depends on VIDEO_RK_CIF_CIF10
	---help---
	  Say Y here to enable cif work on oneframe mode

endchoice

config VIDEO_CVBSIN
	tristate "cif cvbs in"
	depends on VIDEO_V4L2
	default n
	---help---
	  Say Y here to enable selecting the
	  rockchip cif cvbs in

config VIDEO_CIF1TO4
	tristate "cif1to4"
	depends on VIDEO_V4L2
	default n
	---help---
	  Say Y here to enable selecting the
	  rockchip cif1to4

config VIDEO_NVP6124
	tristate "nvp6124"
	depends on VIDEO_V4L2
	default n
	---help---
	  Say Y here to enable selecting the
	  rockchip cif cvbs in
```

## drivers/media/platform/rk-isp11/Kconfig
```kconfig
config VIDEO_RK_CIF_ISP11
	tristate "Rockchip cif isp11 camera sensors"
	depends on VIDEO_V4L2 && I2C
	select VIDEOBUF_GEN
	select VIDEOBUF_DMA_CONTIG
	select VIDEOBUF_VMALLOC
	default n

	---help---
	  Say Y here to enable selecting the
	  rockchip cif isp11 camera sensors
```
