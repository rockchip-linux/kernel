/*
 * Google Veyron Gus Rev 1+ board device tree source
 *
 * Copyright 2015 Google, Inc
 *
 * This program is free software; you can redistribute it and/or modify
 * it under the terms of the GNU General Public License version 2 as
 * published by the Free Software Foundation.
 */

/dts-v1/;

#include "rk3288-veyron-chromebook.dtsi"
#include "rk3288-mighty.dtsi"
#include "cros-ec-sbs.dtsi"

/ {
	model = "Google Gus";
	compatible = "google,veyron-gus-rev5", "google,veyron-gus-rev4",
		     "google,veyron-gus-rev3", "google,veyron-gus-rev2",
		     "google,veyron-gus-rev1", "google,veyron-gus",
		     "google,veyron", "rockchip,rk3288";
};
