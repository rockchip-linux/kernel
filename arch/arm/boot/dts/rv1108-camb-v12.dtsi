
camera0: camera-module@1a {
	status = "okay";
	compatible = "sony,imx323-v4l2-i2c-subdev";
	reg = <0x1a>;
	device_type = "v4l2-i2c-subdev";
	clocks = <&clk_cif_out>;
	clock-names = "clk_cif_out";
	pinctrl-names = "rockchip,camera_default", "rockchip,camera_sleep";
	pinctrl-0 = <&cif_dvp_d0d1 &cif_dvp_d2d9 &cif_dvp_d10d11
		&cif_dvp_clk_in &cif_dvp_clk_out &cif_dvp_sync>;
	pinctrl-1 = <&cif_dvp_sleep>;
	rockchip,pd-gpio = <&gpio3 GPIO_D1 GPIO_ACTIVE_LOW>;
	rockchip,pwr-gpio = <&gpio3 GPIO_B5 GPIO_ACTIVE_HIGH>;
	rockchip,rst-gpio = <&gpio3 GPIO_B0 GPIO_ACTIVE_LOW>;
	rockchip,camera-module-mclk-name = "clk_cif_out";
	rockchip,camera-module-regulator-names = "vdd_cam";
	rockchip,camera-module-regulator-voltages = <1200000>;
	rockchip,camera-module-facing = "back";
	rockchip,camera-module-name = "LA6114PA";
	rockchip,camera-module-len-name = "YM6011P";
	rockchip,camera-module-fov-h = "122";
	rockchip,camera-module-fov-v = "63";
	rockchip,camera-module-orientation = <0>;
	rockchip,camera-module-iq-flip = <0>;
	rockchip,camera-module-iq-mirror = <0>;
	rockchip,camera-module-flip = <0>;
	rockchip,camera-module-mirror = <0>;
	/* resolution.w, resolution.h, defrect.left, defrect.top, defrect.w, defrect.h */
	rockchip,camera-module-defrect0 = <2200 1125 48 13 1920 1080>;
	rockchip,camera-module-flash-support = <0>;
};

camera1: camera-module@36 {
	status = "okay";
	compatible = "omnivision,ov4689-v4l2-i2c-subdev";
	reg = <0x36>;
	device_type = "v4l2-i2c-subdev";
	clocks = <&clk_cif_out>;
	clock-names = "clk_cif_out";
	pinctrl-names = "rockchip,camera_default", "rockchip,camera_sleep";
	pinctrl-0 = <&cif_dvp_clk_out>;
	pinctrl-1 = <&cif_dvp_clk_out_sleep>;
	rockchip,pd-gpio = <&gpio3 GPIO_B0 GPIO_ACTIVE_LOW>;
	rockchip,pwr-gpio = <&gpio3 GPIO_B5 GPIO_ACTIVE_HIGH>;
	rockchip,rst-gpio = <&gpio3 GPIO_D1 GPIO_ACTIVE_LOW>;
	rockchip,camera-module-mclk-name = "clk_cif_out";
	rockchip,camera-module-regulator-names = "vdd_cam";
	rockchip,camera-module-regulator-voltages = <1200000>;
	rockchip,camera-module-facing = "back";
	rockchip,camera-module-name = "LA6111PA";
	rockchip,camera-module-len-name = "YM6011P";
	rockchip,camera-module-fov-h = "116";
	rockchip,camera-module-fov-v = "61";
	rockchip,camera-module-orientation = <0>;
	rockchip,camera-module-iq-flip = <0>;
	rockchip,camera-module-iq-mirror = <0>;
	rockchip,camera-module-flip = <0>;
	rockchip,camera-module-mirror = <1>;
	/* resolution.w, resolution.h, defrect.left, defrect.top, defrect.w, defrect.h */
	rockchip,camera-module-defrect0 = <2688 1520 0 0 2688 1520>;
	rockchip,camera-module-flash-support = <0>;
	rockchip,camera-module-mipi-dphy-index = <0>;
};

camera2: camera-module@36-1 {
	status = "okay";
	compatible = "omnivision,ov2710-v4l2-i2c-subdev";
	reg = <0x36>;
	device_type = "v4l2-i2c-subdev";
	clocks = <&clk_cif_out>;
	clock-names = "clk_cif_out";
	pinctrl-names = "rockchip,camera_default", "rockchip,camera_sleep";
	pinctrl-0 = <&cif_dvp_clk_out>;
	pinctrl-1 = <&cif_dvp_clk_out_sleep>;
	rockchip,pd-gpio = <&gpio3 GPIO_B0 GPIO_ACTIVE_HIGH>;
	rockchip,pwr-gpio = <&gpio3 GPIO_B5 GPIO_ACTIVE_HIGH>;
	rockchip,rst-gpio = <&gpio3 GPIO_D1 GPIO_ACTIVE_LOW>;
	rockchip,camera-module-mclk-name = "clk_cif_out";
	rockchip,camera-module-regulator-names = "vdd_cam";
	rockchip,camera-module-regulator-voltages = <1450000>;
	rockchip,camera-module-facing = "back";
	rockchip,camera-module-name = "LA6110PA";
	rockchip,camera-module-len-name = "YM6011P";
	rockchip,camera-module-fov-h = "128";
	rockchip,camera-module-fov-v = "55.7";
	rockchip,camera-module-orientation = <0>;
	rockchip,camera-module-iq-flip = <0>;
	rockchip,camera-module-iq-mirror = <0>;
	rockchip,camera-module-flip = <0>;
	rockchip,camera-module-mirror = <0>;
	/* resolution.w, resolution.h, defrect.left, defrect.top, defrect.w, defrect.h */
	rockchip,camera-module-defrect0 = <1920 1080 0 0 1920 1080>;
	rockchip,camera-module-flash-support = <0>;
	rockchip,camera-module-mipi-dphy-index = <0>;
};
