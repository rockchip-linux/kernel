/*
 * Smart battery dts fragment for devices that use cros-ec-sbs
 *
 * Copyright (c) 2015 Google, Inc
 *
 * This program is free software; you can redistribute it and/or modify
 * it under the terms of the GNU General Public License version 2 as
 * published by the Free Software Foundation.
*/

&i2c_tunnel {
	battery: sbs-battery@b {
		compatible = "sbs,sbs-battery";
		reg = <0xb>;
		sbs,i2c-retry-count = <2>;
		sbs,poll-retry-count = <1>;
	};
};
