/*
 * Google Veyron Jerry Rev 0 board device tree source
 *
 * Copyright 2014 Google, Inc
 *
 * This program is free software; you can redistribute it and/or modify
 * it under the terms of the GNU General Public License version 2 as
 * published by the Free Software Foundation.
 */

/dts-v1/;
#include "rk3288-veyron.dtsi"

/ {
	model = "Google Jerry";
	compatible = "google,veyron-jerry-rev1", "google,veyron-jerry",
		     "google,veyron", "rockchip,rk3288";
};
