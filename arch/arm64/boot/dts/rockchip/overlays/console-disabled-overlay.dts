// Definitions for disabling ttyFIQ0 console
/dts-v1/;
/plugin/;

/ {
	model = "ROCK PI 4B";
	compatible = "rockchip,rockpi","rockchip,rk3399";

	fragment@0 {
		target = <&fiq_debugger>;
		
		__overlay__ {
			status = "disabled";
		};
	};
};
