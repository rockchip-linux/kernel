/dts-v1/;
/plugin/;

/ {
	model = "ROCK PI 4B";
	compatible = "rockchip,rockpi","rockchip,rk3399";

	fragment@0 {
		target = <&spi2>;

		__overlay__ {
			max-freq = <50000000>;
			dmas = <&dmac_peri 0xe>, <&dmac_peri 0xf>;
			dma-names = "tx","rx";
			#address-cells = <1>;
			#size-cells = <0>;
			devspi@0 {
				status = "okay";
				reg = <0>;
				compatible ="rockchip,spidev";
				spi-max-frequency = <50000000>;
			};
		};
	};
};
