/dts-v1/;
/plugin/;

/ {
	model = "ROCK PI 4B";
	compatible = "rockchip,rockpi","rockchip,rk3399";

	fragment@0 {
		target = <&i2c4>;

		__overlay__ {
			status = "okay";
		};
	};

	fragment@1 {
		target = <&camera1>;

		__overlay__ {
			status = "okay";
		};
	};
};
