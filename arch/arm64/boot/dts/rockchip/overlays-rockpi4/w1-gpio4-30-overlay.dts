/dts-v1/;
/plugin/;

/ {
	compatible = "rockchip,rockpi","rockchip,rk3399";

	fragment@0 {
		target-path = "/";

		__overlay__ {

			w1: onewire@0 {
				compatible = "w1-gpio";
				pinctrl-names = "default";
				pinctrl-0 = <&w1_pins>;
				gpios = <&gpio4 30 0>;
				status = "okay";
			};
		};
	};

	fragment@1 {
		target = <&gpio4>;

		__overlay__ {
			w1_pins: w1_pins {
				rockchip,pins = <4 30 0 &pcfg_pull_none>;
			};
		};
	};
};
