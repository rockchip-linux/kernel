// Definitions for setting uart4 pins as ttyFIQ0 console pins
/dts-v1/;
/plugin/;

/ {
	model = "ROCK PI 4B";
	compatible = "rockchip,rockpi","rockchip,rk3399";

	fragment@0 {
		target = <&uart2>;
		
		__overlay__ {
			status = "disabled";
		};
	};

	fragment@1 {
		target = <&fiq_debugger>;

		__overlay__ {
			status = "okay";
			compatible = "rockchip,fiq-debugger";
			rockchip,serial-id = <2>;
			rockchip,signal-irq = <182>;
			rockchip,wake-irq = <0>;
			rockchip,irq-mode-enable = <1>;  /* If enable uart uses irq instead of fiq */
			rockchip,baudrate = <1500000>;  /* Only 115200 and 1500000 */
			pinctrl-names = "default";
			pinctrl-0 = <&uart2c_xfer>;
		};
	};
};
