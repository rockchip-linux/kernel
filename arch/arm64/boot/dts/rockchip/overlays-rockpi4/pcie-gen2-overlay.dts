// Enable pcie gen2 mode
/dts-v1/;
/plugin/;

/ {
	model = "ROCK PI 4B";
	compatible = "rockchip,rockpi","rockchip,rk3399";

	fragment@0 {
		target = <&pcie0>;
		
		__overlay__ {
			max-link-speed = <2>;
		};
	};
};
