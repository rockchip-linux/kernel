// SPDX-License-Identifier: (GPL-2.0+ OR MIT)
/*
 * Copyright (c) 2018 Fuzhou Rockchip Electronics Co., Ltd
 */

/dts-v1/;
#include "rk1808-compute.dtsi"

/ {
	model = "Rockchip RK1808 compute V10 Board";
	compatible = "rockchip,rk1808-compute-v10", "rockchip,rk1808";

	chosen {
		bootargs = "earlycon=uart8250,mmio32,0xff550000 console=ttyFIQ0 dump_initrd init=/init swiotlb=1 kpti=0";
	};
};
