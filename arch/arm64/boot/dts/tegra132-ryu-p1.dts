/dts-v1/;

#include "tegra132-ryu.dtsi"

/ {
	model = "Google Tegra132 Ryu P1";
	compatible = "google,ryu-p1", "google,ryu", "nvidia,tegra132", \
			"nvidia,tegra124";

	regulators {
		pplcd_vdd: fixed-regulator@5 {
			gpio = <&gpio TEGRA_GPIO(BB, 6) GPIO_ACTIVE_HIGH>;
		};
	};
};
